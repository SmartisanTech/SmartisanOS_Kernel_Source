/* Copyright (c) 2013, The Linux Foundation. All rights reserved.
 *
 * This program is free software; you can redistribute it and/or modify
 * it under the terms of the GNU General Public License version 2 and
 * only version 2 as published by the Free Software Foundation.
 *
 * This program is distributed in the hope that it will be useful,
 * but WITHOUT ANY WARRANTY; without even the implied warranty of
 * MERCHANTABILITY or FITNESS FOR A PARTICULAR PURPOSE.  See the
 * GNU General Public License for more details.
 */

/dts-v1/;

/include/ "sfo-v40-msm8974pro-ac-pm8941.dtsi"
/include/ "sfo-v40-msm8974.dtsi"

/ {
	model = "Qualcomm MSM 8974Pro-AC SMARTISAN SFO";
	compatible = "qcom,msm8974-sfo", "qcom,msm8974", "qcom,sfo", "qcom,sfo-v40", "qcom,8x74AC";
	qcom,board-id = <0x17 0x4>;
};

&sdhc_1 {
	qcom,pad-pull-on = <0x0 0x3 0x3 0x1>; /* no-pull, pull-up, pull-up, pull-down */
	qcom,pad-pull-off = <0x0 0x3 0x3 0x1>; /* no-pull, pull-up, pull-up, pull-down */
};
