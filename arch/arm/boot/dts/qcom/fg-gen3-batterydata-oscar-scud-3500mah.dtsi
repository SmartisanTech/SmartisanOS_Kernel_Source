
qcom,smartisan_oscar_scud {
	qcom, = <24>;
	/* #2952042_Smartisan_ODINscud_3500mAh_averaged_MasterSlave_May17th2017*/
	qcom,fastchg-current-ma = <3500>;
	qcom,max-voltage-uv = <4402500>;
	qcom,nom-batt-capacity-mah = <3500>;
	qcom,batt-id-kohm = <100>;
	qcom,battery-beta = <3380>;
	qcom,battery-type = "smartisan_oscar_scud";
	qcom,checksum = <0x0484>;
	qcom,gui-version = "PM660GUI - 0.0.0.42";
	qcom,fg-profile-data = [
		 AF 1F 64 05
		 AB 0A 2B FC
		 4D 1D EF E2
		 03 0A 77 0C
		 77 18 46 23
		 15 45 8C 53
		 5A 00 00 00
		 0E 00 00 00
		 00 00 B3 C4
		 A6 C4 89 C2
		 1A 00 08 00
		 08 D2 17 E5
		 77 FD A3 00
		 F4 00 28 12
		 B6 05 D9 2A
		 19 06 09 20
		 27 00 14 00
		 B1 1F 9E 05
		 71 0A B1 FC
		 5B 1D C7 EB
		 30 0A 76 15
		 2F 19 E3 22
		 74 45 0A 53
		 54 00 00 00
		 0D 00 00 00
		 00 00 33 CD
		 D8 C2 78 BC
		 16 00 00 00
		 A9 EA 17 E5
		 51 F4 72 EB
		 F2 00 38 0B
		 57 03 57 22
		 C2 33 CC FF
		 07 10 00 00
		 A7 0D 66 46
		 16 00 40 00
		 4A 01 0A FA
		 FF 00 00 00
		 00 00 00 00
		 00 00 00 00
		 00 00 00 00
		 00 00 00 00
		 00 00 00 00
		 00 00 00 00
		 00 00 00 00
		 00 00 00 00
		 00 00 00 00
		 00 00 00 00
		 00 00 00 00
		 00 00 00 00
		 00 00 00 00
		 00 00 00 00
		 00 00 00 00
		 00 00 00 00
		 00 00 00 00
		 00 00 00 00
	];
};
