/* Copyright (c) 2013, The Linux Foundation. All rights reserved.
 *
 * This program is free software; you can redistribute it and/or modify
 * it under the terms of the GNU General Public License version 2 and
 * only version 2 as published by the Free Software Foundation.
 *
 * This program is distributed in the hope that it will be useful,
 * but WITHOUT ANY WARRANTY; without even the implied warranty of
 * MERCHANTABILITY or FITNESS FOR A PARTICULAR PURPOSE.  See the
 * GNU General Public License for more details.
 */

/*---------------------------------------------------------------------------
 * This file is autogenerated file using gcdb parser. Please do not edit it.
 * Update input XML file to add a new entry or update variable in this file
 * VERSION = "1.0"
 *---------------------------------------------------------------------------*/
&mdss_mdp {
	dsi_boe_td4310_1080p_vid: qcom,mdss_dsi_boe_td4310_1080p_video {
		qcom,mdss-dsi-panel-name = "boe td4310 1080p video mode fhd dsi panel";
		qcom,mdss-dsi-panel-controller = <&mdss_dsi0>;
		qcom,mdss-dsi-panel-type = "dsi_video_mode";
		qcom,mdss-dsi-panel-destination = "display_1";
		qcom,mdss-dsi-panel-framerate = <60>;
		qcom,mdss-dsi-virtual-channel-id = <0>;
		qcom,mdss-dsi-stream = <0>;
		qcom,mdss-dsi-panel-width = <1080>;
		qcom,mdss-dsi-panel-height = <2160>;
		qcom,mdss-dsi-h-front-porch = <60>;
		qcom,mdss-dsi-h-back-porch = <20>;
		qcom,mdss-dsi-h-pulse-width = <2>;
		qcom,mdss-dsi-h-sync-skew = <0>;
		qcom,mdss-dsi-v-back-porch = <4>;
		qcom,mdss-dsi-v-front-porch = <4>;
		qcom,mdss-dsi-v-pulse-width = <2>;
		qcom,mdss-dsi-h-left-border = <0>;
		qcom,mdss-dsi-h-right-border = <0>;
		qcom,mdss-dsi-v-top-border = <0>;
		qcom,mdss-dsi-v-bottom-border = <0>;
		qcom,mdss-dsi-bpp = <24>;
		qcom,mdss-dsi-color-order = "rgb_swap_rgb";
		qcom,mdss-dsi-underflow-color = <0xff>;
		qcom,mdss-dsi-border-color = <0>;

		qcom,mdss-dsi-panel-color-temperature-command = [
            		29 01 00 00 00 00 02 b0 04
			29 01 00 00 00 00 2C CA 1D FC FC FC 00 07 0D E4 00 E4 59 23 00 0d df 00 00 C5 FB 00 00 F7 00 00 00 00 00 00 00 00 00 00 00 00 00 00 00 00 00 00 00 00 00
	        	29 01 00 00 00 00 02 C8 11
			29 01 00 00 00 00 14 C9 00 00 00 00 00 F7 00 00 00 00 00 F8 00 00 00 00 00 F4 00
			29 01 00 00 00 00 14 C9 00 00 00 00 00 F7 00 00 00 00 00 F4 00 00 00 00 00 EC 00
			29 01 00 00 00 00 14 C9 00 00 00 00 00 F7 00 00 00 00 00 F0 00 00 00 00 00 E4 00
			29 01 00 00 00 00 14 C9 00 00 00 00 00 F7 00 00 00 00 00 EC 00 00 00 00 00 DC 00
			29 01 00 00 00 00 14 C9 00 00 00 00 00 F7 00 00 00 00 00 E8 00 00 00 00 00 D4 00
			29 01 00 00 00 00 14 C9 00 00 00 00 00 F8 00 00 00 00 00 E4 00 00 00 00 00 CC 00
			29 01 00 00 00 00 14 C9 00 00 00 00 00 F8 00 00 00 00 00 E0 00 00 00 00 00 C4 00
			29 01 00 00 00 00 14 C9 00 00 00 00 00 F8 00 00 00 00 00 DC 00 00 00 00 00 BC 00
			29 01 00 00 00 00 14 C9 00 00 00 00 00 F8 00 00 00 00 00 D8 00 00 00 00 00 B4 00
			29 01 00 00 00 00 14 C9 00 00 00 00 00 F9 00 00 00 00 00 D4 00 00 00 00 00 AC 00
			29 01 00 00 00 00 14 C9 00 00 00 00 00 F9 00 00 00 00 00 D0 00 00 00 00 00 A4 00
			29 01 00 00 00 00 14 C9 00 00 00 00 00 F9 00 00 00 00 00 CC 00 00 00 00 00 9C 00
			29 01 00 00 00 00 14 C9 00 00 00 00 00 F9 00 00 00 00 00 C9 00 00 00 00 00 94 00
			29 01 00 00 00 00 14 C9 00 00 00 00 00 F9 00 00 00 00 00 C4 00 00 00 00 00 8C 00
			29 01 00 00 00 00 14 C9 00 00 00 00 00 FA 00 00 00 00 00 C0 00 00 00 00 00 84 00
			29 01 00 00 00 00 14 C9 00 00 00 00 00 FA 00 00 00 00 00 BD 00 00 00 00 00 7C 00
			29 01 00 00 00 00 14 C9 00 00 00 00 00 FA 00 00 00 00 00 BA 00 00 00 00 00 74 00
			29 01 00 00 00 00 14 C9 00 00 00 00 00 FA 00 00 00 00 00 B7 00 00 00 00 00 6C 00
			29 01 00 00 00 00 14 C9 00 00 00 00 00 FA 00 00 00 00 00 B5 00 00 00 00 00 64 00
			29 01 00 00 00 00 14 C9 00 00 00 00 00 FA 00 00 00 00 00 B3 00 00 00 00 00 5C 00
			29 01 00 00 00 00 14 C9 00 00 00 00 00 FB 00 00 00 00 00 B1 00 00 00 00 00 54 00
			29 01 00 00 00 00 14 C9 00 00 00 00 00 FB 00 00 00 00 00 AF 00 00 00 00 00 4C 00
			29 01 00 00 00 00 14 C9 00 00 00 00 00 FB 00 00 00 00 00 AD 00 00 00 00 00 44 00
			29 01 00 00 00 00 14 C9 00 00 00 00 00 FB 00 00 00 00 00 AB 00 00 00 00 00 3B 00
			29 01 00 00 00 00 14 C9 00 00 00 00 00 FB 00 00 00 00 00 A9 00 00 00 00 00 32 00
			29 01 00 00 00 00 14 C9 00 00 00 00 00 FC 00 00 00 00 00 A7 00 00 00 00 00 29 00
			29 01 00 00 00 00 14 C9 00 00 00 00 00 FC 00 00 00 00 00 A5 00 00 00 00 00 20 00
			29 01 00 00 00 00 14 C9 00 00 FA FE FD FC 00 00 F8 01 FD A2 00 00 FA FE 01 17 00
			29 01 00 00 00 00 08 B8 67 4B 08 00 04 00 00
			29 01 00 00 00 00 08 B9 99 4B 09 00 07 00 00
			29 01 00 00 00 00 08 BA BB 43 19 00 09 00 00
			29 01 00 00 00 00 02 B0 03
		];

			qcom,mdss-dsi-panel-color-temperature-command-restore = [
			29 01 00 00 00 00 02 b0 04
			29 01 00 00 00 00 2c CA 1D FC FC FC 00 F3 FE E4 00 E4 F4 F4 00 E4 00 00 00 C5 FB 00 00 F7 9F 6B 61 A1 69 5B 4D 00 00 00 00 00 00 00 00 00 00 00 00 00 00
	        	29 01 00 00 00 00 02 C8 11
			29 01 00 00 00 00 14 C9 00 00 00 00 00 FC 00 00 00 00 00 A5 00 00 00 00 00 20 00
			29 01 00 00 00 00 14 C9 00 00 00 00 00 FC 00 00 00 00 00 A7 00 00 00 00 00 29 00
			29 01 00 00 00 00 14 C9 00 00 00 00 00 FB 00 00 00 00 00 A9 00 00 00 00 00 32 00
			29 01 00 00 00 00 14 C9 00 00 00 00 00 FB 00 00 00 00 00 AB 00 00 00 00 00 3B 00
			29 01 00 00 00 00 14 C9 00 00 00 00 00 FB 00 00 00 00 00 AD 00 00 00 00 00 44 00
			29 01 00 00 00 00 14 C9 00 00 00 00 00 FB 00 00 00 00 00 AF 00 00 00 00 00 4C 00
			29 01 00 00 00 00 14 C9 00 00 00 00 00 FB 00 00 00 00 00 B1 00 00 00 00 00 54 00
			29 01 00 00 00 00 14 C9 00 00 00 00 00 FA 00 00 00 00 00 B3 00 00 00 00 00 5C 00
			29 01 00 00 00 00 14 C9 00 00 00 00 00 FA 00 00 00 00 00 B5 00 00 00 00 00 64 00
			29 01 00 00 00 00 14 C9 00 00 00 00 00 FA 00 00 00 00 00 B7 00 00 00 00 00 6C 00
			29 01 00 00 00 00 14 C9 00 00 00 00 00 FA 00 00 00 00 00 BA 00 00 00 00 00 74 00
			29 01 00 00 00 00 14 C9 00 00 00 00 00 FA 00 00 00 00 00 BD 00 00 00 00 00 7C 00
			29 01 00 00 00 00 14 C9 00 00 00 00 00 FA 00 00 00 00 00 C0 00 00 00 00 00 84 00
			29 01 00 00 00 00 14 C9 00 00 00 00 00 F9 00 00 00 00 00 C4 00 00 00 00 00 8C 00
			29 01 00 00 00 00 14 C9 00 00 00 00 00 F9 00 00 00 00 00 C9 00 00 00 00 00 94 00
			29 01 00 00 00 00 14 C9 00 00 00 00 00 F9 00 00 00 00 00 CC 00 00 00 00 00 9C 00
			29 01 00 00 00 00 14 C9 00 00 00 00 00 F9 00 00 00 00 00 D0 00 00 00 00 00 A4 00
			29 01 00 00 00 00 14 C9 00 00 00 00 00 F9 00 00 00 00 00 D4 00 00 00 00 00 AC 00
			29 01 00 00 00 00 14 C9 00 00 00 00 00 F8 00 00 00 00 00 D8 00 00 00 00 00 B4 00
			29 01 00 00 00 00 14 C9 00 00 00 00 00 F8 00 00 00 00 00 DC 00 00 00 00 00 BC 00
			29 01 00 00 00 00 14 C9 00 00 00 00 00 F8 00 00 00 00 00 E0 00 00 00 00 00 C4 00
			29 01 00 00 00 00 14 C9 00 00 00 00 00 F8 00 00 00 00 00 E4 00 00 00 00 00 CC 00
			29 01 00 00 00 00 14 C9 00 00 00 00 00 F7 00 00 00 00 00 E8 00 00 00 00 00 D4 00
			29 01 00 00 00 00 14 C9 00 00 00 00 00 F7 00 00 00 00 00 EC 00 00 00 00 00 DC 00
			29 01 00 00 00 00 14 C9 00 00 00 00 00 F7 00 00 00 00 00 F0 00 00 00 00 00 E4 00
			29 01 00 00 00 00 14 C9 00 00 00 00 00 F7 00 00 00 00 00 F4 00 00 00 00 00 EC 00
			29 01 00 00 00 00 14 C9 00 00 00 00 00 F7 00 00 00 00 00 F8 00 00 00 00 00 F4 00
			29 01 00 00 00 00 14 C9 00 00 00 00 00 F7 00 00 00 00 00 FC 00 00 00 00 00 FE 00
			29 01 00 00 00 00 02 C8 01
			29 01 00 00 00 00 08 B8 67 4B 08 00 04 00 00
			29 01 00 00 00 00 08 B9 99 4B 09 00 07 00 00
			29 01 00 00 00 00 08 BA BB 43 19 00 09 00 00
			29 01 00 00 00 00 02 B0 03
		];

		qcom,mdss-dsi-panel-sre-strong-level = [
			29 01 00 00 00 00 02 b0 04
			15 01 00 00 00 00 02 51 ff
			15 01 00 00 00 00 02 53 2C
			15 01 00 00 00 00 02 55 F1
			29 01 00 00 00 00 08 B8 6e F1 64 32 00 40 00
			29 01 00 00 00 00 03 BD 64 00
			29 01 00 00 00 00 2c CA 1D FC FC FC 00 F3 FA E4 00 E4 F4 F4 00 E4 00 00 00 C5 FB 00 00 F7 00 00 00 00 00 00 00 00 00 00 00 00 00 00 00 00 00 00 00 00 00
			29 01 00 00 00 00 02 F9 64
			29 01 00 00 00 00 02 B0 03
		];

		qcom,mdss-dsi-panel-sre-exit = [
			29 01 00 00 00 00 02 b0 04
			15 01 00 00 00 00 02 51 ff
			15 01 00 00 00 00 02 53 2C
			15 01 00 00 00 00 02 55 82
			29 01 00 00 00 00 08 B8 67 4B 08 00 04 00 00
			29 01 00 00 00 00 08 B9 99 4B 09 00 07 00 00
			29 01 00 00 00 00 08 BA BB 43 19 00 09 00 00
			29 01 00 00 00 00 02 F9 64
			29 01 00 00 00 00 02 B0 03
		];

		qcom,mdss-dsi-on-command = [
			05 01 00 00 80 00 02 11 00
			15 01 00 00 00 00 02 51 FF
			15 01 00 00 00 00 02 53 24
			15 01 00 00 00 00 02 55 82
			29 01 00 00 00 00 02 B0 04
			29 01 00 00 00 00 02 d6 01
			//gamma 2.3
			/* 29 01 00 00 00 00 27 C7 06 1D 2A 3B 49 53 67 75 80 8A 3A 44 51 66 70 7E 8E 9D B2 06 1C 29 3A 48 52 66 74 80 8A 3A 44 51 66 70 7E 8E 9D B2 */
			/* 29 01 00 00 00 00 37 C8 03 00 FD FE FF F7 00 00 FC 01 FC FC 00 00 FC FA F5 FE 00 00 FD FE FF FE 00 00 FC 01 FE FE 00 00 FC FA F5 FE 00 00 01 FD FF F1 00 00 FC 01 FF F7 00 00 FC FA F5 FE */
			//esd
			29 01 00 00 00 00 06 b6 33 5f 81 82 00
			29 01 00 00 00 00 02 e4 01
			29 01 00 00 00 00 05 e4 01 00 00 3e
			//boe only
			29 01 00 00 00 00 31 C1 04 40 00 FF 5F 6B 89 B0 6A 85 0F A3 FC FF FF FF 65 84 1F 2C 65 CB B0 F6 FE 0F 00 00 00 00 00 00 00 00 40 02 22 02 06 0A 00 00 01 00 05 00 00 00
			29 01 00 00 00 00 1c CB FF FF FF FF 0F 00 00 00 00 00 11 F0 00 0D 00 00 00 00 00 00 00 00 00 00 00 00 00
			//cabc setting
			29 01 00 00 00 00 08 B8 67 4B 08 00 04 00 00
			29 01 00 00 00 00 08 B9 99 4B 09 00 07 00 00
			29 01 00 00 00 00 08 BA BB 43 19 00 09 00 00
			29 01 00 00 00 00 1a CE 55 40 60 78 87 94 9E AB B8 C4 CD D6 DE E5 EC F3 FF 00 E3 04 04 42 04 69 5A
			29 01 00 00 00 00 2c CA 1D FC FC FC 00 F3 FE E4 00 E4 F4 F4 00 E4 00 00 00 C5 FB 00 00 F7 9F 6B 61 A1 69 5B 4D 00 00 00 00 00 00 00 00 00 00 00 00 00 00
			29 01 00 00 00 00 02 F9 64
			//end
			29 01 00 00 00 00 02 B0 03
			05 01 00 00 20 00 02 29 00];
		qcom,mdss-dsi-off-command = [05 01 00 00 32 00 02 28 00
					29 01 00 00 00 00 02 B0 00
					29 01 00 00 00 00 31 C1 04 40 00 FF FF FF FF FF EA FF FF FF FF FF FF FF FF FF FF 7F F5 FF FF FF FF 0F 00 00 00 00 00 00 00 00 40 02 22 02 06 0A 00 00 01 00 01 00 00 00
					29 01 00 00 00 00 1c CB FF FF FF FF 0F FC 76 E0 F6 03 11 F0 00 0D 00 00 00 00 00 00 00 00 00 00 00 00 00
					29 01 00 00 00 00 02 B0 03
					05 01 00 00 78 00 02 10 00];
		qcom,mdss-dsi-on-command-state = "dsi_lp_mode";
		qcom,mdss-dsi-off-command-state = "dsi_hs_mode";
		qcom,mdss-dsi-h-sync-pulse = <0>;
		qcom,mdss-dsi-traffic-mode = "burst_mode";
		//qcom,mdss-dsi-lane-map = "lane_map_0123";
		qcom,mdss-dsi-bllp-eof-power-mode;
		qcom,mdss-dsi-bllp-power-mode;
		qcom,mdss-dsi-lane-0-state;
		qcom,mdss-dsi-lane-1-state;
		qcom,mdss-dsi-lane-2-state;
		qcom,mdss-dsi-lane-3-state;
		qcom,mdss-dsi-panel-timings = [cb 36 24 01 66 68 2a 38 2a 03 04 00];
		//qcom,mdss-dsi-panel-timings = [bf 38 26 01 68 6e 2a 3c 2c 03 04 00];
		qcom,mdss-dsi-t-clk-post = <0x0d>;
		qcom,mdss-dsi-t-clk-pre = <0x30>;
		qcom,mdss-dsi-bl-min-level = <1>;
		qcom,mdss-dsi-bl-max-level = <4095>;
		qcom,mdss-dsi-dma-trigger = "trigger_sw";
		qcom,mdss-dsi-mdp-trigger = "none";
		qcom,mdss-dsi-bl-pmic-control-type = "bl_ctrl_wled";
		qcom,mdss-dsi-reset-sequence = <1 2>, <0 2>, <1 3>;
		qcom,mdss-pan-physical-width-dimension = <68>;
		qcom,mdss-pan-physical-height-dimension = <136>;
		qcom,mdss-dsi-tx-eot-append;
		//qcom,mdss-dsi-post-init-delay = <1>;
	};
};
