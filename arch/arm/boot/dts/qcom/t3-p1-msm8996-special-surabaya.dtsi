#include "t3-p1-msm8996-pinctrl-surabaya.dtsi"
#include "t3-p1-msm8996-mtp-surabaya.dtsi"
#include "t3-p1-msm8996-regulator-surabaya.dtsi"
#include "t3-p1-msm-pm8994-surabaya.dtsi"
#include "t3-p1-msm-pmi8994-surabaya.dtsi"
#include "t3-p1-msm8996-goodix.dtsi"
#include "t3-p1-msm8996-nfc-brcm.dtsi"
#include "t3-p1-msm8996-pinctrl-surabaya-special.dtsi"
#include "t3-p1-msm8996-fpc.dtsi"
#include "t3-p1-msm8996-battery.dtsi"
#include "t3-p1-msm8996-camera.dtsi"
#include "t3-p1-msm8996-key.dtsi"
#include "t3-p1-msm8996-haptics.dtsi"
#include "t3-p1-msm8996-thermal.dtsi"
