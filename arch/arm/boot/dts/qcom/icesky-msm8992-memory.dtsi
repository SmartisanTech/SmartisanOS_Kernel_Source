/{
	memory {
                pstore_reserve_mem: pstore_reserve_mem_region@0 {
                        linux,reserve-contiguous-region;
                        linux,reserve-region;
                        linux,remove-completely;
                        reg = <0x0 0x1ff00000 0x0 0x00100000>;
                        label = "pstore_reserve_mem";
                };

	};
};
