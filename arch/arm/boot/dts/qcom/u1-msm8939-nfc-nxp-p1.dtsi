&soc {
	i2c@78ba000{
		pn547@28 {
			compatible = "NXP,pn547";
			reg = <0x28>;
			qcom,irq-gpio = <&msm_gpio 21 0x04>;
			qcom,firm-gpio = <&msm_gpio 17 0x00>;
			qcom,ven-gpio = <&msm_gpio 20 0x00>;
           //        qcom,clkreq-gpio = <&pm8916_gpios 5 0x00>;
			interrupt-parent = <&msm_gpio>;
			interrupts = <21 0>;
		};
	};
};
