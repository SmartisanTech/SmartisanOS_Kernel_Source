/* Copyright (c) 2014-2015, The Linux Foundation. All rights reserved.
 *
 * This program is free software; you can redistribute it and/or modify
 * it under the terms of the GNU General Public License version 2 and
 * only version 2 as published by the Free Software Foundation.
 *
 * This program is distributed in the hope that it will be useful,
 * but WITHOUT ANY WARRANTY; without even the implied warranty of
 * MERCHANTABILITY or FITNESS FOR A PARTICULAR PURPOSE.  See the
 * GNU General Public License for more details.
 */

&spmi_bus {
	qcom,pmi8950@3 {
		pmi_haptic: qcom,haptic@c000 {
			status = "okay";
			compatible = "qcom,qpnp-haptic";
			reg = <0xc000 0x100>;
			interrupts = <0x3 0xc0 0x0>,
					<0x3 0xc0 0x1>;
			interrupt-names = "sc-irq", "play-irq";
			qcom,play-mode = "buffer";
			qcom,wave-play-rate-us = <4255>;	/* 235Hz */
			qcom,actuator-type = "lra";
			qcom,wave-shape = "sine";
			qcom,vmax-mv = <2545>;			/* 1.8 Vrms AC (Sine Wave) */
			qcom,ilim-ma = <80>;				/* 80 mArms */
			qcom,sc-deb-cycles = <8>;
			qcom,int-pwm-freq-khz = <505>;
			qcom,use-play-irq;
			qcom,use-sc-irq;
			qcom,wave-samples = [2c 2c 2c 2c 2c 2c 2c 2c];
			qcom,wave-rep-cnt = <1>;
			qcom,wave-samp-rep-cnt = <1>;
		};
	};
};
