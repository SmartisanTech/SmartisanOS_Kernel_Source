/* Copyright (c) 2013, The Linux Foundation. All rights reserved.
 *
 * This program is free software; you can redistribute it and/or modify
 * it under the terms of the GNU General Public License version 2 and
 * only version 2 as published by the Free Software Foundation.
 *
 * This program is distributed in the hope that it will be useful,
 * but WITHOUT ANY WARRANTY; without even the implied warranty of
 * MERCHANTABILITY or FITNESS FOR A PARTICULAR PURPOSE.  See the
 * GNU General Public License for more details.
 */

/*---------------------------------------------------------------------------
 * This file is autogenerated file using gcdb parser. Please do not edit it.
 * Update input XML file to add a new entry or update variable in this file
 * VERSION = "1.0"
 *---------------------------------------------------------------------------*/
&mdss_mdp {
	dsi_sharp_ft8716_1080p_vid: qcom,mdss_dsi_sharp_ft8716_1080p_video {
		qcom,mdss-dsi-panel-name = "sharp ft8716 1080p video mode dsi panel";
		qcom,mdss-dsi-panel-controller = <&mdss_dsi0>;
		qcom,mdss-dsi-panel-type = "dsi_video_mode";
		qcom,mdss-dsi-panel-destination = "display_1";
		qcom,mdss-dsi-panel-framerate = <60>;
		qcom,mdss-dsi-virtual-channel-id = <0>;
		qcom,mdss-dsi-stream = <0>;
		qcom,mdss-dsi-panel-width = <1080>;
		qcom,mdss-dsi-panel-height = <1920>;
		qcom,mdss-dsi-h-front-porch = <96>;
		qcom,mdss-dsi-h-back-porch = <96>;
		qcom,mdss-dsi-h-pulse-width = <4>;
		qcom,mdss-dsi-h-sync-skew = <0>;
		qcom,mdss-dsi-v-back-porch = <16>;
		qcom,mdss-dsi-v-front-porch = <16>;
		qcom,mdss-dsi-v-pulse-width = <2>;
		qcom,mdss-dsi-h-left-border = <0>;
		qcom,mdss-dsi-h-right-border = <0>;
		qcom,mdss-dsi-v-top-border = <0>;
		qcom,mdss-dsi-v-bottom-border = <0>;
		qcom,mdss-dsi-bpp = <24>;
		qcom,mdss-dsi-color-order = "rgb_swap_rgb";
		qcom,mdss-dsi-underflow-color = <0xff>;
		qcom,mdss-dsi-border-color = <0>;
		qcom,ulps-enabled;
		qcom,suspend-ulps-enabled;
		/* qcom,mdss-dsi-pan-enable-dynamic-fps; */
		/* qcom,mdss-dsi-pan-fps-update = "dfps_immediate_porch_mode_vfp"; */
		/* qcom,mdss-dsi-min-refresh-rate = <48>; */
		/* qcom,mdss-dsi-max-refresh-rate = <60>; */


		qcom,mdss-dsi-panel-color-temperature-command-sharp-ft8716-first = [
			15 01 00 00 00 00 02 00 00
			39 01 00 00 00 00 04 FF 87 16 01
			15 01 00 00 00 00 02 00 80
			39 01 00 00 00 00 03 FF 87 16
			//huyan
			#if 1
			15 01 00 00 00 00 02 00 80
			39 01 00 00 00 00 0d D8 80 82 82 83 85 86 87 87 86 84 82 00
			15 01 00 00 00 00 02 00 90
			39 01 00 00 00 00 0d D8 00 00 80 81 82 82 81 80 00 01 00 00
			15 01 00 00 00 00 02 00 A0
			39 01 00 00 00 00 0d D8 01 02 03 04 06 08 0b 0f 13 17 18 1d
			15 01 00 00 00 00 02 00 B0
			39 01 00 00 00 00 0d D8 81 84 86 89 8e 93 96 99 9b 9c 9c 9f
			15 01 00 00 00 00 02 00 C0
			39 01 00 00 00 00 0d D8 84 8a 8e 92 9b a5 ad b3 b9 bc b9 bb
			15 01 00 00 00 00 02 00 D0
			39 01 00 00 00 00 0d D8 02 04 05 06 08 0c 10 14 19 1c 1a 1c
			15 01 00 00 00 00 02 00 E0
			39 01 00 00 00 00 04 D8 ff f2 f5
			15 01 00 00 00 00 02 00 C0
			15 01 00 00 00 00 02 D7 01
			15 01 00 00 00 00 02 00 00
			#endif
			//huyan end
			//CE start
			#if 0
			15 01 00 00 00 00 02 00 A0
			39 01 00 00 00 00 0d D6 0f 0f 0f 0f 0f 0f 12 17 19 14 0f 0f
			15 01 00 00 00 00 02 00 B0
			39 01 00 00 00 00 0d D6 80 80 80 80 80 7a 73 6a 60 73 80 80
			15 01 00 00 00 00 02 00 C0
			39 01 00 00 00 00 0d D6 80 80 80 80 7f 78 71 66 65 78 80 80
			15 01 00 00 00 00 02 00 D0
			39 01 00 00 00 00 0d D6 80 80 80 80 74 76 6e 64 6e 7c 80 80
			#endif
			15 01 00 00 00 00 02 00 A0
			39 01 00 00 00 00 0d D6 0f 0f 0f 0f 0f 0f 0c 12 19 14 0f 0f
			15 01 00 00 00 00 02 00 B0
			39 01 00 00 00 00 0d D6 80 80 80 80 80 7a 6c 5f 5f 73 80 80
			15 01 00 00 00 00 02 00 C0
			39 01 00 00 00 00 0d D6 80 80 80 80 7f 76 66 5f 64 78 80 80
			15 01 00 00 00 00 02 00 D0
			39 01 00 00 00 00 0d D6 80 80 80 80 7c 71 63 5f 6c 7c 80 80
			//CE end
			15 01 00 00 00 00 02 00 00
			39 01 00 00 00 00 04 ff 00 00 00
			15 01 00 00 00 00 02 00 80
			39 01 00 00 00 00 03 ff 00 00
			//enable eyecare
			15 01 00 00 00 00 02 94 ff
			//enable CE
			39 01 00 00 00 00 03 91 80 00
			
		];

		qcom,mdss-dsi-panel-color-temperature-command-restore-sharp-ft8716-first = [
			15 01 00 00 00 00 02 00 00
			39 01 00 00 00 00 04 FF 87 16 01
			15 01 00 00 00 00 02 00 80
			39 01 00 00 00 00 03 FF 87 16
			//huyan config that same as init configuration.
			#if 1
			15 01 00 00 00 00 02 00 80
			39 01 00 00 00 00 0d D8 80 82 82 83 85 86 87 87 86 84 82 00
			15 01 00 00 00 00 02 00 90
			39 01 00 00 00 00 0d D8 00 00 80 81 82 82 81 80 00 01 00 00
			15 01 00 00 00 00 02 00 A0
			39 01 00 00 00 00 0d D8 01 02 03 04 06 08 0b 0f 13 17 18 1d
			15 01 00 00 00 00 02 00 B0
			39 01 00 00 00 00 0d D8 81 84 86 89 8e 93 96 99 9b 9c 9c 9f
			15 01 00 00 00 00 02 00 C0
			39 01 00 00 00 00 0d D8 84 8a 8e 92 9b a5 ad b3 b9 bc b9 bb
			15 01 00 00 00 00 02 00 D0
			39 01 00 00 00 00 0d D8 02 04 05 06 08 0c 10 14 19 1c 1a 1c
			15 01 00 00 00 00 02 00 E0
			39 01 00 00 00 00 04 D8 ff f2 f5
			15 01 00 00 00 00 02 00 C0
			15 01 00 00 00 00 02 D7 01
			15 01 00 00 00 00 02 00 00
			#endif
			//huyan end
			//CE start
			15 01 00 00 00 00 02 00 A0 
			39 01 00 00 00 00 0d D6 0f 13 0f 0f 0f 0f 0f 0f 0f 0f 0f 0f 
			15 01 00 00 00 00 02 00 B0 
			39 01 00 00 00 00 0d D6 80 7c 80 80 80 80 80 80 80 80 80 80 
			15 01 00 00 00 00 02 00 C0 
			39 01 00 00 00 00 0d D6 7f 7d 80 80 80 80 80 80 80 80 80 80 
			15 01 00 00 00 00 02 00 D0 
			39 01 00 00 00 00 0d D6 7d 7f 80 80 80 80 80 80 80 80 80 80
			//CE END
			15 01 00 00 00 00 02 00 00
			39 01 00 00 00 00 04 ff 00 00 00
			15 01 00 00 00 00 02 00 80
			39 01 00 00 00 00 03 ff 00 00
			//disable eyecare
			15 01 00 00 00 00 02 94 00
			//enable CE
			39 01 00 00 00 00 03 91 80 00
		];


		qcom,mdss-dsi-panel-color-temperature-command = [
			15 01 00 00 00 00 02 00 00
			39 01 00 00 00 00 04 FF 87 16 01
			15 01 00 00 00 00 02 00 80
			39 01 00 00 00 00 03 FF 87 16
			//CE start
			#if 0
			15 01 00 00 00 00 02 00 A0
			39 01 00 00 00 00 0d D6 0f 0f 0f 0f 0f 0f 12 17 19 14 0f 0f
			15 01 00 00 00 00 02 00 B0
			39 01 00 00 00 00 0d D6 80 80 80 80 80 7a 73 6a 60 73 80 80
			15 01 00 00 00 00 02 00 C0
			39 01 00 00 00 00 0d D6 80 80 80 80 7f 78 71 66 65 78 80 80
			15 01 00 00 00 00 02 00 D0
			39 01 00 00 00 00 0d D6 80 80 80 80 74 76 6e 64 6e 7c 80 80
			#endif
			15 01 00 00 00 00 02 00 A0
			39 01 00 00 00 00 0d D6 0f 0f 0f 0f 0f 0f 0c 12 19 14 0f 0f
			15 01 00 00 00 00 02 00 B0
			39 01 00 00 00 00 0d D6 80 80 80 80 80 7a 6c 5f 5f 73 80 80
			15 01 00 00 00 00 02 00 C0
			39 01 00 00 00 00 0d D6 80 80 80 80 7f 76 66 5f 64 78 80 80
			15 01 00 00 00 00 02 00 D0
			39 01 00 00 00 00 0d D6 80 80 80 80 7c 71 63 5f 6c 7c 80 80
			//CE END
			15 01 00 00 00 00 02 00 00
			39 01 00 00 00 00 04 ff 00 00 00
			15 01 00 00 00 00 02 00 80
			39 01 00 00 00 00 03 ff 00 00
			//enable eyecare
			15 01 00 00 01 00 02 94 c1
			15 01 00 00 01 00 02 94 c7
			15 01 00 00 01 00 02 94 cd
			15 01 00 00 01 00 02 94 d3
			15 01 00 00 01 00 02 94 d9
			15 01 00 00 01 00 02 94 df
			15 01 00 00 01 00 02 94 e6
			15 01 00 00 01 00 02 94 ec
			15 01 00 00 01 00 02 94 f2
			15 01 00 00 01 00 02 94 f5
			15 01 00 00 01 00 02 94 f8
			15 01 00 00 01 00 02 94 fb
			15 01 00 00 01 00 02 94 fd
			15 01 00 00 01 00 02 94 ff
			//enable CE
			39 01 00 00 00 00 03 91 80 00
		];

		qcom,mdss-dsi-panel-color-temperature-command-restore = [
			15 01 00 00 00 00 02 00 00
			39 01 00 00 00 00 04 FF 87 16 01
			15 01 00 00 00 00 02 00 80
			39 01 00 00 00 00 03 FF 87 16
			//CE start
			15 01 00 00 00 00 02 00 A0 
			39 01 00 00 00 00 0d D6 0f 13 0f 0f 0f 0f 0f 0f 0f 0f 0f 0f 
			15 01 00 00 00 00 02 00 B0 
			39 01 00 00 00 00 0d D6 80 7c 80 80 80 80 80 80 80 80 80 80 
			15 01 00 00 00 00 02 00 C0 
			39 01 00 00 00 00 0d D6 7f 7d 80 80 80 80 80 80 80 80 80 80 
			15 01 00 00 00 00 02 00 D0 
			39 01 00 00 00 00 0d D6 7d 7f 80 80 80 80 80 80 80 80 80 80
			//CE END
			15 01 00 00 00 00 02 00 00
			39 01 00 00 00 00 04 ff 00 00 00
			15 01 00 00 00 00 02 00 80
			39 01 00 00 00 00 03 ff 00 00
			//disable eyecare
			15 01 00 00 01 00 02 94 ff
			15 01 00 00 01 00 02 94 fb
			15 01 00 00 01 00 02 94 f8
			15 01 00 00 01 00 02 94 f5
			15 01 00 00 01 00 02 94 f2
			15 01 00 00 01 00 02 94 ef
			15 01 00 00 01 00 02 94 ec
			15 01 00 00 01 00 02 94 e9
			15 01 00 00 01 00 02 94 e6
			15 01 00 00 01 00 02 94 df
			15 01 00 00 01 00 02 94 d9
			15 01 00 00 01 00 02 94 d3
			15 01 00 00 01 00 02 94 cd
			15 01 00 00 01 00 02 94 c7
			15 01 00 00 01 00 02 94 c1
			15 01 00 00 01 00 02 94 00
			//enable CE
			39 01 00 00 00 00 03 91 80 00
		];

		qcom,mdss-dsi-panel-cabc-moving-mode-sharp-ft8716 = [
			15 01 00 00 00 00 02 00 00
			39 01 00 00 00 00 04 FF 87 16 01
			15 01 00 00 00 00 02 00 80
			39 01 00 00 00 00 03 FF 87 16
			//gamma 2.2
			15 01 00 00 00 00 02 00 00
			39 01 00 00 00 00 19 E1 04 10 27 3b 46 53 66 74 7a 83 8b 94 64 5d 5a 54 47 3c 2e 25 1c 0f 04 03
			15 01 00 00 00 00 02 00 00
			39 01 00 00 00 00 19 E2 04 10 27 3b 46 53 66 74 7a 83 8b 94 64 5d 5a 54 47 3c 2e 25 1c 0f 04 03
			//gamma 2.2 end
			//dfps setting start
			/* 15 01 00 00 00 00 02 00 84 */
			/* 15 01 00 00 00 00 02 A5 00 */
			//dfps setting end
			//cabc
			15 01 00 00 00 00 02 00 80
			39 01 00 00 00 00 0b CA 80 e5 ff cc ff 94 ff 00 00 00
			15 01 00 00 00 00 02 00 00
			15 01 00 00 00 00 02 C6 10 //CABC G 1
			15 01 00 00 00 00 02 00 00
			39 01 00 00 00 00 13 C7 90 9a 8b ab c9 8a 9a b9 aa ba ba 98 88 78 56 34 22 12
			15 01 00 00 00 00 02 00 00
			15 01 00 00 00 00 02 C6 11 //CABC G 2
			15 01 00 00 00 00 02 00 00
			39 01 00 00 00 00 13 C7 90 9a 9a 9a ba 8a 9a a9 aa b9 ba 88 89 88 67 34 22 22
			15 01 00 00 00 00 02 00 00
			15 01 00 00 00 00 02 C6 12 //CABC G 3
			15 01 00 00 00 00 02 00 00
			39 01 00 00 00 00 13 C7 90 9a 8a 9a c9 99 99 99 aa 9a ab 89 88 88 67 45 33 22
			15 01 00 00 00 00 02 00 00
			15 01 00 00 00 00 02 C6 13 //CABC G 4
			15 01 00 00 00 00 02 00 00
			39 01 00 00 00 00 13 C7 80 9a 8a 9a b9 99 99 99 b9 a8 aa 7a 88 88 78 45 33 33
			15 01 00 00 00 00 02 00 00
			15 01 00 00 00 00 02 C6 14 //CABC G 5
			15 01 00 00 00 00 02 00 00
			39 01 00 00 00 00 13 C7 80 9a 8a 99 a9 99 89 9a a9 99 aa 7a 88 88 78 56 34 33
			15 01 00 00 00 00 02 00 00
			15 01 00 00 00 00 02 C6 15 //CABC G 6
			15 01 00 00 00 00 02 00 00
			39 01 00 00 00 00 13 C7 80 99 8a 99 a9 99 98 99 a9 98 b9 89 88 88 78 56 44 44
			15 01 00 00 00 00 02 00 00
			15 01 00 00 00 00 02 C6 16 //CABC G 7
			15 01 00 00 00 00 02 00 00
			39 01 00 00 00 00 13 C7 80 99 99 89 a9 89 99 98 99 99 a9 99 87 88 88 67 44 44
			15 01 00 00 00 00 02 00 00
			15 01 00 00 00 00 02 C6 17 //CABC G 8
			15 01 00 00 00 00 02 00 00
			39 01 00 00 00 00 13 C7 80 89 99 89 a9 89 89 89 a9 89 a9 89 88 88 88 67 55 44
			15 01 00 00 00 00 02 00 00
			15 01 00 00 00 00 02 C6 18 //CABC G 9
			15 01 00 00 00 00 02 00 00
			39 01 00 00 00 00 13 C7 80 89 99 89 a8 89 98 98 a8 88 a9 99 87 88 88 68 55 55
			15 01 00 00 00 00 02 00 00
			15 01 00 00 00 00 02 C6 19 //CABC G 10
			15 01 00 00 00 00 02 00 00
			39 01 00 00 00 00 13 C7 80 98 89 89 99 89 88 89 99 98 98 8a 88 88 88 78 56 55
			15 01 00 00 00 00 02 00 00
			15 01 00 00 00 00 02 C6 1a //CABC G 11
			15 01 00 00 00 00 02 00 00
			39 01 00 00 00 00 13 C7 80 98 98 89 98 89 88 98 a8 88 99 89 88 88 88 78 66 56
			15 01 00 00 00 00 02 00 00
			15 01 00 00 00 00 02 C6 1b //CABC G 12
			15 01 00 00 00 00 02 00 00
			39 01 00 00 00 00 13 C7 80 88 89 89 98 98 88 98 98 88 99 98 88 88 88 88 66 66
			15 01 00 00 00 00 02 00 00
			15 01 00 00 00 00 02 C6 1c //CABC G 13
			15 01 00 00 00 00 02 00 00
			39 01 00 00 00 00 13 C7 80 88 89 88 98 98 88 98 88 89 98 98 87 88 88 88 77 67
			15 01 00 00 00 00 02 00 00
			15 01 00 00 00 00 02 C6 1d //CABC G 14
			15 01 00 00 00 00 02 00 00
			39 01 00 00 00 00 13 C7 80 88 88 89 88 89 88 88 98 88 98 98 88 88 88 88 77 77
			15 01 00 00 00 00 02 00 00
			15 01 00 00 00 00 02 C6 1e //CABC G 15
			15 01 00 00 00 00 02 00 00
			39 01 00 00 00 00 13 C7 80 88 88 88 98 88 88 98 88 88 98 88 88 88 88 88 88 77
			15 01 00 00 00 00 02 00 00
			15 01 00 00 00 00 02 C6 1f //CABC G 16
			15 01 00 00 00 00 02 00 00
			39 01 00 00 00 00 13 C7 80 88 88 88 88 88 88 88 89 97 88 88 88 88 88 88 88 88
			15 01 00 00 00 00 02 00 00
			15 01 00 00 00 00 02 C6 00
			15 01 00 00 00 00 02 55 03
			//cabc end
			//CE start//
			15 01 00 00 00 00 02 00 A0 
			39 01 00 00 00 00 0d D6 0f 13 0f 0f 0f 0f 0f 0f 0f 0f 0f 0f 
			15 01 00 00 00 00 02 00 B0 
			39 01 00 00 00 00 0d D6 80 7c 80 80 80 80 80 80 80 80 80 80 
			15 01 00 00 00 00 02 00 C0 
			39 01 00 00 00 00 0d D6 7f 7d 80 80 80 80 80 80 80 80 80 80 
			15 01 00 00 00 00 02 00 D0 
			39 01 00 00 00 00 0d D6 7d 7f 80 80 80 80 80 80 80 80 80 80
			//CE end
			15 01 00 00 00 00 02 00 00
			39 01 00 00 00 00 04 ff 00 00 00
			15 01 00 00 00 00 02 00 80
			39 01 00 00 00 00 03 ff 00 00
			//enable CE
			39 01 00 00 00 00 03 91 80 00
		];
		
		qcom,mdss-dsi-panel-sre-weak-level = [
			15 01 00 00 00 00 02 92 80
		];

		qcom,mdss-dsi-panel-sre-middle-level = [
			15 01 00 00 00 00 02 92 81
		];

		qcom,mdss-dsi-panel-sre-strong-level = [
			15 01 00 00 00 00 02 92 82
		];

		qcom,mdss-dsi-panel-sre-exit = [
			15 01 00 00 00 00 02 92 00
		];

		qcom,mdss-dsi-on-command = [
			15 01 00 00 00 00 02 00 00
			39 01 00 00 00 00 04 FF 87 16 01
			15 01 00 00 00 00 02 00 80
			39 01 00 00 00 00 03 FF 87 16
			//dfps setting start
			/* 15 01 00 00 00 00 02 00 84 */
			/* 15 01 00 00 00 00 02 A5 00 */
			//dfps setting end
			//gamma 2.2
			15 01 00 00 00 00 02 00 00
			39 01 00 00 00 00 19 E1 04 10 27 3b 46 53 66 74 7a 83 8b 94 64 5d 5a 54 47 3c 2e 25 1c 0f 04 03
			15 01 00 00 00 00 02 00 00
			39 01 00 00 00 00 19 E2 04 10 27 3b 46 53 66 74 7a 83 8b 94 64 5d 5a 54 47 3c 2e 25 1c 0f 04 03
			//gamma 2.2 end
			//cabc start
			15 01 00 00 00 00 02 00 80
			39 01 00 00 00 00 0b CA 80 e5 ff cc ff 94 ff 00 00 00
			15 01 00 00 00 00 02 00 00
			15 01 00 00 00 00 02 C6 10 //CABC G 1
			15 01 00 00 00 00 02 00 00
			39 01 00 00 00 00 13 C7 90 9a 8b ab c9 8a 9a b9 aa ba ba 98 88 78 56 34 22 12
			15 01 00 00 00 00 02 00 00
			15 01 00 00 00 00 02 C6 11 //CABC G 2
			15 01 00 00 00 00 02 00 00
			39 01 00 00 00 00 13 C7 90 9a 9a 9a ba 8a 9a a9 aa b9 ba 88 89 88 67 34 22 22
			15 01 00 00 00 00 02 00 00
			15 01 00 00 00 00 02 C6 12 //CABC G 3
			15 01 00 00 00 00 02 00 00
			39 01 00 00 00 00 13 C7 90 9a 8a 9a c9 99 99 99 aa 9a ab 89 88 88 67 45 33 22
			15 01 00 00 00 00 02 00 00
			15 01 00 00 00 00 02 C6 13 //CABC G 4
			15 01 00 00 00 00 02 00 00
			39 01 00 00 00 00 13 C7 80 9a 8a 9a b9 99 99 99 b9 a8 aa 7a 88 88 78 45 33 33
			15 01 00 00 00 00 02 00 00
			15 01 00 00 00 00 02 C6 14 //CABC G 5
			15 01 00 00 00 00 02 00 00
			39 01 00 00 00 00 13 C7 80 9a 8a 99 a9 99 89 9a a9 99 aa 7a 88 88 78 56 34 33
			15 01 00 00 00 00 02 00 00
			15 01 00 00 00 00 02 C6 15 //CABC G 6
			15 01 00 00 00 00 02 00 00
			39 01 00 00 00 00 13 C7 80 99 8a 99 a9 99 98 99 a9 98 b9 89 88 88 78 56 44 44
			15 01 00 00 00 00 02 00 00
			15 01 00 00 00 00 02 C6 16 //CABC G 7
			15 01 00 00 00 00 02 00 00
			39 01 00 00 00 00 13 C7 80 99 99 89 a9 89 99 98 99 99 a9 99 87 88 88 67 44 44
			15 01 00 00 00 00 02 00 00
			15 01 00 00 00 00 02 C6 17 //CABC G 8
			15 01 00 00 00 00 02 00 00
			39 01 00 00 00 00 13 C7 80 89 99 89 a9 89 89 89 a9 89 a9 89 88 88 88 67 55 44
			15 01 00 00 00 00 02 00 00
			15 01 00 00 00 00 02 C6 18 //CABC G 9
			15 01 00 00 00 00 02 00 00
			39 01 00 00 00 00 13 C7 80 89 99 89 a8 89 98 98 a8 88 a9 99 87 88 88 68 55 55
			15 01 00 00 00 00 02 00 00
			15 01 00 00 00 00 02 C6 19 //CABC G 10
			15 01 00 00 00 00 02 00 00
			39 01 00 00 00 00 13 C7 80 98 89 89 99 89 88 89 99 98 98 8a 88 88 88 78 56 55
			15 01 00 00 00 00 02 00 00
			15 01 00 00 00 00 02 C6 1a //CABC G 11
			15 01 00 00 00 00 02 00 00
			39 01 00 00 00 00 13 C7 80 98 98 89 98 89 88 98 a8 88 99 89 88 88 88 78 66 56
			15 01 00 00 00 00 02 00 00
			15 01 00 00 00 00 02 C6 1b //CABC G 12
			15 01 00 00 00 00 02 00 00
			39 01 00 00 00 00 13 C7 80 88 89 89 98 98 88 98 98 88 99 98 88 88 88 88 66 66
			15 01 00 00 00 00 02 00 00
			15 01 00 00 00 00 02 C6 1c //CABC G 13
			15 01 00 00 00 00 02 00 00
			39 01 00 00 00 00 13 C7 80 88 89 88 98 98 88 98 88 89 98 98 87 88 88 88 77 67
			15 01 00 00 00 00 02 00 00
			15 01 00 00 00 00 02 C6 1d //CABC G 14
			15 01 00 00 00 00 02 00 00
			39 01 00 00 00 00 13 C7 80 88 88 89 88 89 88 88 98 88 98 98 88 88 88 88 77 77
			15 01 00 00 00 00 02 00 00
			15 01 00 00 00 00 02 C6 1e //CABC G 15
			15 01 00 00 00 00 02 00 00
			39 01 00 00 00 00 13 C7 80 88 88 88 98 88 88 98 88 88 98 88 88 88 88 88 88 77
			15 01 00 00 00 00 02 00 00
			15 01 00 00 00 00 02 C6 1f //CABC G 16
			15 01 00 00 00 00 02 00 00
			39 01 00 00 00 00 13 C7 80 88 88 88 88 88 88 88 89 97 88 88 88 88 88 88 88 88
			15 01 00 00 00 00 02 00 00
			15 01 00 00 00 00 02 C6 00 
			//cabc end
			//sre start
			15 01 00 00 00 00 02 00 01
			15 01 00 00 00 00 02 C6 10
			15 01 00 00 00 00 02 00 00
			39 01 00 00 00 00 13 c8 90 78 56 34 33 33 33 33 33 33 43 44 43 44 44 44 44 54
			15 01 00 00 00 00 02 00 01
			15 01 00 00 00 00 02 C6 11
			15 01 00 00 00 00 02 00 00
			39 01 00 00 00 00 13 c8 c0 8a 57 34 33 33 33 33 33 33 33 33 33 33 44 44 44 44 
			15 01 00 00 00 00 02 00 01
			15 01 00 00 00 00 02 C6 12
			15 01 00 00 00 00 02 00 00
			39 01 00 00 00 00 13 c8 f0 9d 57 33 33 33 33 33 33 33 23 32 23 22 44 44 44 34
			39 01 00 00 00 00 02 00 01
			39 01 00 00 00 00 02 c6 00
			//sre end
			//eye care
			15 01 00 00 00 00 02 00 80
			39 01 00 00 00 00 0d D8 80 82 82 83 85 86 87 87 86 84 82 00
			15 01 00 00 00 00 02 00 90
			39 01 00 00 00 00 0d D8 00 00 80 81 82 82 81 80 00 01 00 00
			15 01 00 00 00 00 02 00 A0
			39 01 00 00 00 00 0d D8 01 02 03 04 06 08 0b 0f 13 17 18 1d
			15 01 00 00 00 00 02 00 B0
			39 01 00 00 00 00 0d D8 81 84 86 89 8e 93 96 99 9b 9c 9c 9f
			15 01 00 00 00 00 02 00 C0
			39 01 00 00 00 00 0d D8 84 8a 8e 92 9b a5 ad b3 b9 bc b9 bb
			15 01 00 00 00 00 02 00 D0
			39 01 00 00 00 00 0d D8 02 04 05 06 08 0c 10 14 19 1c 1a 1c
			15 01 00 00 00 00 02 00 E0
			39 01 00 00 00 00 04 D8 ff f2 f5
			15 01 00 00 00 00 02 00 C0
			15 01 00 00 00 00 02 D7 01
			15 01 00 00 00 00 02 00 00
			//eye care end
			//CE start//
			15 01 00 00 00 00 02 00 A0 
			39 01 00 00 00 00 0d D6 0f 13 0f 0f 0f 0f 0f 0f 0f 0f 0f 0f 
			15 01 00 00 00 00 02 00 B0 
			39 01 00 00 00 00 0d D6 80 7c 80 80 80 80 80 80 80 80 80 80 
			15 01 00 00 00 00 02 00 C0 
			39 01 00 00 00 00 0d D6 7f 7d 80 80 80 80 80 80 80 80 80 80 
			15 01 00 00 00 00 02 00 D0 
			39 01 00 00 00 00 0d D6 7d 7f 80 80 80 80 80 80 80 80 80 80
			//CE end
			15 01 00 00 00 00 02 00 00
			39 01 00 00 00 00 04 ff 00 00 00
			15 01 00 00 00 00 02 00 80
			39 01 00 00 00 00 03 ff 00 00
			39 01 00 00 00 00 03 91 80 00
			15 01 00 00 00 00 02 51 FF
			15 01 00 00 00 00 02 53 2c
			15 01 00 00 00 00 02 55 03
			05 01 00 00 80 00 02 11 00
			05 01 00 00 20 00 02 29 00];
		qcom,mdss-dsi-off-command = [05 01 00 00 32 00 02 28 00
					05 01 00 00 78 00 02 10 00];
		qcom,mdss-dsi-on-command-state = "dsi_lp_mode";
		qcom,mdss-dsi-off-command-state = "dsi_hs_mode";
		qcom,mdss-dsi-h-sync-pulse = <1>;
		qcom,mdss-dsi-traffic-mode = "burst_mode";
		//qcom,mdss-dsi-lane-map = "lane_map_0123";
		qcom,mdss-dsi-bllp-eof-power-mode;
		qcom,mdss-dsi-bllp-power-mode;
		qcom,mdss-dsi-lane-0-state;
		qcom,mdss-dsi-lane-1-state;
		qcom,mdss-dsi-lane-2-state;
		qcom,mdss-dsi-lane-3-state;
		qcom,mdss-dsi-panel-timings = [bf 38 26 01 68 6e 2a 3c 2c 03 04 00];
		qcom,mdss-dsi-t-clk-post = <0x0d>;
		qcom,mdss-dsi-t-clk-pre = <0x30>;
		qcom,mdss-dsi-bl-min-level = <1>;
		qcom,mdss-dsi-bl-max-level = <4095>;
		qcom,mdss-dsi-dma-trigger = "trigger_sw";
		qcom,mdss-dsi-mdp-trigger = "none";
		qcom,mdss-dsi-bl-pmic-control-type = "bl_ctrl_wled";
		qcom,mdss-dsi-reset-sequence = <1 2>, <0 2>, <1 3>;
		qcom,mdss-pan-physical-width-dimension = <68>;
		qcom,mdss-pan-physical-height-dimension = <121>;
		//qcom,mdss-dsi-tx-eot-append;
		//qcom,mdss-dsi-post-init-delay = <1>;
	};
};
