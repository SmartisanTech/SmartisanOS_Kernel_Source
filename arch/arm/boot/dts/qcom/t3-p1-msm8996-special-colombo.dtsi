#include "t3-p1-msm8996-pinctrl-surabaya.dtsi"
#include "t3-p1-msm8996-mtp-surabaya.dtsi"
#include "t3-p1-msm8996-regulator-surabaya.dtsi"
#include "t3-p1-msm-pm8994-surabaya.dtsi"
#include "t3-p1-msm-pmi8994-surabaya.dtsi"
#include "t3-p1-msm8996-goodix.dtsi"
#include "t3-p1-msm8996-nfc-colombo-nxp.dtsi"
#include "t3-p1-msm8996-pinctrl-colombo-special.dtsi"
#include "t3-p1-msm8996-fpc.dtsi"
#include "t3-p1-msm8996-camera.dtsi"
#include "t3-p1-msm8996-key.dtsi"
#include "t3-p1-msm8996-battery-colombo.dtsi"
#include "t3-p1-msm8996-mdss-panels-colombo.dtsi"
#include "t3-p1-msm8996-haptics.dtsi"
#include "t3-p1-msm8996-thermal.dtsi"
#include "t3-p1-msm8996-pinctrl-hifi-colombo-cs.dtsi"
#include "t3-p1-msm8996-hifi-colombo-cs.dtsi"
