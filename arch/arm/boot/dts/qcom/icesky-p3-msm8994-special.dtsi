/* Copyright (c) 2014-2015, The Linux Foundation. All rights reserved.
 *
 * This program is free software; you can redistribute it and/or modify
 * it under the terms of the GNU General Public License version 2 and
 * only version 2 as published by the Free Software Foundation.
 *
 * This program is distributed in the hope that it will be useful,
 * but WITHOUT ANY WARRANTY; without even the implied warranty of
 * MERCHANTABILITY or FITNESS FOR A PARTICULAR PURPOSE.  See the
 * GNU General Public License for more details.
 */

#include "icesky-p1-msm8994-pinctrl.dtsi"
#include "icesky-p2-msm8994-pm8994-key.dtsi"
#include "icesky-p1-msm8994-t2.dtsi"
#include "icesky-p2-msm8994-wifi.dtsi"
#include "icesky-p1-msm8992-nfc-brcm.dtsi"
#include "icesky-p3-haptics.dtsi"
#include "icesky-p2-msm8994-battery.dtsi"
#include "icesky-p1-msm8994-camera-sensor.dtsi"
#include "icesky-msm8994-memory.dtsi"
