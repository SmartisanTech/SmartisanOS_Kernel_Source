/* Copyright (c) 2015-2016, The Linux Foundation. All rights reserved.
 *
 * This program is free software; you can redistribute it and/or modify
 * it under the terms of the GNU General Public License version 2 and
 * only version 2 as published by the Free Software Foundation.
 *
 * This program is distributed in the hope that it will be useful,
 * but WITHOUT ANY WARRANTY; without even the implied warranty of
 * MERCHANTABILITY or FITNESS FOR A PARTICULAR PURPOSE.  See the
 * GNU General Public License for more details.
 */

qcom,qrd_msm8937_sku1_2920mah {
	/* #QRD8937_2800mAh_China_data_averaged_MasterSlave_Oct30th2015*/
	qcom,max-voltage-uv = <4400000>;
	qcom,nom-batt-capacity-mah = <2800>;
	qcom,batt-id-kohm = <10>;
	qcom,cool-fastchg-current-comp = <700>;
	qcom,thermal-coefficients = [C2 86 BB 50 CF 37];
	qcom,battery-beta = <3435>;
	qcom,battery-type = "qrd_msm8937_sku1_2800mah";
	qcom,fg-cc-cv-threshold-mv = <4390>;
	qcom,chg-rslow-comp-c1 = <3008181>;
	qcom,chg-rslow-comp-c2 = <4489063>;
	qcom,chg-rs-to-rslow = <856955>;
	qcom,chg-rslow-comp-thr = <0xA9>;
	qcom,checksum = <0x613B>;
	qcom,gui-version = "PMI8950GUI - 2.0.0.14";
	qcom,fg-profile-data = [
		 F1 83 79 7D
		 A1 81 25 7C
		 5E 83 44 6C
		 64 83 E0 8D
		 41 82 B0 99
		 EC BC C6 C9
		 5A 0E 06 88
		 11 7E 07 82
		 85 7C 56 83
		 A7 68 8F 7A
		 6A 87 57 82
		 88 99 DD BC
		 C7 C9 5A 0D
		 53 10 D0 58
		 14 70 DA FC
		 8F 3E 96 3F
		 8E 3A 00 00
		 61 45 68 2A
		 FE 1A 00 00
		 00 00 00 00
		 00 00 00 00
		 C3 6B A5 6A
		 D4 72 48 89
		 A7 6F AA 68
		 1F 5A 5F 7B
		 4E 6D EC 61
		 65 74 0E A1
		 1A 3C 63 34
		 65 A0 71 0C
		 28 00 FF 36
		 F0 11 30 03
		 00 00 00 0C
	];
};
