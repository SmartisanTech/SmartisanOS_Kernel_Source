/* Copyright (c) 2013, The Linux Foundation. All rights reserved.
 *
 * This program is free software; you can redistribute it and/or modify
 * it under the terms of the GNU General Public License version 2 and
 * only version 2 as published by the Free Software Foundation.
 *
 * This program is distributed in the hope that it will be useful,
 * but WITHOUT ANY WARRANTY; without even the implied warranty of
 * MERCHANTABILITY or FITNESS FOR A PARTICULAR PURPOSE.  See the
 * GNU General Public License for more details.
 */

/*---------------------------------------------------------------------------
 * This file is autogenerated file using gcdb parser. Please do not edit it.
 * Update input XML file to add a new entry or update variable in this file
 * VERSION = "1.0"
 *---------------------------------------------------------------------------*/
&mdss_mdp {
	dsi_r63452_1080p_cmd: qcom,mdss_dsi_r63452_1080p_cmd {
		qcom,mdss-dsi-panel-name = "jdi r63452 command mode dsi panel";
		qcom,mdss-dsi-panel-controller = <&mdss_dsi0>;
		qcom,mdss-dsi-panel-type = "dsi_cmd_mode";
		qcom,mdss-dsi-panel-destination = "display_1";
		qcom,mdss-dsi-panel-framerate = <57>;
		qcom,mdss-dsi-virtual-channel-id = <0>;
		qcom,mdss-dsi-stream = <0>;
		qcom,mdss-dsi-panel-width = <1080>;
		qcom,mdss-dsi-panel-height = <1920>;
		qcom,mdss-dsi-h-front-porch = <100>;
		qcom,mdss-dsi-h-back-porch = <30>;
		qcom,mdss-dsi-h-pulse-width = <20>;
		qcom,mdss-dsi-h-sync-skew = <0>;
		qcom,mdss-dsi-v-back-porch = <6>;
		qcom,mdss-dsi-v-front-porch = <6>;
		qcom,mdss-dsi-v-pulse-width = <1>;
		qcom,mdss-dsi-h-left-border = <0>;
		qcom,mdss-dsi-h-right-border = <0>;
		qcom,mdss-dsi-v-top-border = <0>;
		qcom,mdss-dsi-v-bottom-border = <0>;
		qcom,mdss-dsi-bpp = <24>;
		qcom,mdss-dsi-panel-clockrate = <813120000>;
		qcom,mdss-dsi-color-order = "rgb_swap_rgb";
		qcom,mdss-dsi-underflow-color = <0xff>;
		qcom,mdss-dsi-border-color = <0>;
		qcom,mdss-dsi-pixel-packing = "tight";
		qcom,mdss-dsi-pixel-alignment = <0>;
		qcom,mdss-mdp-transfer-time-us = <12500>;
		qcom,mdss-dsi-panel-color-temperature-command0 = [
			29 01 00 00 00 00 02 B0 00
			29 01 00 00 00 00 02 84 00
			29 01 00 00 00 00 32 C8 01 00 0A 03 03 B8 00 00 09 02 FF BD 00 00 0B FC F6 FC 00 00 0A 03 03 B8 00 09 02 FF BD 00 0B FC F6 FC 00 0A 03 03 B8 00 09 02 FF BD 00 0B FC F6 FC
			29 01 00 00 00 00 02 B0 03
			];
		qcom,mdss-dsi-panel-color-temperature-command1 = [
			29 01 00 00 00 00 02 B0 00
			29 01 00 00 00 00 02 84 00
			29 01 00 00 00 00 32 C8 01 00 0B 02 03 CD 00 00 0A 01 FF CB 00 00 0B FC F6 FC 00 00 0B 02 03 CD 00 0A 01 FF CB 00 0B FC F6 FC 00 0B 02 03 CD 00 0A 01 FF CB 00 0B FC F6 FC
			29 01 00 00 00 00 02 B0 03
			];
		qcom,mdss-dsi-panel-color-temperature-command2 = [
			29 01 00 00 00 00 02 B0 00
			29 01 00 00 00 00 02 84 00
			29 01 00 00 00 00 32 C8 01 00 0C 02 04 E9 00 00 09 01 FF DF 00 00 0B FC F6 FC 00 00 0C 02 04 E9 00 09 01 FF DF 00 0B FC F6 FC 00 0C 02 04 E9 00 09 01 FF DF 00 0B FC F6 FC
			29 01 00 00 00 00 02 B0 03
			];
		qcom,mdss-dsi-panel-color-temperature-command3 = [
			29 01 00 00 00 00 02 B0 00
			29 01 00 00 00 00 02 84 00
			29 01 00 00 00 00 32 C8 01 00 0B 02 06 FC 00 00 0A 01 FF ED 00 00 0B FC F6 FC 00 00 0C 02 07 FA 00 09 01 FF EE 00 0B FC F6 FC 00 0C 02 07 FA 00 09 01 FF EE 00 0B FC F6 FC
			29 01 00 00 00 00 02 B0 03
			];
		qcom,mdss-dsi-panel-color-temperature-command4 = [
			29 01 00 00 00 00 02 B0 00
			29 01 00 00 00 00 02 84 00
			29 01 00 00 00 00 32 C8 01 00 0B 02 06 FC 00 00 09 01 FF DD 00 00 0B FE F9 D5 00 00 0B 02 06 FC 00 09 01 FF DD 00 0B FE F9 D5 00 0B 02 06 FC 00 09 01 FF DD 00 0B FE F9 D5
			29 01 00 00 00 00 02 B0 03
			];
		qcom,mdss-dsi-panel-color-temperature-command5 = [
			29 01 00 00 00 00 02 B0 00
			29 01 00 00 00 00 02 84 00
			29 01 00 00 00 00 32 C8 01 00 0B 02 06 FC 00 00 09 01 FF D2 00 00 09 01 FA B4 00 00 0B 02 06 FC 00 09 01 FF D2 00 09 01 FA B4 00 0B 02 06 FC 00 09 01 FF D2 00 09 01 FA B4
			29 01 00 00 00 00 02 B0 03
			];
		qcom,mdss-dsi-panel-color-temperature-command6 = [
			29 01 00 00 00 00 02 B0 00
			29 01 00 00 00 00 02 84 00
			29 01 00 00 00 00 32 C8 01 00 0B 02 06 FC 00 00 09 02 FF B7 00 00 08 03 F7 73 00 00 0B 02 06 FC 00 09 02 FF B7 00 08 03 F7 73 00 0B 02 06 FC 00 09 02 FF B7 00 08 03 F7 73
			29 01 00 00 00 00 02 B0 03
			];
		qcom,mdss-dsi-panel-color-temperature-command7 = [
			29 01 00 00 00 00 02 B0 00
			29 01 00 00 00 00 02 84 00
			29 01 00 00 00 00 32 C8 01 00 0B 02 06 FC 00 00 09 02 FF AB 00 00 08 03 F6 58 00 00 0B 02 06 FC 00 09 02 FF AB 00 08 03 F6 58 00 0B 02 06 FC 00 09 02 FF AB 00 08 03 F6 58
			29 01 00 00 00 00 02 B0 03
			];
		qcom,mdss-dsi-panel-color-temperature-command8 = [
			29 01 00 00 00 00 02 B0 00
			29 01 00 00 00 00 02 84 00
			29 01 00 00 00 00 32 C8 01 00 0B 02 06 FC 00 00 08 02 FC 9F 00 00 07 03 F5 30 00 00 0B 02 06 FC 00 08 02 FC 9F 00 07 03 F5 30 00 0B 02 06 FC 00 08 02 FC 9F 00 07 03 F5 30
			29 01 00 00 00 00 02 B0 03
			];
		qcom,mdss-dsi-panel-color-temperature-command9 = [
			29 01 00 00 00 00 02 B0 00
			29 01 00 00 00 00 02 84 00
			29 01 00 00 00 00 32 C8 01 00 0B 02 06 FC 00 00 08 02 FA 91 00 00 04 04 F2 01 00 00 0B 02 06 FC 00 08 02 FA 90 00 04 04 F2 00 00 0B 02 06 FC 00 08 02 FA 90 00 04 04 F2 00
			29 01 00 00 00 00 02 B0 03
			];
		qcom,mdss-dsi-panel-color-temperature-command11 = [
			29 01 00 00 00 00 02 B0 00
			29 01 00 00 00 00 02 84 00
			29 01 00 00 00 00 32 C8 01 00 0A 01 04 FC 00 00 07 02 FB 7F 00 00 05 03 F2 00 00 00 0A 01 04 FC 00 07 02 FB 7F 00 05 03 F2 00 00 0A 01 04 FC 00 07 02 FB 7F 00 05 03 F2 00
			29 01 00 00 00 00 2C CA 1D FC DF B8 00 f9 ef 00 f9 ef 00 f9 ef 00 f9 ef 00 f9 ef 00 f9 ef 00 00 00 00 00 00 00 00 00 00 00 00 00 00 00 00 00 00 00 00 00
			29 01 00 00 00 00 02 B0 03
			];
		qcom,mdss-dsi-panel-color-temperature-command12 = [
			29 01 00 00 00 00 02 B0 00
			29 01 00 00 00 00 02 84 00
			29 01 00 00 00 00 32 C8 01 00 0A 01 04 FC 00 00 07 02 FB 7F 00 00 05 03 F2 00 00 00 0A 01 04 FC 00 07 02 FB 7F 00 05 03 F2 00 00 0A 01 04 FC 00 07 02 FB 7F 00 05 03 F2 00
			29 01 00 00 00 00 2C CA 1D FC CA 67 00 f4 db 00 f4 db 00 f4 db 00 f4 db 00 f4 db 00 f4 db 00 00 00 00 00 00 00 00 00 00 00 00 00 00 00 00 00 00 00 00 00
			29 01 00 00 00 00 02 B0 03
			];
		qcom,mdss-dsi-panel-color-temperature-command13 = [
			29 01 00 00 00 00 02 B0 00
			29 01 00 00 00 00 02 84 00
			29 01 00 00 00 00 32 C8 01 00 0A 01 04 FC 00 00 07 02 FB 7F 00 00 05 03 F2 00 00 00 0A 01 04 FC 00 07 02 FB 7F 00 05 03 F2 00 00 0A 01 04 FC 00 07 02 FB 7F 00 05 03 F2 00
			29 01 00 00 00 00 2C CA 1D FC 9F 20 00 e9 c9 00 e9 c9 00 e9 c9 00 e9 c9 00 e9 c9 00 e9 c9 00 00 00 00 00 00 00 00 00 00 00 00 00 00 00 00 00 00 00 00 00
			29 01 00 00 00 00 02 B0 03
			];
		qcom,mdss-dsi-panel-color-temperature-command14 = [
			29 01 00 00 00 00 02 B0 00
			29 01 00 00 00 00 02 84 00
			29 01 00 00 00 00 32 C8 01 00 01 01 FF FC 00 00 FD 01 F6 74 00 00 FE 01 F6 00 00 00 01 01 FF FC 00 FD 01 F6 74 00 FE 01 F6 00 00 01 01 FF FC 00 FD 01 F6 74 00 FE 01 F6 00
			29 01 00 00 00 00 2C CA 1d FC AE 00 00 00 00 00 00 00 00 00 00 00 00 00 00 00 00 00 00 00 00 00 00 00 00 00 00 00 00 00 00 00 00 00 00 00 00 00 00 00 00
			29 01 00 00 00 00 02 B0 03
			];
		qcom,mdss-dsi-panel-color-temperature-command_restore = [
			29 01 00 00 00 00 02 B0 00
			29 01 00 00 00 00 02 84 00
			29 01 00 00 00 00 32 C7 00 13 1D 29 39 48 51 5f 44 4C 57 62 6A 71 7F 00 13 1D 29 39 48 51 5f 44 4C 57 62 6A 71 7F 00 00 00 00 00 00 00 00 00 00 00 00 00 00 00 00 00 00 00
			29 01 00 00 00 00 2C C8 01 00 02 07 FF D7 E1 00 01 02 FC FA 01 00 02 FE EE FC 01 00 00 00 00 00 00 00 00 00 00 00 00 00 00 00 00 00 00 00 00 00 00 00 00
			29 01 00 00 00 00 2c CA 1C FC FC FC 00 00 00 00 00 00 00 00 00 00 00 00 00 00 00 00 00 00 00 00 00 00 00 00 00 00 00 00 00 00 00 00 00 00 00 00 00 00 00
			29 01 00 00 00 00 08 BA CD 51 11 00 17 00 00
			29 01 00 00 00 00 1A CE 55 40 56 6E 87 A0 B6 CF E8 E9 EA EB EC ED EE EF FF 04 00 04 04 42 00 69 5A
			29 01 00 00 00 00 0A F9 64 FF E0 BE 00 8D BF 80 00
			29 01 00 00 00 00 02 B0 03
			];
		qcom,mdss-dsi-panel-sre-weak-level = [
			29 01 00 00 00 00 02 B0 04 
			39 01 00 00 00 00 02 51 ff
			39 01 00 00 00 00 02 55 F2
			29 01 00 00 00 00 08 B9 6e F1 64 32 00 40 00
			29 01 00 00 00 00 1A CE 65 40 49 53 59 5E 63 68 6E 74 7E 8A 98 A8 BB D0 ff 04 00 04 04 42 00 69 5A
			29 01 00 00 00 00 09 F9 64 7F E0 E6 00 8D BF 80
			29 01 00 00 00 00 03 BD 14 00
			29 01 00 00 00 00 02 B0 03
			];
		qcom,mdss-dsi-panel-sre-middle-level = [
			29 01 00 00 00 00 02 B0 04 
			39 01 00 00 00 00 02 51 ff
			39 01 00 00 00 00 02 55 F2
			29 01 00 00 00 00 08 B9 6e F1 64 32 00 40 00
			29 01 00 00 00 00 1A CE 65 40 49 53 59 5E 63 68 6E 74 7E 8A 98 A8 BB D0 ff 04 00 04 04 42 00 69 5A 
			29 01 00 00 00 00 09 F9 64 7F E0 E6 00 8D BF 80
			29 01 00 00 00 00 03 BD 64 00
			29 01 00 00 00 00 02 B0 03
			];
		qcom,mdss-dsi-panel-sre-strong-level = [
			29 01 00 00 00 00 02 B0 04 	
			39 01 00 00 00 00 02 51 ff
			39 01 00 00 00 00 02 55 F2
			29 01 00 00 00 00 08 B9 6e F1 64 32 00 40 00
			29 01 00 00 00 00 1A CE 65 40 49 53 59 5E 63 68 6E 74 7E 8A 98 A8 BB D0 ff 04 00 04 04 42 00 69 5A 
			29 01 00 00 00 00 09 F9 64 7F E0 E6 00 8D BF 80
			29 01 00 00 00 00 03 BD ff 00
			29 01 00 00 00 00 02 B0 03
			];
		qcom,mdss-dsi-panel-sre-exit = [
			29 01 00 00 00 00 02 B0 04 
			39 01 00 00 00 00 02 55 83
			29 01 00 00 00 00 08 BA CD 51 11 00 17 00 00
			29 01 00 00 00 00 1A CE 55 40 56 6E 87 A0 B6 CF E8 E9 EA EB EC ED EE EF FF 04 00 04 04 42 00 69 5A 
			29 01 00 00 00 00 0A F9 64 FF E0 BE 00 8D BF 80 00
			29 01 00 00 00 00 02 B0 03
			];
		qcom,mdss-dsi-on-command = [
				39 01 00 00 00 00 02 35 00
				39 01 00 00 00 00 02 3A 77
				39 01 00 00 00 00 03 44 00 00
				39 01 00 00 00 00 02 5e 20
				29 01 00 00 00 00 02 B0 04
				29 01 00 00 00 00 02 D6 01
				39 01 00 00 00 00 02 53 2c
				39 01 00 00 00 00 02 55 83
				29 01 00 00 00 00 1f C7 00 13 1D 29 39 48 51 5f 44 4C 57 62 6A 71 7F 00 13 1D 29 39 48 51 5f 44 4C 57 62 6A 71 7F
				29 01 00 00 00 00 14 C8 01 00 02 07 FF D7 E1 00 01 02 FC FA 01 00 02 FE EE FC 01
				29 01 00 00 00 00 08 BA CD 51 11 00 17 00 00
				29 01 00 00 00 00 1A CE 55 40 56 6E 87 A0 B6 CF E8 E9 EA EB EC ED EE EF FF 04 00 04 04 42 00 69 5A
				29 01 00 00 00 00 0A F9 64 FF E0 BE 00 8D BF 80 00
				29 01 00 00 00 00 02 B0 03
				39 01 00 00 00 00 05 2A 00 00 04 37
				39 01 00 00 00 00 05 2B 00 00 07 7F
				39 01 00 00 00 00 02 36 41
				39 01 00 00 00 00 02 51 ff
				05 01 00 00 78 00 02 11 00
				05 01 00 00 14 00 02 29 00]; //LED control

		qcom,mdss-dsi-off-command = [
			39 01 00 00 10 00 02 28 00
			39 01 00 00 20 00 02 10 00
			];
		qcom,mdss-dsi-on-command-state = "dsi_lp_mode";
		qcom,mdss-dsi-off-command-state = "dsi_hs_mode";

		qcom,mdss-dsi-h-sync-pulse = <1>;

		qcom,mdss-dsi-traffic-mode = "burst_mode";
		qcom,mdss-dsi-lane-map = "lane_map_0123";
		qcom,mdss-dsi-bllp-eof-power-mode;
		qcom,mdss-dsi-bllp-power-mode;
		qcom,mdss-dsi-lane-0-state;
		qcom,mdss-dsi-lane-1-state;
		qcom,mdss-dsi-lane-2-state;
		qcom,mdss-dsi-lane-3-state;
		//qcom,mdss-dsi-panel-orientation="180";
		qcom,mdss-dsi-lp11-init;
/*
		qcom,mdss-tear-check-sync-init-val = <1920>;
		qcom,mdss-tear-check-sync-cfg-height = <1928>;
		qcom,mdss-tear-check-rd-ptr-trigger-intr = <1921>;
		qcom,mdss-tear-check-frame-rate = <6000>;
		qcom,mdss-tear-check-start-pos = <1920>;
*/
		qcom,mdss-dsi-te-pin-select = <1>;
		qcom,mdss-dsi-wr-mem-start = <0x2c>;
		qcom,mdss-dsi-wr-mem-continue = <0x3c>;
		qcom,mdss-dsi-te-dcs-command = <1>;
		qcom,mdss-dsi-te-check-enable;
		qcom,mdss-dsi-te-using-te-pin;
		//qcom,mdss-dsi-te-v-sync-rd-ptr-irq-line = <0x2c>;
		qcom,mdss-dsi-tx-eot-append;
		qcom,mdss-dsi-panel-timings = [AE 44 37 00 5D 55 39 46 5B 03 04 00];
		qcom,mdss-dsi-panel-timings-8996 = [
			23 1f 07 09 05 03 04 a0
			23 1f 07 09 05 03 04 a0
			23 1f 07 09 05 03 04 a0
			23 1f 07 09 05 03 04 a0
			23 19 07 08 05 03 04 a0];
		qcom,mdss-dsi-t-clk-post = <0x1e>;
		qcom,mdss-dsi-t-clk-pre = <0x34>;
		qcom,mdss-dsi-bl-min-level = <1>;
		qcom,mdss-dsi-bl-max-level = <4095>;
		qcom,mdss-dsi-dma-trigger = "trigger_sw";
		qcom,mdss-dsi-mdp-trigger = "none";
		qcom,mdss-dsi-bl-pmic-control-type = "bl_ctrl_wled";
		qcom,mdss-dsi-reset-sequence = <1 50>, <0 10>, <1 50>;
		qcom,mdss-pan-physical-width-dimension = <65>;
		qcom,mdss-pan-physical-height-dimension = <116>;
	};
};
