/* Copyright (c) 2013, The Linux Foundation. All rights reserved.
 *
 * This program is free software; you can redistribute it and/or modify
 * it under the terms of the GNU General Public License version 2 and
 * only version 2 as published by the Free Software Foundation.
 *
 * This program is distributed in the hope that it will be useful,
 * but WITHOUT ANY WARRANTY; without even the implied warranty of
 * MERCHANTABILITY or FITNESS FOR A PARTICULAR PURPOSE.  See the
 * GNU General Public License for more details.
 */

/*---------------------------------------------------------------------------
 * This file is autogenerated file using gcdb parser. Please do not edit it.
 * Update input XML file to add a new entry or update variable in this file
 * VERSION = "1.0"
 *---------------------------------------------------------------------------*/
&mdss_mdp {
	dsi_jdi_1080p_cmd: qcom,mdss_dsi_jdi_1080p_cmd {
		qcom,mdss-dsi-panel-name = "jdi 1080p command mode dsi panel";
		qcom,mdss-dsi-panel-controller = <&mdss_dsi0>;
		qcom,mdss-dsi-panel-type = "dsi_video_mode";
		qcom,mdss-dsi-panel-destination = "display_1";
		qcom,mdss-dsi-panel-framerate = <57>;
		qcom,mdss-dsi-virtual-channel-id = <0>;
		qcom,mdss-dsi-stream = <0>;
		qcom,mdss-dsi-panel-width = <1080>;
		qcom,mdss-dsi-panel-height = <1920>;
		qcom,mdss-dsi-h-front-porch = <128>;
		qcom,mdss-dsi-h-back-porch = <18>;
		qcom,mdss-dsi-h-pulse-width = <10>;
		qcom,mdss-dsi-h-sync-skew = <0>;
		qcom,mdss-dsi-v-back-porch = <4>;
		qcom,mdss-dsi-v-front-porch = <36>;
		qcom,mdss-dsi-v-pulse-width = <2>;

		qcom,mdss-dsi-h-left-border = <0>;
		qcom,mdss-dsi-h-right-border = <0>;
		qcom,mdss-dsi-v-top-border = <0>;
		qcom,mdss-dsi-v-bottom-border = <0>;
		qcom,mdss-dsi-bpp = <24>;
		//qcom,mdss-dsi-panel-clockrate = <895000000>;
		//qcom,mdss-dsi-panel-clockrate = <400000000>;
		qcom,mdss-dsi-color-order = "rgb_swap_rgb";
		qcom,mdss-dsi-underflow-color = <0xff>;
		qcom,mdss-dsi-border-color = <0>;
		qcom,mdss-dsi-pixel-packing = "tight";
		qcom,mdss-dsi-pixel-alignment = <0>;
		qcom,mdss-dsi-on-command = [
				29 01 00 00 05 00 02 FF 20
				29 01 00 00 00 00 02 00 01
				29 01 00 00 00 00 02 01 22
				29 01 00 00 00 00 02 02 45
				29 01 00 00 00 00 02 03 55
				29 01 00 00 00 00 02 04 00
				29 01 00 00 00 00 02 05 90
				29 01 00 00 00 00 02 06 B2
				29 01 00 00 00 00 02 07 B2
				29 01 00 00 00 00 02 08 0C
				29 01 00 00 00 00 02 09 D7
				29 01 00 00 00 00 02 0A D7
				29 01 00 00 00 00 02 0B D7
				29 01 00 00 00 00 02 0C D7
				29 01 00 00 00 00 02 0D 00
				29 01 00 00 00 00 02 0E B3
				29 01 00 00 00 00 02 0F AC
				29 01 00 00 00 00 02 11 1D
				29 01 00 00 00 00 02 12 1D
				29 01 00 00 00 00 02 13 03
				29 01 00 00 00 00 02 14 0A
				29 01 00 00 00 00 02 15 9A
				29 01 00 00 00 00 02 16 9A
				29 01 00 00 00 00 02 17 66
				29 01 00 00 00 00 02 18 63
				29 01 00 00 00 00 02 19 63
				29 01 00 00 00 00 02 1A 63
				29 01 00 00 00 00 02 1C 44
				29 01 00 00 00 00 02 1D 44
				29 01 00 00 00 00 02 30 62
				29 01 00 00 00 00 02 31 A8
				29 01 00 00 00 00 02 32 D8
				29 01 00 00 00 00 02 58 00
				29 01 00 00 00 00 02 59 00
				29 01 00 00 00 00 02 5A 00
				29 01 00 00 00 00 02 5B 00
				29 01 00 00 00 00 02 5C 00
				29 01 00 00 00 00 02 5D 00
				29 01 00 00 00 00 02 5E 00
				29 01 00 00 00 00 02 5F 00
				29 01 00 00 00 00 02 60 80
				29 01 00 00 00 00 02 61 21
				29 01 00 00 00 00 02 62 43
				29 01 00 00 00 00 02 63 65
				29 01 00 00 00 00 02 64 87
				29 01 00 00 00 00 02 65 A9
				29 01 00 00 00 00 02 66 0B
				29 01 00 00 00 00 02 67 10
				29 01 00 00 00 00 02 69 99
				29 01 00 00 00 00 02 6B 43
				29 01 00 00 00 00 02 6D 33
				29 01 00 00 00 00 02 71 54
				29 01 00 00 00 00 02 72 11
				29 01 00 00 00 00 02 74 10
				29 01 00 00 00 00 02 75 00
				29 01 00 00 00 00 02 76 00
				29 01 00 00 00 00 02 77 00
				29 01 00 00 00 00 02 78 16
				29 01 00 00 00 00 02 79 00
				29 01 00 00 00 00 02 7A 41
				29 01 00 00 00 00 02 7B 00
				29 01 00 00 00 00 02 7C 61
				29 01 00 00 00 00 02 7D 00
				29 01 00 00 00 00 02 7E 80
				29 01 00 00 00 00 02 7F 00
				29 01 00 00 00 00 02 80 98
				29 01 00 00 00 00 02 81 00
				29 01 00 00 00 00 02 82 AF
				29 01 00 00 00 00 02 83 00
				29 01 00 00 00 00 02 84 C3
				29 01 00 00 00 00 02 85 00
				29 01 00 00 00 00 02 86 D6
				29 01 00 00 00 00 02 87 01
				29 01 00 00 00 00 02 88 12
				29 01 00 00 00 00 02 89 01
				29 01 00 00 00 00 02 8A 40
				29 01 00 00 00 00 02 8B 01
				29 01 00 00 00 00 02 8C 86
				29 01 00 00 00 00 02 8D 01
				29 01 00 00 00 00 02 8E BB
				29 01 00 00 00 00 02 8F 02
				29 01 00 00 00 00 02 90 0A
				29 01 00 00 00 00 02 91 02
				29 01 00 00 00 00 02 92 4A
				29 01 00 00 00 00 02 93 02
				29 01 00 00 00 00 02 94 4C
				29 01 00 00 00 00 02 95 02
				29 01 00 00 00 00 02 96 89
				29 01 00 00 00 00 02 97 02
				29 01 00 00 00 00 02 98 CA
				29 01 00 00 00 00 02 99 02
				29 01 00 00 00 00 02 9A F2
				29 01 00 00 00 00 02 9B 03
				29 01 00 00 00 00 02 9C 23
				29 01 00 00 00 00 02 9D 03
				29 01 00 00 00 00 02 9E 45
				29 01 00 00 00 00 02 9F 03
				29 01 00 00 00 00 02 A0 73
				29 01 00 00 00 00 02 A2 03
				29 01 00 00 00 00 02 A3 82
				29 01 00 00 00 00 02 A4 03
				29 01 00 00 00 00 02 A5 91
				29 01 00 00 00 00 02 A6 03
				29 01 00 00 00 00 02 A7 A2
				29 01 00 00 00 00 02 A9 03
				29 01 00 00 00 00 02 AA B4
				29 01 00 00 00 00 02 AB 03
				29 01 00 00 00 00 02 AC C7
				29 01 00 00 00 00 02 AD 03
				29 01 00 00 00 00 02 AE DC
				29 01 00 00 00 00 02 AF 03
				29 01 00 00 00 00 02 B0 F4
				29 01 00 00 00 00 02 B1 03
				29 01 00 00 00 00 02 B2 FF
				29 01 00 00 00 00 02 B3 00
				29 01 00 00 00 00 02 B4 00
				29 01 00 00 00 00 02 B5 00
				29 01 00 00 00 00 02 B6 16
				29 01 00 00 00 00 02 B7 00
				29 01 00 00 00 00 02 B8 41
				29 01 00 00 00 00 02 B9 00
				29 01 00 00 00 00 02 BA 61
				29 01 00 00 00 00 02 BB 00
				29 01 00 00 00 00 02 BC 80
				29 01 00 00 00 00 02 BD 00
				29 01 00 00 00 00 02 BE 98
				29 01 00 00 00 00 02 BF 00
				29 01 00 00 00 00 02 C0 AF
				29 01 00 00 00 00 02 C1 00
				29 01 00 00 00 00 02 C2 C3
				29 01 00 00 00 00 02 C3 00
				29 01 00 00 00 00 02 C4 D6
				29 01 00 00 00 00 02 C5 01
				29 01 00 00 00 00 02 C6 12
				29 01 00 00 00 00 02 C7 01
				29 01 00 00 00 00 02 C8 40
				29 01 00 00 00 00 02 C9 01
				29 01 00 00 00 00 02 CA 86
				29 01 00 00 00 00 02 CB 01
				29 01 00 00 00 00 02 CC BB
				29 01 00 00 00 00 02 CD 02
				29 01 00 00 00 00 02 CE 0A
				29 01 00 00 00 00 02 CF 02
				29 01 00 00 00 00 02 D0 4A
				29 01 00 00 00 00 02 D1 02
				29 01 00 00 00 00 02 D2 4C
				29 01 00 00 00 00 02 D3 02
				29 01 00 00 00 00 02 D4 89
				29 01 00 00 00 00 02 D5 02
				29 01 00 00 00 00 02 D6 CA
				29 01 00 00 00 00 02 D7 02
				29 01 00 00 00 00 02 D8 F2
				29 01 00 00 00 00 02 D9 03
				29 01 00 00 00 00 02 DA 23
				29 01 00 00 00 00 02 DB 03
				29 01 00 00 00 00 02 DC 45
				29 01 00 00 00 00 02 DD 03
				29 01 00 00 00 00 02 DE 73
				29 01 00 00 00 00 02 DF 03
				29 01 00 00 00 00 02 E0 82
				29 01 00 00 00 00 02 E1 03
				29 01 00 00 00 00 02 E2 91
				29 01 00 00 00 00 02 E3 03
				29 01 00 00 00 00 02 E4 A2
				29 01 00 00 00 00 02 E5 03
				29 01 00 00 00 00 02 E6 B4
				29 01 00 00 00 00 02 E7 03
				29 01 00 00 00 00 02 E8 C7
				29 01 00 00 00 00 02 E9 03
				29 01 00 00 00 00 02 EA DC
				29 01 00 00 00 00 02 EB 03
				29 01 00 00 00 00 02 EC F4
				29 01 00 00 00 00 02 ED 03
				29 01 00 00 00 00 02 EE FF
				29 01 00 00 00 00 02 EF 00
				29 01 00 00 00 00 02 F0 66
				29 01 00 00 00 00 02 F1 00
				29 01 00 00 00 00 02 F2 75
				29 01 00 00 00 00 02 F3 00
				29 01 00 00 00 00 02 F4 91
				29 01 00 00 00 00 02 F5 00
				29 01 00 00 00 00 02 F6 A7
				29 01 00 00 00 00 02 F7 00
				29 01 00 00 00 00 02 F8 BD
				29 01 00 00 00 00 02 F9 00
				29 01 00 00 00 00 02 FA CF
				29 01 00 00 05 00 02 FB 01
				29 01 00 00 05 00 02 FF 21
				29 01 00 00 00 00 02 00 00
				29 01 00 00 00 00 02 01 E1
				29 01 00 00 00 00 02 02 00
				29 01 00 00 00 00 02 03 F0
				29 01 00 00 00 00 02 04 00
				29 01 00 00 00 00 02 05 FF
				29 01 00 00 00 00 02 06 01
				29 01 00 00 00 00 02 07 30
				29 01 00 00 00 00 02 08 01
				29 01 00 00 00 00 02 09 58
				29 01 00 00 00 00 02 0A 01
				29 01 00 00 00 00 02 0B 96
				29 01 00 00 00 00 02 0C 01
				29 01 00 00 00 00 02 0D C6
				29 01 00 00 00 00 02 0E 02
				29 01 00 00 00 00 02 0F 11
				29 01 00 00 00 00 02 10 02
				29 01 00 00 00 00 02 11 4F
				29 01 00 00 00 00 02 12 02
				29 01 00 00 00 00 02 13 51
				29 01 00 00 00 00 02 14 02
				29 01 00 00 00 00 02 15 8C
				29 01 00 00 00 00 02 16 02
				29 01 00 00 00 00 02 17 CD
				29 01 00 00 00 00 02 18 02
				29 01 00 00 00 00 02 19 F4
				29 01 00 00 00 00 02 1A 03
				29 01 00 00 00 00 02 1B 25
				29 01 00 00 00 00 02 1C 03
				29 01 00 00 00 00 02 1D 48
				29 01 00 00 00 00 02 1E 03
				29 01 00 00 00 00 02 1F 75
				29 01 00 00 00 00 02 20 03
				29 01 00 00 00 00 02 21 83
				29 01 00 00 00 00 02 22 03
				29 01 00 00 00 00 02 23 93
				29 01 00 00 00 00 02 24 03
				29 01 00 00 00 00 02 25 A3
				29 01 00 00 00 00 02 26 03
				29 01 00 00 00 00 02 27 B5
				29 01 00 00 00 00 02 28 03
				29 01 00 00 00 00 02 29 C8
				29 01 00 00 00 00 02 2A 03
				29 01 00 00 00 00 02 2B DD
				29 01 00 00 00 00 02 2D 03
				29 01 00 00 00 00 02 2F F4
				29 01 00 00 00 00 02 30 03
				29 01 00 00 00 00 02 31 FF
				29 01 00 00 00 00 02 32 00
				29 01 00 00 00 00 02 33 66
				29 01 00 00 00 00 02 34 00
				29 01 00 00 00 00 02 35 75
				29 01 00 00 00 00 02 36 00
				29 01 00 00 00 00 02 37 91
				29 01 00 00 00 00 02 38 00
				29 01 00 00 00 00 02 39 A7
				29 01 00 00 00 00 02 3A 00
				29 01 00 00 00 00 02 3B BD
				29 01 00 00 00 00 02 3D 00
				29 01 00 00 00 00 02 3F CF
				29 01 00 00 00 00 02 40 00
				29 01 00 00 00 00 02 41 E1
				29 01 00 00 00 00 02 42 00
				29 01 00 00 00 00 02 43 F0
				29 01 00 00 00 00 02 44 00
				29 01 00 00 00 00 02 45 FF
				29 01 00 00 00 00 02 46 01
				29 01 00 00 00 00 02 47 30
				29 01 00 00 00 00 02 48 01
				29 01 00 00 00 00 02 49 58
				29 01 00 00 00 00 02 4A 01
				29 01 00 00 00 00 02 4B 96
				29 01 00 00 00 00 02 4C 01
				29 01 00 00 00 00 02 4D C6
				29 01 00 00 00 00 02 4E 02
				29 01 00 00 00 00 02 4F 11
				29 01 00 00 00 00 02 50 02
				29 01 00 00 00 00 02 51 4F
				29 01 00 00 00 00 02 52 02
				29 01 00 00 00 00 02 53 51
				29 01 00 00 00 00 02 54 02
				29 01 00 00 00 00 02 55 8C
				29 01 00 00 00 00 02 56 02
				29 01 00 00 00 00 02 58 CD
				29 01 00 00 00 00 02 59 02
				29 01 00 00 00 00 02 5A F4
				29 01 00 00 00 00 02 5B 03
				29 01 00 00 00 00 02 5C 25
				29 01 00 00 00 00 02 5D 03
				29 01 00 00 00 00 02 5E 48
				29 01 00 00 00 00 02 5F 03
				29 01 00 00 00 00 02 60 75
				29 01 00 00 00 00 02 61 03
				29 01 00 00 00 00 02 62 83
				29 01 00 00 00 00 02 63 03
				29 01 00 00 00 00 02 64 93
				29 01 00 00 00 00 02 65 03
				29 01 00 00 00 00 02 66 A3
				29 01 00 00 00 00 02 67 03
				29 01 00 00 00 00 02 68 B5
				29 01 00 00 00 00 02 69 03
				29 01 00 00 00 00 02 6A C8
				29 01 00 00 00 00 02 6B 03
				29 01 00 00 00 00 02 6C DD
				29 01 00 00 00 00 02 6D 03
				29 01 00 00 00 00 02 6E F4
				29 01 00 00 00 00 02 6F 03
				29 01 00 00 00 00 02 70 FF
				29 01 00 00 00 00 02 71 00
				29 01 00 00 00 00 02 72 B8
				29 01 00 00 00 00 02 73 00
				29 01 00 00 00 00 02 74 C2
				29 01 00 00 00 00 02 75 00
				29 01 00 00 00 00 02 76 D5
				29 01 00 00 00 00 02 77 00
				29 01 00 00 00 00 02 78 E5
				29 01 00 00 00 00 02 79 00
				29 01 00 00 00 00 02 7A F5
				29 01 00 00 00 00 02 7B 01
				29 01 00 00 00 00 02 7C 03
				29 01 00 00 00 00 02 7D 01
				29 01 00 00 00 00 02 7E 11
				29 01 00 00 00 00 02 7F 01
				29 01 00 00 00 00 02 80 1D
				29 01 00 00 00 00 02 81 01
				29 01 00 00 00 00 02 82 29
				29 01 00 00 00 00 02 83 01
				29 01 00 00 00 00 02 84 52
				29 01 00 00 00 00 02 85 01
				29 01 00 00 00 00 02 86 73
				29 01 00 00 00 00 02 87 01
				29 01 00 00 00 00 02 88 AA
				29 01 00 00 00 00 02 89 01
				29 01 00 00 00 00 02 8A D5
				29 01 00 00 00 00 02 8B 02
				29 01 00 00 00 00 02 8C 1C
				29 01 00 00 00 00 02 8D 02
				29 01 00 00 00 00 02 8E 57
				29 01 00 00 00 00 02 8F 02
				29 01 00 00 00 00 02 90 59
				29 01 00 00 00 00 02 91 02
				29 01 00 00 00 00 02 92 92
				29 01 00 00 00 00 02 93 02
				29 01 00 00 00 00 02 94 D2
				29 01 00 00 00 00 02 95 02
				29 01 00 00 00 00 02 96 F9
				29 01 00 00 00 00 02 97 03
				29 01 00 00 00 00 02 98 2A
				29 01 00 00 00 00 02 99 03
				29 01 00 00 00 00 02 9A 4C
				29 01 00 00 00 00 02 9B 03
				29 01 00 00 00 00 02 9C 79
				29 01 00 00 00 00 02 9D 03
				29 01 00 00 00 00 02 9E 87
				29 01 00 00 00 00 02 9F 03
				29 01 00 00 00 00 02 A0 96
				29 01 00 00 00 00 02 A2 03
				29 01 00 00 00 00 02 A3 A6
				29 01 00 00 00 00 02 A4 03
				29 01 00 00 00 00 02 A5 B7
				29 01 00 00 00 00 02 A6 03
				29 01 00 00 00 00 02 A7 CA
				29 01 00 00 00 00 02 A9 03
				29 01 00 00 00 00 02 AA DE
				29 01 00 00 00 00 02 AB 03
				29 01 00 00 00 00 02 AC F4
				29 01 00 00 00 00 02 AD 03
				29 01 00 00 00 00 02 AE FF
				29 01 00 00 00 00 02 AF 00
				29 01 00 00 00 00 02 B0 B8
				29 01 00 00 00 00 02 B1 00
				29 01 00 00 00 00 02 B2 C2
				29 01 00 00 00 00 02 B3 00
				29 01 00 00 00 00 02 B4 D5
				29 01 00 00 00 00 02 B5 00
				29 01 00 00 00 00 02 B6 E5
				29 01 00 00 00 00 02 B7 00
				29 01 00 00 00 00 02 B8 F5
				29 01 00 00 00 00 02 B9 01
				29 01 00 00 00 00 02 BA 03
				29 01 00 00 00 00 02 BB 01
				29 01 00 00 00 00 02 BC 11
				29 01 00 00 00 00 02 BD 01
				29 01 00 00 00 00 02 BE 1D
				29 01 00 00 00 00 02 BF 01
				29 01 00 00 00 00 02 C0 29
				29 01 00 00 00 00 02 C1 01
				29 01 00 00 00 00 02 C2 52
				29 01 00 00 00 00 02 C3 01
				29 01 00 00 00 00 02 C4 73
				29 01 00 00 00 00 02 C5 01
				29 01 00 00 00 00 02 C6 AA
				29 01 00 00 00 00 02 C7 01
				29 01 00 00 00 00 02 C8 D5
				29 01 00 00 00 00 02 C9 02
				29 01 00 00 00 00 02 CA 1C
				29 01 00 00 00 00 02 CB 02
				29 01 00 00 00 00 02 CC 57
				29 01 00 00 00 00 02 CD 02
				29 01 00 00 00 00 02 CE 59
				29 01 00 00 00 00 02 CF 02
				29 01 00 00 00 00 02 D0 92
				29 01 00 00 00 00 02 D1 02
				29 01 00 00 00 00 02 D2 D2
				29 01 00 00 00 00 02 D3 02
				29 01 00 00 00 00 02 D4 F9
				29 01 00 00 00 00 02 D5 03
				29 01 00 00 00 00 02 D6 2A
				29 01 00 00 00 00 02 D7 03
				29 01 00 00 00 00 02 D8 4C
				29 01 00 00 00 00 02 D9 03
				29 01 00 00 00 00 02 DA 79
				29 01 00 00 00 00 02 DB 03
				29 01 00 00 00 00 02 DC 87
				29 01 00 00 00 00 02 DD 03
				29 01 00 00 00 00 02 DE 96
				29 01 00 00 00 00 02 DF 03
				29 01 00 00 00 00 02 E0 A6
				29 01 00 00 00 00 02 E1 03
				29 01 00 00 00 00 02 E2 B7
				29 01 00 00 00 00 02 E3 03
				29 01 00 00 00 00 02 E4 CA
				29 01 00 00 00 00 02 E5 03
				29 01 00 00 00 00 02 E6 DE
				29 01 00 00 00 00 02 E7 03
				29 01 00 00 00 00 02 E8 F4
				29 01 00 00 00 00 02 E9 03
				29 01 00 00 00 00 02 EA FF
				29 01 00 00 05 00 02 FB 01
				29 01 00 00 05 00 02 FF 23
				29 01 00 00 00 00 02 07 20
				29 01 00 00 00 00 02 08 03
				29 01 00 00 00 00 02 46 00
				29 01 00 00 05 00 02 FB 01
				29 01 00 00 05 00 02 FF 24
				29 01 00 00 00 00 02 00 0C
				29 01 00 00 00 00 02 01 04
				29 01 00 00 00 00 02 02 1B
				29 01 00 00 00 00 02 03 0F
				29 01 00 00 00 00 02 04 1D
				29 01 00 00 00 00 02 05 00
				29 01 00 00 00 00 02 06 01
				29 01 00 00 00 00 02 07 19
				29 01 00 00 00 00 02 08 00
				29 01 00 00 00 00 02 09 00
				29 01 00 00 00 00 02 0A 17
				29 01 00 00 00 00 02 0B 15
				29 01 00 00 00 00 02 0C 13
				29 01 00 00 00 00 02 0D 18
				29 01 00 00 00 00 02 0E 16
				29 01 00 00 00 00 02 0F 14
				29 01 00 00 00 00 02 10 00
				29 01 00 00 00 00 02 11 03
				29 01 00 00 00 00 02 12 1B
				29 01 00 00 00 00 02 13 00
				29 01 00 00 00 00 02 14 1D
				29 01 00 00 00 00 02 15 00
				29 01 00 00 00 00 02 16 01
				29 01 00 00 00 00 02 17 19
				29 01 00 00 00 00 02 18 00
				29 01 00 00 00 00 02 19 00
				29 01 00 00 00 00 02 1A 17
				29 01 00 00 00 00 02 1B 15
				29 01 00 00 00 00 02 1C 13
				29 01 00 00 00 00 02 1D 18
				29 01 00 00 00 00 02 1E 16
				29 01 00 00 00 00 02 1F 14
				29 01 00 00 00 00 02 20 00
				29 01 00 00 00 00 02 21 01
				29 01 00 00 00 00 02 22 10
				29 01 00 00 00 00 02 23 13
				29 01 00 00 00 00 02 24 13
				29 01 00 00 00 00 02 25 5D
				29 01 00 00 00 00 02 26 13
				29 01 00 00 00 00 02 27 13
				29 01 00 00 00 00 02 29 D8
				29 01 00 00 00 00 02 2A 15
				29 01 00 00 00 00 02 2F 02
				29 01 00 00 00 00 02 30 02
				29 01 00 00 00 00 02 31 00
				29 01 00 00 00 00 02 32 23
				29 01 00 00 00 00 02 33 00
				29 01 00 00 00 00 02 34 03
				29 01 00 00 00 00 02 35 4B
				29 01 00 00 00 00 02 36 00
				29 01 00 00 00 00 02 37 1D
				29 01 00 00 00 00 02 38 08
				29 01 00 00 00 00 02 39 03
				29 01 00 00 00 00 02 3A 4B
				29 01 00 00 00 00 02 3F 01
				29 01 00 00 00 00 02 40 01
				29 01 00 00 00 00 02 41 E0
				29 01 00 00 00 00 02 42 01
				29 01 00 00 00 00 02 43 50
				29 01 00 00 00 00 02 44 58
				29 01 00 00 00 00 02 45 00
				29 01 00 00 00 00 02 46 1D
				29 01 00 00 00 00 02 47 08
				29 01 00 00 00 00 02 48 50
				29 01 00 00 00 00 02 49 58
				29 01 00 00 00 00 02 59 02
				29 01 00 00 00 00 02 5A 06
				29 01 00 00 00 00 02 5F 4D
				29 01 00 00 00 00 02 67 04
				29 01 00 00 00 00 02 6E 10
				29 01 00 00 00 00 02 72 00
				29 01 00 00 00 00 02 73 00
				29 01 00 00 00 00 02 74 03
				29 01 00 00 00 00 02 75 14
				29 01 00 00 00 00 02 76 02
				29 01 00 00 00 00 02 77 01
				29 01 00 00 00 00 02 78 00
				29 01 00 00 00 00 02 79 00
				29 01 00 00 00 00 02 7A 00
				29 01 00 00 00 00 02 7B 91
				29 01 00 00 00 00 02 7C DA
				29 01 00 00 00 00 02 7D 10
				29 01 00 00 00 00 02 7E 03
				29 01 00 00 00 00 02 7F 14
				29 01 00 00 00 00 02 80 00
				29 01 00 00 00 00 02 81 02
				29 01 00 00 00 00 02 82 01
				29 01 00 00 00 00 02 83 00
				29 01 00 00 00 00 02 84 02
				29 01 00 00 00 00 02 85 02
				29 01 00 00 00 00 02 86 1B
				29 01 00 00 00 00 02 87 1B
				29 01 00 00 00 00 02 88 1B
				29 01 00 00 00 00 02 89 1B
				29 01 00 00 00 00 02 8A 33
				29 01 00 00 00 00 02 8B F0
				29 01 00 00 00 00 02 8C 00
				29 01 00 00 00 00 02 8E 02
				29 01 00 00 00 00 02 90 51
				29 01 00 00 00 00 02 91 40
				29 01 00 00 00 00 02 92 51
				29 01 00 00 00 00 02 93 02
				29 01 00 00 00 00 02 94 06
				29 01 00 00 00 00 02 95 55
				29 01 00 00 00 00 02 96 55
				29 01 00 00 00 00 02 97 A3
				29 01 00 00 00 00 02 98 00
				29 01 00 00 00 00 02 99 33
				29 01 00 00 00 00 02 9A 03
				29 01 00 00 00 00 02 9B 0F
				29 01 00 00 00 00 02 9C 01
				29 01 00 00 00 00 02 9D B0
				29 01 00 00 00 00 02 A2 0B
				29 01 00 00 00 00 02 A5 10
				29 01 00 00 00 00 02 A9 21
				29 01 00 00 00 00 02 AA 44
				29 01 00 00 00 00 02 AB 00
				29 01 00 00 00 00 02 AC 00
				29 01 00 00 00 00 02 AD 08
				29 01 00 00 00 00 02 AE 3C
				29 01 00 00 00 00 02 AF 0F
				29 01 00 00 00 00 02 B0 35
				29 01 00 00 00 00 02 B1 08
				29 01 00 00 00 00 02 B2 3C
				29 01 00 00 00 00 02 B3 0A
				29 01 00 00 00 00 02 B4 DA
				29 01 00 00 00 00 02 B5 55
				29 01 00 00 00 00 02 BA 23
				29 01 00 00 00 00 02 BB 00
				29 01 00 00 00 00 02 BC 23
				29 01 00 00 00 00 02 C4 24
				29 01 00 00 00 00 02 C5 30
				29 01 00 00 00 00 02 C6 00
				29 01 00 00 00 00 02 D3 00
				29 01 00 00 00 00 02 D4 50
				29 01 00 00 00 00 02 D5 45
				29 01 00 00 00 00 02 D6 08
				29 01 00 00 00 00 02 D7 45
				29 01 00 00 00 00 02 D8 08
				29 01 00 00 00 00 02 D9 74
				29 01 00 00 00 00 02 DA 74
				29 01 00 00 00 00 02 DB 91
				29 01 00 00 00 00 02 DE FF
				29 01 00 00 00 00 02 E3 02
				29 01 00 00 00 00 02 EA 00
				29 01 00 00 00 00 02 EB 00
				29 01 00 00 00 00 02 EC 00
				29 01 00 00 00 00 02 EE 01
				29 01 00 00 00 00 02 EF 06
				29 01 00 00 00 00 02 F0 50
				29 01 00 00 00 00 02 F1 50
				29 01 00 00 00 00 02 F2 0D
				29 01 00 00 00 00 02 F3 48
				29 01 00 00 00 00 02 F4 D0
				29 01 00 00 00 00 02 F5 05
				29 01 00 00 00 00 02 F6 00
				29 01 00 00 00 00 02 F7 00
				29 01 00 00 00 00 02 F8 00
				29 01 00 00 00 00 02 F9 00
				29 01 00 00 05 00 02 FB 01
				29 01 00 00 05 00 02 FF 26
				29 01 00 00 00 00 02 00 AB
				29 01 00 00 00 00 02 01 00
				29 01 00 00 00 00 02 02 64
				29 01 00 00 00 00 02 03 06
				29 01 00 00 00 00 02 04 66
				29 01 00 00 00 00 02 05 25
				29 01 00 00 00 00 02 06 30
				29 01 00 00 00 00 02 07 01
				29 01 00 00 00 00 02 0A 08
				29 01 00 00 00 00 02 0B 55
				29 01 00 00 00 00 02 0C 14
				29 01 00 00 00 00 02 0D 28
				29 01 00 00 00 00 02 0E 00
				29 01 00 00 00 00 02 0F FF
				29 01 00 00 00 00 02 10 00
				29 01 00 00 00 00 02 11 01
				29 01 00 00 00 00 02 12 07
				29 01 00 00 00 00 02 13 03
				29 01 00 00 00 00 02 14 01
				29 01 00 00 00 00 02 15 02
				29 01 00 00 00 00 02 16 00
				29 01 00 00 00 00 02 19 40
				29 01 00 00 00 00 02 1A 03
				29 01 00 00 00 00 02 1B 23
				29 01 00 00 00 00 02 1C 11
				29 01 00 00 00 00 02 1D 01
				29 01 00 00 00 00 02 1E 93
				29 01 00 00 00 00 02 1F 06
				29 01 00 00 00 00 02 20 00
				29 01 00 00 00 00 02 21 03
				29 01 00 00 00 00 02 22 20
				29 01 00 00 00 00 02 23 23
				29 01 00 00 00 00 02 24 00
				29 01 00 00 00 00 02 25 A5
				29 01 00 00 00 00 02 26 00
				29 01 00 00 00 00 02 27 A3
				29 01 00 00 00 00 02 2F 05
				29 01 00 00 00 00 02 30 27
				29 01 00 00 00 00 02 31 3F
				29 01 00 00 00 00 02 32 3B
				29 01 00 00 00 00 02 33 1E
				29 01 00 00 00 00 02 34 1E
				29 01 00 00 00 00 02 35 45
				29 01 00 00 00 00 02 41 20
				29 01 00 00 00 00 02 42 03
				29 01 00 00 00 00 02 43 00
				29 01 00 00 00 00 02 44 11
				29 01 00 00 00 00 02 45 01
				29 01 00 00 00 00 02 46 12
				29 01 00 00 00 00 02 47 06
				29 01 00 00 00 00 02 48 00
				29 01 00 00 00 00 02 49 03
				29 01 00 00 00 00 02 4A 00
				29 01 00 00 00 00 02 4B 00
				29 01 00 00 00 00 02 4C 01
				29 01 00 00 00 00 02 4D 53
				29 01 00 00 00 00 02 4E 01
				29 01 00 00 00 00 02 4F 51
				29 01 00 00 00 00 02 50 0A
				29 01 00 00 00 00 02 51 9A
				29 01 00 00 00 00 02 52 3F
				29 01 00 00 00 00 02 53 1A
				29 01 00 00 00 00 02 54 3C
				29 01 00 00 00 00 02 55 3C
				29 01 00 00 00 00 02 56 3B
				29 01 00 00 00 00 02 5B 40
				29 01 00 00 00 00 02 5C 03
				29 01 00 00 00 00 02 5D 23
				29 01 00 00 00 00 02 5E 11
				29 01 00 00 00 00 02 5F 01
				29 01 00 00 00 00 02 60 93
				29 01 00 00 00 00 02 61 06
				29 01 00 00 00 00 02 62 00
				29 01 00 00 00 00 02 63 03
				29 01 00 00 00 00 02 64 20
				29 01 00 00 00 00 02 65 23
				29 01 00 00 00 00 02 66 00
				29 01 00 00 00 00 02 67 A5
				29 01 00 00 00 00 02 68 00
				29 01 00 00 00 00 02 69 A3
				29 01 00 00 00 00 02 6A 05
				29 01 00 00 00 00 02 6B 27
				29 01 00 00 00 00 02 6C 3F
				29 01 00 00 00 00 02 6D 3B
				29 01 00 00 00 00 02 6E 1E
				29 01 00 00 00 00 02 6F 1E
				29 01 00 00 00 00 02 70 45
				29 01 00 00 00 00 02 71 40
				29 01 00 00 00 00 02 72 03
				29 01 00 00 00 00 02 73 23
				29 01 00 00 00 00 02 74 11
				29 01 00 00 00 00 02 75 01
				29 01 00 00 00 00 02 76 93
				29 01 00 00 00 00 02 77 06
				29 01 00 00 00 00 02 78 00
				29 01 00 00 00 00 02 79 03
				29 01 00 00 00 00 02 7A 20
				29 01 00 00 00 00 02 7B 23
				29 01 00 00 00 00 02 7C 00
				29 01 00 00 00 00 02 7D A5
				29 01 00 00 00 00 02 7E 00
				29 01 00 00 00 00 02 7F A3
				29 01 00 00 00 00 02 80 05
				29 01 00 00 00 00 02 81 27
				29 01 00 00 00 00 02 82 3F
				29 01 00 00 00 00 02 83 3B
				29 01 00 00 00 00 02 84 1E
				29 01 00 00 00 00 02 85 1E
				29 01 00 00 00 00 02 86 45
				29 01 00 00 00 00 02 87 12
				29 01 00 00 00 00 02 88 12
				29 01 00 00 00 00 02 89 12
				29 01 00 00 00 00 02 8A 12
				29 01 00 00 00 00 02 8B 12
				29 01 00 00 00 00 02 8C 12
				29 01 00 00 00 00 02 8D 00
				29 01 00 00 00 00 02 8E 18
				29 01 00 00 00 00 02 8F 18
				29 01 00 00 00 00 02 90 00
				29 01 00 00 00 00 02 91 08
				29 01 00 00 00 00 02 92 FC
				29 01 00 00 00 00 02 93 01
				29 01 00 00 00 00 02 94 01
				29 01 00 00 00 00 02 95 01
				29 01 00 00 00 00 02 96 01
				29 01 00 00 00 00 02 97 10
				29 01 00 00 00 00 02 98 42
				29 01 00 00 00 00 02 99 00
				29 01 00 00 00 00 02 9A 13
				29 01 00 00 00 00 02 9B 02
				29 01 00 00 00 00 02 9C 01
				29 01 00 00 00 00 02 9D 02
				29 01 00 00 00 00 02 9E 01
				29 01 00 00 00 00 02 9F 0D
				29 01 00 00 00 00 02 A0 00
				29 01 00 00 00 00 02 A2 00
				29 01 00 00 00 00 02 A3 22
				29 01 00 00 00 00 02 A4 00
				29 01 00 00 00 00 02 A5 80
				29 01 00 00 00 00 02 A6 80
				29 01 00 00 00 00 02 AC 71
				29 01 00 00 00 00 02 AD 77
				29 01 00 00 00 00 02 AE 77
				29 01 00 00 00 00 02 B0 80
				29 01 00 00 00 00 02 B1 80
				29 01 00 00 00 00 02 B2 80
				29 01 00 00 00 00 02 B4 80
				29 01 00 00 00 00 02 B5 80
				29 01 00 00 00 00 02 B7 80
				29 01 00 00 00 00 02 B8 80
				29 01 00 00 00 00 02 BA 13
				29 01 00 00 00 00 02 BB 13
				29 01 00 00 00 00 02 BC 00
				29 01 00 00 00 00 02 BD 02
				29 01 00 00 00 00 02 BE 4F
				29 01 00 00 00 00 02 BF 50
				29 01 00 00 00 00 02 C0 58
				29 01 00 00 00 00 02 C3 02
				29 01 00 00 00 00 02 C4 01
				29 01 00 00 00 00 02 C5 03
				29 01 00 00 00 00 02 C6 15
				29 01 00 00 00 00 02 C7 49
				29 01 00 00 00 00 02 C8 0C
				29 01 00 00 00 00 02 C9 56
				29 01 00 00 00 00 02 CA 00
				29 01 00 00 00 00 02 CB 18
				29 01 00 00 00 00 02 CC 57
				29 01 00 00 00 00 02 CE 2E
				29 01 00 00 00 00 02 CF 00
				29 01 00 00 00 00 02 D0 B0
				29 01 00 00 00 00 02 D1 0A
				29 01 00 00 00 00 02 D2 0A
				29 01 00 00 00 00 02 D3 0B
				29 01 00 00 00 00 02 E1 05
				29 01 00 00 00 00 02 E2 0D
				29 01 00 00 00 00 02 E3 05
				29 01 00 00 00 00 02 E4 0D
				29 01 00 00 00 00 02 E5 05
				29 01 00 00 00 00 02 E6 0D
				29 01 00 00 00 00 02 E7 05
				29 01 00 00 00 00 02 E8 0D
				29 01 00 00 00 00 02 E9 1C
				29 01 00 00 00 00 02 EA 22
				29 01 00 00 00 00 02 EB 1C
				29 01 00 00 00 00 02 FB 01
				29 01 00 00 00 00 02 FF 10
				29 01 00 00 00 00 02 BB 13
				29 01 00 00 00 00 06 3B 03 08 08 50 80
				29 01 00 00 00 00 02 36 03
				39 01 00 00 79 00 02 11 00
				39 01 00 00 00 00 02 29 00
				29 01 00 00 00 00 02 55 02 /* CABC Setting */
				29 01 00 00 00 00 02 5E 33 /* CABC Minimum brightness */
				29 01 00 00 00 00 02 51 ff //LED PWM duty
				29 01 00 00 00 00 02 53 2c]; //LED control

		qcom,mdss-dsi-off-command = [
			39 01 00 00 0A 00 02 28 00
			39 01 00 00 96 00 02 10 00
			];
		qcom,mdss-dsi-on-command-state = "dsi_lp_mode";
		qcom,mdss-dsi-off-command-state = "dsi_hs_mode";
		qcom,mdss-dsi-h-sync-pulse = <1>;
		qcom,mdss-dsi-traffic-mode = "burst_mode";
		qcom,mdss-dsi-lane-map = "lane_map_0123";
		qcom,mdss-dsi-bllp-eof-power-mode;
		qcom,mdss-dsi-bllp-power-mode;
		qcom,mdss-dsi-lane-0-state;
		qcom,mdss-dsi-lane-1-state;
		qcom,mdss-dsi-lane-2-state;
		qcom,mdss-dsi-lane-3-state;
		//qcom,mdss-dsi-panel-orientation="180";
		//qcom,mdss-dsi-lp11-init;
		//qcom,mdss-tear-check-sync-init-val = <1920>;
		//qcom,mdss-tear-check-sync-cfg-height = <1928>;
		//qcom,mdss-tear-check-rd-ptr-trigger-intr = <1921>;
		//qcom,mdss-tear-check-frame-rate = <6000>;
		//qcom,mdss-tear-check-start-pos = <1920>;
		/*qcom,mdss-dsi-te-pin-select = <1>;
		qcom,mdss-dsi-te-v-sync-rd-ptr-irq-line = <0x2c>;
		qcom,mdss-dsi-te-dcs-command = <1>;
		qcom,mdss-dsi-te-check-enable;
		qcom,mdss-dsi-te-using-te-pin;*/
		qcom,mdss-dsi-tx-eot-append;
		qcom,mdss-dsi-panel-timings-8996 = [
			23 1e 07 09 05 03 04 a0
			23 1e 07 09 05 03 04 a0
			23 1e 07 09 05 03 04 a0
			23 1e 07 09 05 03 04 a0
			23 19 07 08 05 03 04 a0];
		qcom,mdss-dsi-t-clk-post = <0x13>;
		qcom,mdss-dsi-t-clk-pre = <0x45>;
		qcom,mdss-dsi-bl-min-level = <1>;
		qcom,mdss-dsi-bl-max-level = <4095>;
		qcom,mdss-dsi-dma-trigger = "trigger_sw";
		qcom,mdss-dsi-mdp-trigger = "none";
		qcom,mdss-dsi-bl-pmic-control-type = "bl_ctrl_wled";
		qcom,mdss-dsi-reset-sequence = <1 11>, <0 1>, <1 11>;
		qcom,mdss-pan-physical-width-dimension = <65>;
		qcom,mdss-pan-physical-height-dimension = <116>;
	};
};
