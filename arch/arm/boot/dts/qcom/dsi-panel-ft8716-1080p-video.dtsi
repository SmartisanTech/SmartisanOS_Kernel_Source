/* Copyright (c) 2013, The Linux Foundation. All rights reserved.
 *
 * This program is free software; you can redistribute it and/or modify
 * it under the terms of the GNU General Public License version 2 and
 * only version 2 as published by the Free Software Foundation.
 *
 * This program is distributed in the hope that it will be useful,
 * but WITHOUT ANY WARRANTY; without even the implied warranty of
 * MERCHANTABILITY or FITNESS FOR A PARTICULAR PURPOSE.  See the
 * GNU General Public License for more details.
 */

/*---------------------------------------------------------------------------
 * This file is autogenerated file using gcdb parser. Please do not edit it.
 * Update input XML file to add a new entry or update variable in this file
 * VERSION = "1.0"
 *---------------------------------------------------------------------------*/
&mdss_mdp {
	dsi_ft8716_1080p_vid: qcom,mdss_dsi_ft8716_1080p_video {
		qcom,mdss-dsi-panel-name = "ft8716 1080p video mode dsi panel";
		qcom,mdss-dsi-panel-controller = <&mdss_dsi0>;
		qcom,mdss-dsi-panel-type = "dsi_video_mode";
		qcom,mdss-dsi-panel-destination = "display_1";
		qcom,mdss-dsi-panel-framerate = <60>;
		qcom,mdss-dsi-virtual-channel-id = <0>;
		qcom,mdss-dsi-stream = <0>;
		qcom,mdss-dsi-panel-width = <1080>;
		qcom,mdss-dsi-panel-height = <1920>;
		qcom,mdss-dsi-h-front-porch = <96>;
		qcom,mdss-dsi-h-back-porch = <96>;
		qcom,mdss-dsi-h-pulse-width = <4>;
		qcom,mdss-dsi-h-sync-skew = <0>;
		qcom,mdss-dsi-v-back-porch = <16>;
		qcom,mdss-dsi-v-front-porch = <16>;
		qcom,mdss-dsi-v-pulse-width = <2>;
		qcom,mdss-dsi-h-left-border = <0>;
		qcom,mdss-dsi-h-right-border = <0>;
		qcom,mdss-dsi-v-top-border = <0>;
		qcom,mdss-dsi-v-bottom-border = <0>;
		qcom,mdss-dsi-bpp = <24>;
		qcom,mdss-dsi-color-order = "rgb_swap_rgb";
		qcom,mdss-dsi-underflow-color = <0xff>;
		qcom,mdss-dsi-border-color = <0>;
		/* qcom,ulps-enabled; */
		/* qcom,suspend-ulps-enabled; */
		//qcom,mdss-dsi-pan-enable-dynamic-fps;
		qcom,mdss-dsi-pan-fps-update = "dfps_immediate_porch_mode_vfp";
		qcom,mdss-dsi-min-refresh-rate = <48>;
		qcom,mdss-dsi-max-refresh-rate = <60>;


		qcom,mdss-dsi-panel-color-temperature-command-ft8716-first = [
			15 01 00 00 00 00 02 00 00
			39 01 00 00 00 00 04 FF 87 16 01
			15 01 00 00 00 00 02 00 80
			39 01 00 00 00 00 03 FF 87 16
			//huyan
			15 01 00 00 00 00 02 00 80
			39 01 00 00 00 00 0d D8 81 84 84 85 86 87 88 88 87 86 84 00
			15 01 00 00 00 00 02 00 90
			39 01 00 00 00 00 0d D8 01 02 03 03 04 04 03 04 04 03 03 00
			15 01 00 00 00 00 02 00 A0
			39 01 00 00 00 00 0d D8 00 00 01 03 06 09 0d 12 19 1e 21 27
			15 01 00 00 00 00 02 00 B0
			39 01 00 00 00 00 0d D8 01 03 04 04 06 07 07 09 09 0a 0a 07
			15 01 00 00 00 00 02 00 C0
			39 01 00 00 00 00 0d D8 85 8b 8f 93 9c a4 ad b5 bf c6 c6 c4
			15 01 00 00 00 00 02 00 D0
			39 01 00 00 00 00 0d D8 06 0b 10 16 20 2a 35 40 4d 56 58 57
			15 01 00 00 00 00 02 00 E0
			39 01 00 00 00 00 04 D8 ff ee e0
			15 01 00 00 00 00 02 00 C0
			15 01 00 00 00 00 02 D7 01
			15 01 00 00 00 00 02 00 00
			//huyan end
			15 01 00 00 00 00 02 00 00
			39 01 00 00 00 00 04 ff 00 00 00
			15 01 00 00 00 00 02 00 80
			39 01 00 00 00 00 03 ff 00 00
			15 01 00 00 00 00 02 94 ff
		];

		qcom,mdss-dsi-panel-color-temperature-command = [
			15 01 00 00 00 00 02 94 ff
		];

		qcom,mdss-dsi-panel-color-temperature-command-restore-ft8716-first = [
			15 01 00 00 00 00 02 00 00
			39 01 00 00 00 00 04 FF 87 16 01
			15 01 00 00 00 00 02 00 80
			39 01 00 00 00 00 03 FF 87 16
			//eyecare config  
			15 01 00 00 00 00 02 00 80
			39 01 00 00 00 00 0d D8 81 84 84 85 86 87 88 88 87 86 84 00
			15 01 00 00 00 00 02 00 90
			39 01 00 00 00 00 0d D8 01 02 03 03 04 04 03 04 04 03 03 00
			15 01 00 00 00 00 02 00 A0
			39 01 00 00 00 00 0d D8 00 00 01 03 06 09 0d 12 19 1e 21 27
			15 01 00 00 00 00 02 00 B0
			39 01 00 00 00 00 0d D8 01 03 04 04 06 07 07 09 09 0a 0a 07
			15 01 00 00 00 00 02 00 C0
			39 01 00 00 00 00 0d D8 85 8b 8f 93 9c a4 ad b5 bf c6 c6 c4
			15 01 00 00 00 00 02 00 D0
			39 01 00 00 00 00 0d D8 06 0b 10 16 20 2a 35 40 4d 56 58 57
			15 01 00 00 00 00 02 00 E0
			39 01 00 00 00 00 04 D8 ff ee e0
			15 01 00 00 00 00 02 00 C0
			15 01 00 00 00 00 02 D7 01
			15 01 00 00 00 00 02 00 00
			//eyecare  end
			15 01 00 00 00 00 02 00 00
			39 01 00 00 00 00 04 ff 00 00 00
			15 01 00 00 00 00 02 00 80
			39 01 00 00 00 00 03 ff 00 00
			15 01 00 00 00 00 02 94 00
		];

		qcom,mdss-dsi-panel-color-temperature-command-restore = [
			15 01 00 00 00 00 02 94 00
		];
		
		qcom,mdss-dsi-panel-cabc-ui-mode-ft8716 = [
			15 01 00 00 00 00 02 00 00
			39 01 00 00 00 00 04 FF 87 16 01
			15 01 00 00 00 00 02 00 80
			39 01 00 00 00 00 03 FF 87 16
			//cabc
			15 01 00 00 00 00 02 00 80
			39 01 00 00 00 00 0b CA 80 b4 ff b4 ff b4 ff 00 00 00
			15 01 00 00 00 00 02 00 00 
			15 01 00 00 00 00 02 c6 10
			15 01 00 00 00 00 02 00 00
			39 01 00 00 00 00 13 C7 90 9a 9a 9a ba ab 99 a8 a9 a9 da 99 89 78 56 34 22 22
			15 01 00 00 00 00 02 00 00 
			15 01 00 00 00 00 02 c6 11
			15 01 00 00 00 00 02 00 00
			39 01 00 00 00 00 13 C7 90 9a 8a 9a b9 aa 99 99 9a 99 bb 9a 88 88 67 45 22 22
			15 01 00 00 00 00 02 00 00 
			15 01 00 00 00 00 02 c6 12
			15 01 00 00 00 00 02 00 00
			39 01 00 00 00 00 13 C7 90 99 9a 99 a9 9b 99 89 9a 99 ba 9a 88 88 67 45 33 23
			15 01 00 00 00 00 02 00 00 
			15 01 00 00 00 00 02 c6 13
			15 01 00 00 00 00 02 00 00
			39 01 00 00 00 00 13 C7 80 9a 8a 99 a9 9a 99 98 9a 89 aa 8b 89 88 78 45 33 33
			15 01 00 00 00 00 02 00 00 
			15 01 00 00 00 00 02 c6 14
			15 01 00 00 00 00 02 00 00
			39 01 00 00 00 00 13 C7 80 8a 8a 8a a9 9a 89 99 99 89 aa 9a 88 88 78 56 44 33
			15 01 00 00 00 00 02 00 00 
			15 01 00 00 00 00 02 c6 15
			15 01 00 00 00 00 02 00 00
			39 01 00 00 00 00 13 C7 80 99 99 89 a9 a9 89 89 99 89 a9 aa 87 88 88 56 44 44
			15 01 00 00 00 00 02 00 00 
			15 01 00 00 00 00 02 c6 16
			15 01 00 00 00 00 02 00 00
			39 01 00 00 00 00 13 C7 80 99 89 99 98 9a 98 98 99 89 a8 9a 88 88 88 67 45 44
			15 01 00 00 00 00 02 00 00 
			15 01 00 00 00 00 02 c6 17
			15 01 00 00 00 00 02 00 00
			39 01 00 00 00 00 13 C7 80 89 99 89 99 99 89 98 98 89 99 9a 88 88 88 67 55 45
			15 01 00 00 00 00 02 00 00 
			15 01 00 00 00 00 02 c6 18
			15 01 00 00 00 00 02 00 00
			39 01 00 00 00 00 13 C7 80 98 89 89 99 99 88 89 89 89 99 a9 88 88 88 68 55 55
			15 01 00 00 00 00 02 00 00 
			15 01 00 00 00 00 02 c6 19
			15 01 00 00 00 00 02 00 00
			39 01 00 00 00 00 13 C7 80 98 98 89 98 99 88 89 98 89 98 a9 88 88 88 78 56 55
			15 01 00 00 00 00 02 00 00 
			15 01 00 00 00 00 02 c6 1a
			15 01 00 00 00 00 02 00 00
			39 01 00 00 00 00 13 C7 80 88 99 88 98 99 88 98 88 89 98 99 88 88 88 78 66 66
			15 01 00 00 00 00 02 00 00 
			15 01 00 00 00 00 02 c6 1b
			15 01 00 00 00 00 02 00 00
			39 01 00 00 00 00 13 C7 80 88 89 88 89 a8 88 88 89 98 88 99 88 88 88 88 67 66
			15 01 00 00 00 00 02 00 00 
			15 01 00 00 00 00 02 c6 1c
			15 01 00 00 00 00 02 00 00
			39 01 00 00 00 00 13 C7 80 88 98 88 98 98 88 88 89 98 97 89 88 88 88 88 77 67
			15 01 00 00 00 00 02 00 00 
			15 01 00 00 00 00 02 c6 1d
			15 01 00 00 00 00 02 00 00
			39 01 00 00 00 00 13 C7 80 88 88 88 89 98 88 88 98 88 98 88 89 88 88 88 77 77
			15 01 00 00 00 00 02 00 00 
			15 01 00 00 00 00 02 c6 1e
			15 01 00 00 00 00 02 00 00
			39 01 00 00 00 00 13 C7 80 88 88 88 88 89 88 88 88 88 98 98 88 88 88 88 88 77
			15 01 00 00 00 00 02 00 00 
			15 01 00 00 00 00 02 c6 1f
			15 01 00 00 00 00 02 00 00
			39 01 00 00 00 00 13 C7 80 88 88 88 88 88 88 88 79 88 89 88 88 88 88 88 88 88
			15 01 00 00 00 00 02 00 00
			15 01 00 00 00 00 02 c6 00
			15 01 00 00 00 00 02 55 01
			//cabc end
			15 01 00 00 00 00 02 00 00
			39 01 00 00 00 00 04 ff 00 00 00
			15 01 00 00 00 00 02 00 80
			39 01 00 00 00 00 03 ff 00 00
		];

		qcom,mdss-dsi-panel-cabc-still-mode-ft8716 = [
			15 01 00 00 00 00 02 00 00
			39 01 00 00 00 00 04 FF 87 16 01
			15 01 00 00 00 00 02 00 80
			39 01 00 00 00 00 03 FF 87 16
			//cabc
			15 01 00 00 00 00 02 00 80
			39 01 00 00 00 00 0b CA 80 b4 ff b4 ff b4 ff 00 00 00
			15 01 00 00 00 00 02 00 00 
			15 01 00 00 00 00 02 c6 10
			15 01 00 00 00 00 02 00 00
			39 01 00 00 00 00 13 C7 90 9a 9a 9a ba ab 99 a8 a9 a9 da 99 89 78 56 34 22 22
			15 01 00 00 00 00 02 00 00 
			15 01 00 00 00 00 02 c6 11
			15 01 00 00 00 00 02 00 00
			39 01 00 00 00 00 13 C7 90 9a 8a 9a b9 aa 99 99 9a 99 bb 9a 88 88 67 45 22 22
			15 01 00 00 00 00 02 00 00 
			15 01 00 00 00 00 02 c6 12
			15 01 00 00 00 00 02 00 00
			39 01 00 00 00 00 13 C7 90 99 9a 99 a9 9b 99 89 9a 99 ba 9a 88 88 67 45 33 23
			15 01 00 00 00 00 02 00 00 
			15 01 00 00 00 00 02 c6 13
			15 01 00 00 00 00 02 00 00
			39 01 00 00 00 00 13 C7 80 9a 8a 99 a9 9a 99 98 9a 89 aa 8b 89 88 78 45 33 33
			15 01 00 00 00 00 02 00 00 
			15 01 00 00 00 00 02 c6 14
			15 01 00 00 00 00 02 00 00
			39 01 00 00 00 00 13 C7 80 8a 8a 8a a9 9a 89 99 99 89 aa 9a 88 88 78 56 44 33
			15 01 00 00 00 00 02 00 00 
			15 01 00 00 00 00 02 c6 15
			15 01 00 00 00 00 02 00 00
			39 01 00 00 00 00 13 C7 80 99 99 89 a9 a9 89 89 99 89 a9 aa 87 88 88 56 44 44
			15 01 00 00 00 00 02 00 00 
			15 01 00 00 00 00 02 c6 16
			15 01 00 00 00 00 02 00 00
			39 01 00 00 00 00 13 C7 80 99 89 99 98 9a 98 98 99 89 a8 9a 88 88 88 67 45 44
			15 01 00 00 00 00 02 00 00 
			15 01 00 00 00 00 02 c6 17
			15 01 00 00 00 00 02 00 00
			39 01 00 00 00 00 13 C7 80 89 99 89 99 99 89 98 98 89 99 9a 88 88 88 67 55 45
			15 01 00 00 00 00 02 00 00 
			15 01 00 00 00 00 02 c6 18
			15 01 00 00 00 00 02 00 00
			39 01 00 00 00 00 13 C7 80 98 89 89 99 99 88 89 89 89 99 a9 88 88 88 68 55 55
			15 01 00 00 00 00 02 00 00 
			15 01 00 00 00 00 02 c6 19
			15 01 00 00 00 00 02 00 00
			39 01 00 00 00 00 13 C7 80 98 98 89 98 99 88 89 98 89 98 a9 88 88 88 78 56 55
			15 01 00 00 00 00 02 00 00 
			15 01 00 00 00 00 02 c6 1a
			15 01 00 00 00 00 02 00 00
			39 01 00 00 00 00 13 C7 80 88 99 88 98 99 88 98 88 89 98 99 88 88 88 78 66 66
			15 01 00 00 00 00 02 00 00 
			15 01 00 00 00 00 02 c6 1b
			15 01 00 00 00 00 02 00 00
			39 01 00 00 00 00 13 C7 80 88 89 88 89 a8 88 88 89 98 88 99 88 88 88 88 67 66
			15 01 00 00 00 00 02 00 00 
			15 01 00 00 00 00 02 c6 1c
			15 01 00 00 00 00 02 00 00
			39 01 00 00 00 00 13 C7 80 88 98 88 98 98 88 88 89 98 97 89 88 88 88 88 77 67
			15 01 00 00 00 00 02 00 00 
			15 01 00 00 00 00 02 c6 1d
			15 01 00 00 00 00 02 00 00
			39 01 00 00 00 00 13 C7 80 88 88 88 89 98 88 88 98 88 98 88 89 88 88 88 77 77
			15 01 00 00 00 00 02 00 00 
			15 01 00 00 00 00 02 c6 1e
			15 01 00 00 00 00 02 00 00
			39 01 00 00 00 00 13 C7 80 88 88 88 88 89 88 88 88 88 98 98 88 88 88 88 88 77
			15 01 00 00 00 00 02 00 00 
			15 01 00 00 00 00 02 c6 1f
			15 01 00 00 00 00 02 00 00
			39 01 00 00 00 00 13 C7 80 88 88 88 88 88 88 88 79 88 89 88 88 88 88 88 88 88
			15 01 00 00 00 00 02 00 00
			15 01 00 00 00 00 02 c6 00
			15 01 00 00 00 00 02 55 02
			//cabc end
			15 01 00 00 00 00 02 00 00
			39 01 00 00 00 00 04 ff 00 00 00
			15 01 00 00 00 00 02 00 80
			39 01 00 00 00 00 03 ff 00 00
		];

		qcom,mdss-dsi-panel-cabc-moving-mode-ft8716 = [
			15 01 00 00 00 00 02 00 00
			39 01 00 00 00 00 04 FF 87 16 01
			15 01 00 00 00 00 02 00 80
			39 01 00 00 00 00 03 FF 87 16
			//gamma 2.2
			15 01 00 00 00 00 02 00 00
			39 01 00 00 00 00 19 E1 00 0a 23 38 42 4d 61 6e 74 7c 81 89 71 6d 6b 64 56 49 3b 31 26 14 04 03
			15 01 00 00 00 00 02 00 00
			39 01 00 00 00 00 19 E2 00 0a 23 38 42 4d 61 6e 74 7c 81 89 71 6d 6b 64 56 49 3b 31 26 14 04 03
			//end gamma
			//cabc
			//dfps setting start
			15 01 00 00 00 00 02 00 84
			15 01 00 00 00 00 02 A5 00
			//dfps setting end
			15 01 00 00 00 00 02 00 80
			39 01 00 00 00 00 0b CA 80 e5 ff cc ff 94 ff 00 00 00
 			15 01 00 00 00 00 02 00 00
 			15 01 00 00 00 00 02 C6 10  
 			15 01 00 00 00 00 02 00 00 
 			39 01 00 00 00 00 13 C7 90 9a 9a 9a ba ab 99 a8 a9 a9 da 99 89 78 56 34 22 22
 			15 01 00 00 00 00 02 00 00
 			15 01 00 00 00 00 02 C6 11  
 			15 01 00 00 00 00 02 00 00 
 			39 01 00 00 00 00 13 C7 90 9a 8a 9a b9 aa 99 99 9a 99 bb 9a 88 88 67 45 22 22
 			15 01 00 00 00 00 02 00 00
 			15 01 00 00 00 00 02 C6 12  
 			15 01 00 00 00 00 02 00 00 
 			39 01 00 00 00 00 13 C7 90 99 9a 99 a9 9b 99 89 9a 99 ba 9a 88 88 67 45 33 23
 			15 01 00 00 00 00 02 00 00
 			15 01 00 00 00 00 02 C6 13  
 			15 01 00 00 00 00 02 00 00 
 			39 01 00 00 00 00 13 C7 80 9a 8a 99 a9 9a 99 98 9a 89 aa 8b 89 88 78 45 33 33
 			15 01 00 00 00 00 02 00 00
 			15 01 00 00 00 00 02 C6 14  
 			15 01 00 00 00 00 02 00 00 
 			39 01 00 00 00 00 13 C7 80 8a 8a 8a a9 9a 89 99 99 89 aa 9a 88 88 78 56 44 33
 			15 01 00 00 00 00 02 00 00
 			15 01 00 00 00 00 02 C6 15  
 			15 01 00 00 00 00 02 00 00 
 			39 01 00 00 00 00 13 C7 80 99 99 89 a9 a9 89 89 99 89 a9 aa 87 88 88 56 44 44
 			15 01 00 00 00 00 02 00 00
 			15 01 00 00 00 00 02 C6 16  
 			15 01 00 00 00 00 02 00 00 
 			39 01 00 00 00 00 13 C7 80 99 89 99 98 9a 98 98 99 89 a8 9a 88 88 88 67 45 44
 			15 01 00 00 00 00 02 00 00
 			15 01 00 00 00 00 02 C6 17  
 			15 01 00 00 00 00 02 00 00 
 			39 01 00 00 00 00 13 C7 80 89 99 89 99 99 89 98 98 89 99 9a 88 88 88 67 55 45
 			15 01 00 00 00 00 02 00 00
 			15 01 00 00 00 00 02 C6 18  
 			15 01 00 00 00 00 02 00 00 
 			39 01 00 00 00 00 13 C7 80 98 89 89 99 99 88 89 89 89 99 a9 88 88 88 68 55 55
 			15 01 00 00 00 00 02 00 00
 			15 01 00 00 00 00 02 C6 19  
 			15 01 00 00 00 00 02 00 00 
 			39 01 00 00 00 00 13 C7 80 98 98 89 98 99 88 89 98 89 98 a9 88 88 88 78 56 55
 			15 01 00 00 00 00 02 00 00
 			15 01 00 00 00 00 02 C6 1a 
 			15 01 00 00 00 00 02 00 00 
 			39 01 00 00 00 00 13 C7 80 88 99 88 98 99 88 98 88 89 98 99 88 88 88 78 66 66
 			15 01 00 00 00 00 02 00 00
 			15 01 00 00 00 00 02 C6 1b  
 			15 01 00 00 00 00 02 00 00 
 			39 01 00 00 00 00 13 C7 80 88 89 88 89 a8 88 88 89 98 88 99 88 88 88 88 67 66
 			15 01 00 00 00 00 02 00 00
 			15 01 00 00 00 00 02 C6 1c  
 			15 01 00 00 00 00 02 00 00 
 			39 01 00 00 00 00 13 C7 80 88 98 88 98 98 88 88 89 98 97 89 88 88 88 88 77 67
 			15 01 00 00 00 00 02 00 00
 			15 01 00 00 00 00 02 C6 1d  
 			15 01 00 00 00 00 02 00 00 
 			39 01 00 00 00 00 13 C7 80 88 88 88 89 98 88 88 98 88 98 88 89 88 88 88 77 77
 			15 01 00 00 00 00 02 00 00
 			15 01 00 00 00 00 02 C6 1e  
 			15 01 00 00 00 00 02 00 00 
 			39 01 00 00 00 00 13 C7 80 88 88 88 88 89 88 88 88 88 98 98 88 88 88 88 88 77
 			15 01 00 00 00 00 02 00 00
 			15 01 00 00 00 00 02 C6 1f 
 			15 01 00 00 00 00 02 00 00 
 			39 01 00 00 00 00 13 C7 80 88 88 88 88 88 88 88 79 88 89 88 88 88 88 88 88 88
 			15 01 00 00 00 00 02 00 00
 			15 01 00 00 00 00 02 C6 00
			15 01 00 00 00 00 02 55 03
			//cabc end
			//CE start
			15 01 00 00 00 00 02 00 A0
			39 01 00 00 00 00 0d D6 08 0d 0f 0f 0f 13 11 10 0f 14 12 10
			15 01 00 00 00 00 02 00 B0
			39 01 00 00 00 00 0d D6 80 80 8d 9a 9a 9a 9a 9a 98 a0 c0 a0
			15 01 00 00 00 00 02 00 C0
			39 01 00 00 00 00 0d D6 90 80 91 91 91 91 91 91 90 95 ab 95
			15 01 00 00 00 00 02 00 D0
			39 01 00 00 00 00 0d D6 90 89 89 89 89 89 89 89 88 8b 95 8b		
			//CE end
			15 01 00 00 00 00 02 00 00
			39 01 00 00 00 00 04 ff 00 00 00
			15 01 00 00 00 00 02 00 80
			39 01 00 00 00 00 03 ff 00 00
			//enable CE
			39 01 00 00 00 00 03 91 80 00
		];

		qcom,mdss-dsi-panel-sre-weak-level = [
			15 01 00 00 00 00 02 92 80
		];

		qcom,mdss-dsi-panel-sre-middle-level = [
			15 01 00 00 00 00 02 92 81
		];

		qcom,mdss-dsi-panel-sre-strong-level = [
			15 01 00 00 00 00 02 92 82
		];

		qcom,mdss-dsi-panel-sre-exit = [
			15 01 00 00 00 00 02 92 00
		];

		qcom,mdss-dsi-on-command = [
			15 01 00 00 00 00 02 00 00
			39 01 00 00 00 00 04 FF 87 16 01
			15 01 00 00 00 00 02 00 80
			39 01 00 00 00 00 03 FF 87 16
			//gamma 2.2
			15 01 00 00 00 00 02 00 00
			39 01 00 00 00 00 19 E1 00 0a 23 38 42 4d 61 6e 74 7c 81 89 71 6d 6b 64 56 49 3b 31 26 14 04 03
			15 01 00 00 00 00 02 00 00
			39 01 00 00 00 00 19 E2 00 0a 23 38 42 4d 61 6e 74 7c 81 89 71 6d 6b 64 56 49 3b 31 26 14 04 03
			//end gamma
			//dfps setting start
			15 01 00 00 00 00 02 00 84
			15 01 00 00 00 00 02 A5 00
			//dfps setting end
			//cabc start
 			15 01 00 00 00 00 02 00 80
			39 01 00 00 00 00 0b CA 80 e5 ff cc ff 94 ff 00 00 00
 			15 01 00 00 00 00 02 00 00
 			15 01 00 00 00 00 02 C6 10  
 			15 01 00 00 00 00 02 00 00 
 			39 01 00 00 00 00 13 C7 90 9a 9a 9a ba ab 99 a8 a9 a9 da 99 89 78 56 34 22 22
 			15 01 00 00 00 00 02 00 00
 			15 01 00 00 00 00 02 C6 11  
 			15 01 00 00 00 00 02 00 00 
 			39 01 00 00 00 00 13 C7 90 9a 8a 9a b9 aa 99 99 9a 99 bb 9a 88 88 67 45 22 22
 			15 01 00 00 00 00 02 00 00
 			15 01 00 00 00 00 02 C6 12  
 			15 01 00 00 00 00 02 00 00 
 			39 01 00 00 00 00 13 C7 90 99 9a 99 a9 9b 99 89 9a 99 ba 9a 88 88 67 45 33 23
 			15 01 00 00 00 00 02 00 00
 			15 01 00 00 00 00 02 C6 13  
 			15 01 00 00 00 00 02 00 00 
 			39 01 00 00 00 00 13 C7 80 9a 8a 99 a9 9a 99 98 9a 89 aa 8b 89 88 78 45 33 33
 			15 01 00 00 00 00 02 00 00
 			15 01 00 00 00 00 02 C6 14  
 			15 01 00 00 00 00 02 00 00 
 			39 01 00 00 00 00 13 C7 80 8a 8a 8a a9 9a 89 99 99 89 aa 9a 88 88 78 56 44 33
 			15 01 00 00 00 00 02 00 00
 			15 01 00 00 00 00 02 C6 15  
 			15 01 00 00 00 00 02 00 00 
 			39 01 00 00 00 00 13 C7 80 99 99 89 a9 a9 89 89 99 89 a9 aa 87 88 88 56 44 44
 			15 01 00 00 00 00 02 00 00
 			15 01 00 00 00 00 02 C6 16  
 			15 01 00 00 00 00 02 00 00 
 			39 01 00 00 00 00 13 C7 80 99 89 99 98 9a 98 98 99 89 a8 9a 88 88 88 67 45 44
 			15 01 00 00 00 00 02 00 00
 			15 01 00 00 00 00 02 C6 17  
 			15 01 00 00 00 00 02 00 00 
 			39 01 00 00 00 00 13 C7 80 89 99 89 99 99 89 98 98 89 99 9a 88 88 88 67 55 45
 			15 01 00 00 00 00 02 00 00
 			15 01 00 00 00 00 02 C6 18  
 			15 01 00 00 00 00 02 00 00 
 			39 01 00 00 00 00 13 C7 80 98 89 89 99 99 88 89 89 89 99 a9 88 88 88 68 55 55
 			15 01 00 00 00 00 02 00 00
 			15 01 00 00 00 00 02 C6 19  
 			15 01 00 00 00 00 02 00 00 
 			39 01 00 00 00 00 13 C7 80 98 98 89 98 99 88 89 98 89 98 a9 88 88 88 78 56 55
 			15 01 00 00 00 00 02 00 00
 			15 01 00 00 00 00 02 C6 1a 
 			15 01 00 00 00 00 02 00 00 
 			39 01 00 00 00 00 13 C7 80 88 99 88 98 99 88 98 88 89 98 99 88 88 88 78 66 66
 			15 01 00 00 00 00 02 00 00
 			15 01 00 00 00 00 02 C6 1b  
 			15 01 00 00 00 00 02 00 00 
 			39 01 00 00 00 00 13 C7 80 88 89 88 89 a8 88 88 89 98 88 99 88 88 88 88 67 66
 			15 01 00 00 00 00 02 00 00
 			15 01 00 00 00 00 02 C6 1c  
 			15 01 00 00 00 00 02 00 00 
 			39 01 00 00 00 00 13 C7 80 88 98 88 98 98 88 88 89 98 97 89 88 88 88 88 77 67
 			15 01 00 00 00 00 02 00 00
 			15 01 00 00 00 00 02 C6 1d  
 			15 01 00 00 00 00 02 00 00 
 			39 01 00 00 00 00 13 C7 80 88 88 88 89 98 88 88 98 88 98 88 89 88 88 88 77 77
 			15 01 00 00 00 00 02 00 00
 			15 01 00 00 00 00 02 C6 1e  
 			15 01 00 00 00 00 02 00 00 
 			39 01 00 00 00 00 13 C7 80 88 88 88 88 89 88 88 88 88 98 98 88 88 88 88 88 77
 			15 01 00 00 00 00 02 00 00
 			15 01 00 00 00 00 02 C6 1f 
 			15 01 00 00 00 00 02 00 00 
 			39 01 00 00 00 00 13 C7 80 88 88 88 88 88 88 88 79 88 89 88 88 88 88 88 88 88
 			15 01 00 00 00 00 02 00 00
 			15 01 00 00 00 00 02 C6 00  
			//cabc end
			//sre
			15 01 00 00 00 00 02 00 01
			15 01 00 00 00 00 02 C6 10
			15 01 00 00 00 00 02 00 00
			39 01 00 00 00 00 13 c8 90 78 56 34 33 33 33 33 33 33 43 44 43 44 44 44 44 54
			15 01 00 00 00 00 02 00 01
			15 01 00 00 00 00 02 C6 11
			15 01 00 00 00 00 02 00 00
			39 01 00 00 00 00 13 c8 c0 8a 57 34 33 33 33 33 33 33 33 33 33 33 44 44 44 44 
			15 01 00 00 00 00 02 00 01
			15 01 00 00 00 00 02 C6 12
			15 01 00 00 00 00 02 00 00
			39 01 00 00 00 00 13 c8 f0 9d 57 33 33 33 33 33 33 33 23 32 23 22 44 44 44 34
			39 01 00 00 00 00 02 00 01
			39 01 00 00 00 00 02 c6 00
			//sre end
			//huyan
			15 01 00 00 00 00 02 00 80
			39 01 00 00 00 00 0d D8 81 84 84 85 86 87 88 88 87 86 84 00
			15 01 00 00 00 00 02 00 90
			39 01 00 00 00 00 0d D8 01 02 03 03 04 04 03 04 04 03 03 00
			15 01 00 00 00 00 02 00 A0
			39 01 00 00 00 00 0d D8 00 00 01 03 06 09 0d 12 19 1e 21 27
			15 01 00 00 00 00 02 00 B0
			39 01 00 00 00 00 0d D8 01 03 04 04 06 07 07 09 09 0a 0a 07
			15 01 00 00 00 00 02 00 C0
			39 01 00 00 00 00 0d D8 85 8b 8f 93 9c a4 ad b5 bf c6 c6 c4
			15 01 00 00 00 00 02 00 D0
			39 01 00 00 00 00 0d D8 06 0b 10 16 20 2a 35 40 4d 56 58 57
			15 01 00 00 00 00 02 00 E0
			39 01 00 00 00 00 04 D8 ff ee e0
			15 01 00 00 00 00 02 00 C0
			15 01 00 00 00 00 02 D7 01
			15 01 00 00 00 00 02 00 00
			//huyan end
			//CE start
			15 01 00 00 00 00 02 00 A0
			39 01 00 00 00 00 0d D6 08 0d 0f 0f 0f 13 11 10 0f 14 12 10
			15 01 00 00 00 00 02 00 B0
			39 01 00 00 00 00 0d D6 80 80 8d 9a 9a 9a 9a 9a 98 a0 c0 a0
			15 01 00 00 00 00 02 00 C0
			39 01 00 00 00 00 0d D6 90 80 91 91 91 91 91 91 90 95 ab 95
			15 01 00 00 00 00 02 00 D0
			39 01 00 00 00 00 0d D6 90 89 89 89 89 89 89 89 88 8b 95 8b		
			//CE end
			15 01 00 00 00 00 02 00 00
			39 01 00 00 00 00 04 ff 00 00 00
			15 01 00 00 00 00 02 00 80
			39 01 00 00 00 00 03 ff 00 00
			//enable CE
			39 01 00 00 00 00 03 91 80 00
			15 01 00 00 00 00 02 51 FF
			15 01 00 00 00 00 02 53 2c
			15 01 00 00 00 00 02 55 03
			05 01 00 00 80 00 02 11 00
			05 01 00 00 20 00 02 29 00];
		qcom,mdss-dsi-off-command = [05 01 00 00 32 00 02 28 00
					05 01 00 00 78 00 02 10 00];
		qcom,mdss-dsi-on-command-state = "dsi_lp_mode";
		qcom,mdss-dsi-off-command-state = "dsi_hs_mode";
		qcom,mdss-dsi-h-sync-pulse = <1>;
		qcom,mdss-dsi-traffic-mode = "burst_mode";
		//qcom,mdss-dsi-lane-map = "lane_map_0123";
		qcom,mdss-dsi-bllp-eof-power-mode;
		qcom,mdss-dsi-bllp-power-mode;
		qcom,mdss-dsi-lane-0-state;
		qcom,mdss-dsi-lane-1-state;
		qcom,mdss-dsi-lane-2-state;
		qcom,mdss-dsi-lane-3-state;
		qcom,mdss-dsi-panel-timings = [bf 38 26 01 68 6e 2a 3c 2c 03 04 00];
		qcom,mdss-dsi-t-clk-post = <0x0d>;
		qcom,mdss-dsi-t-clk-pre = <0x30>;
		qcom,mdss-dsi-bl-min-level = <1>;
		qcom,mdss-dsi-bl-max-level = <4095>;
		qcom,mdss-dsi-dma-trigger = "trigger_sw";
		qcom,mdss-dsi-mdp-trigger = "none";
		qcom,mdss-dsi-bl-pmic-control-type = "bl_ctrl_wled";
		qcom,mdss-dsi-reset-sequence = <1 2>, <0 2>, <1 3>;
		qcom,mdss-pan-physical-width-dimension = <68>;
		qcom,mdss-pan-physical-height-dimension = <121>;
		//qcom,mdss-dsi-tx-eot-append;
		//qcom,mdss-dsi-post-init-delay = <1>;
	};
};
