&dsi_sharp_1080p_cmd {
	qcom,mdss-dsi-on-command = [
					15 01 00 00 00 00 02 ff 23
					15 01 00 00 00 00 02 fb 01
					13 01 00 00 00 00 02 08 02
					13 01 00 00 00 00 02 46 45
					15 01 00 00 00 00 02 ff 10
					15 01 00 00 00 00 02 bb 10
					15 01 00 00 00 00 02 b0 03
					29 01 00 00 00 00 06 3b 03 06 04 4e 80
					15 01 00 00 00 00 02 ff 20
					15 01 00 00 00 00 02 fb 01
					15 01 00 00 00 00 02 30 66
					15 01 00 00 00 00 02 ff 24
					15 01 00 00 00 00 02 fb 01
					15 01 00 00 00 00 02 2d 00
					15 01 00 00 00 00 02 ff 10
					05 01 00 00 64 00 02 11 00
					05 01 00 00 28 00 02 29 00
					15 01 00 00 00 00 02 51 ff
					15 01 00 00 00 00 02 53 2c
					15 01 00 00 00 00 02 55 03];
	qcom,mdss-dsi-reset-sequence = <1 1>, <0 1>, <1 50>;
};
