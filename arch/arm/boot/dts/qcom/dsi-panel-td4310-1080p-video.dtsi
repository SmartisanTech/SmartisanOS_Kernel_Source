/* Copyright (c) 2015-2016, The Linux Foundation. All rights reserved.
 *
 * This program is free software; you can redistribute it and/or modify
 * it under the terms of the GNU General Public License version 2 and
 * only version 2 as published by the Free Software Foundation.
 *
 * This program is distributed in the hope that it will be useful,
 * but WITHOUT ANY WARRANTY; without even the implied warranty of
 * MERCHANTABILITY or FITNESS FOR A PARTICULAR PURPOSE.  See the
 * GNU General Public License for more details.
 */

&mdss_mdp {
	dsi_td4310_1080p_vid: qcom,mdss_dsi_td4310_tcl_1080p_video {

		qcom,mdss-dsi-panel-name = "td4310 1080p  video mode dsi panel";
		qcom,mdss-dsi-panel-controller = <&mdss_dsi0>;
		qcom,mdss-dsi-panel-type = "dsi_video_mode";
		qcom,mdss-dsi-panel-destination = "display_1";
		qcom,mdss-dsi-panel-framerate = <58>;
		qcom,mdss-dsi-virtual-channel-id = <0>;
		qcom,mdss-dsi-stream = <0>;
		qcom,mdss-dsi-panel-width = <1080>;
		qcom,mdss-dsi-panel-height = <2160>;
		qcom,mdss-dsi-h-front-porch = <320>;
		qcom,mdss-dsi-h-back-porch = <20>;
		qcom,mdss-dsi-h-pulse-width = <2>;
		qcom,mdss-dsi-h-sync-skew = <0>;
		qcom,mdss-dsi-v-back-porch = <31>;
		qcom,mdss-dsi-v-front-porch = <4>;
		qcom,mdss-dsi-v-pulse-width = <2>;
		qcom,mdss-dsi-h-left-border = <0>;
		qcom,mdss-dsi-h-right-border = <0>;
		qcom,mdss-dsi-v-top-border = <0>;
		qcom,mdss-dsi-v-bottom-border = <0>;
		qcom,mdss-dsi-bpp = <24>;
		qcom,mdss-dsi-color-order = "rgb_swap_rgb";
		qcom,mdss-dsi-underflow-color = <0xff>;
		qcom,mdss-dsi-border-color = <0>;
		qcom,mdss-dsi-h-sync-pulse = <1>;
		qcom,mdss-dsi-traffic-mode = "burst_mode";
		qcom,mdss-dsi-lane-map = "lane_map_0123";
		qcom,mdss-dsi-hfp-power-mode;
		//qcom,mdss-dsi-force-clock-lane-hs;
		qcom,mdss-dsi-bllp-eof-power-mode;
		qcom,mdss-dsi-bllp-power-mode;
		//qcom,mdss-dsi-lp11-init;
		//qcom,mdss-dsi-init-delay-us = <30000>;
		qcom,mdss-dsi-lane-0-state;
		qcom,mdss-dsi-lane-1-state;
		qcom,mdss-dsi-lane-2-state;
		qcom,mdss-dsi-lane-3-state;
		//qcom,mdss-dsi-panel-timings = [24 1b 08 09 05 24 1f 08 09 05 03 04];
		qcom,mdss-dsi-panel-timings = [EE 38 26 00 6A 6C 2C 3C 2C 03 04 00];
		qcom,mdss-dsi-t-clk-post = <0x2d>;
		qcom,mdss-dsi-t-clk-pre = <0x31>;
		qcom,ulps-enabled;
		qcom,suspend-ulps-enabled;
		qcom,mdss-dsi-bl-min-level = <1>;
		qcom,mdss-dsi-bl-max-level = <4095>;
		qcom,mdss-dsi-dma-trigger = "trigger_sw";
		qcom,mdss-dsi-mdp-trigger = "none";

		qcom,mdss-dsi-panel-color-temperature-command = [
			29 01 00 00 00 00 02 b0 04
			15 01 00 00 00 00 02 51 ff
			15 01 00 00 00 00 02 53 2C
			15 01 00 00 00 00 02 55 82
			//29 01 00 00 26 00 2c CA 1D FC FC FC 00 2B 1D 14 00 F5 40 00 00 13 DB 00 00 07 17 F1 00 F5 9F 6B 61 A1 6B 59 4D 00 00 00 00 00 00 00 00 00 00 00 00 00 00  ->CE in paper mode
			29 01 00 00 26 00 2c CA 1D FC FC FC 00 15 03 0B 00 CF 40 00 00 2F 00 F9 00 07 17 FC 00 D0 9F 6B 61 A0 6F 4E 4D 00 C5 F2 55 BF FF 4E 00 00 00 00 00 00 00  //->CE in paper mode,updated on 20180306
			29 01 00 00 26 00 13 C8 03 00 00 00 00 FC 00 00 00 00 00 FC 00 00 00 00 00 FC
			29 01 00 00 26 00 13 C8 03 00 00 00 00 FC 00 00 00 00 00 FA 00 00 00 00 00 FA
			29 01 00 00 26 00 13 C8 03 00 00 00 00 FC 00 00 00 00 00 F8 00 00 00 00 00 F6
			29 01 00 00 26 00 13 C8 03 00 00 00 00 FC 00 00 00 00 00 F6 00 00 00 00 00 F2
			29 01 00 00 26 00 13 C8 03 00 00 00 00 FC 00 00 00 00 00 F4 00 00 00 00 00 EE
			29 01 00 00 26 00 13 C8 03 00 00 00 00 FC 00 00 00 00 00 F2 00 00 00 00 00 EA
			29 01 00 00 26 00 13 C8 03 00 00 00 00 FC 00 00 00 00 00 F1 00 00 00 00 00 E6
			29 01 00 00 26 00 13 C8 03 00 00 00 00 FC 00 00 00 00 00 F0 00 00 00 00 00 E2
			29 01 00 00 26 00 13 C8 03 00 00 00 00 FC 00 00 00 00 00 EF 00 00 00 00 00 DE
			29 01 00 00 26 00 13 C8 03 00 00 00 00 FC 00 00 00 00 00 EE 00 00 00 00 00 DA
			29 01 00 00 26 00 13 C8 03 00 00 00 00 FD 00 00 00 00 00 ED 00 00 00 00 00 D6
			29 01 00 00 26 00 13 C8 03 00 00 00 00 FD 00 00 00 00 00 EC 00 00 00 00 00 D2
			29 01 00 00 26 00 13 C8 03 00 00 00 00 FD 00 00 00 00 00 EB 00 00 00 00 00 CE
			29 01 00 00 26 00 13 C8 03 00 00 00 00 FD 00 00 00 00 00 EA 00 00 00 00 00 CA
			29 01 00 00 26 00 13 C8 03 00 00 00 00 FD 00 00 00 00 00 E9 00 00 00 00 00 C6
			29 01 00 00 26 00 13 C8 03 00 00 00 00 FD 00 00 00 00 00 E8 00 00 00 00 00 C2
			29 01 00 00 26 00 13 C8 03 00 00 00 00 FD 00 00 00 00 00 E7 00 00 00 00 00 BE
			29 01 00 00 26 00 13 C8 03 00 00 00 00 FD 00 00 00 00 00 E6 00 00 00 00 00 BA
			29 01 00 00 26 00 13 C8 03 00 00 00 00 FD 00 00 00 00 00 E5 00 00 00 00 00 B6
			29 01 00 00 26 00 13 C8 03 00 00 00 00 FD 00 00 00 00 00 E4 00 00 00 00 00 B2
			29 01 00 00 26 00 13 C8 03 00 00 00 00 FE 00 00 00 00 00 E3 00 00 00 00 00 AE
			29 01 00 00 26 00 13 C8 03 00 00 00 00 FE 00 00 00 00 00 E2 00 00 00 00 00 AA
			29 01 00 00 26 00 13 C8 03 00 00 00 00 FE 00 00 00 00 00 E1 00 00 00 00 00 A6
			29 01 00 00 26 00 13 C8 03 00 00 00 00 FE 00 00 00 00 00 E0 00 00 00 00 00 A2
			29 01 00 00 26 00 13 C8 03 00 00 00 00 FE 00 00 00 00 00 DF 00 00 00 00 00 9E
			29 01 00 00 26 00 13 C8 03 00 00 00 00 FE 00 00 00 00 00 DE 00 00 00 00 00 9A
			29 01 00 00 26 00 13 C8 03 00 00 00 00 FE 00 00 00 00 00 DD 00 00 00 00 00 96
			29 01 00 00 26 00 13 C8 03 00 00 00 00 FE 00 00 00 00 00 DC 00 00 00 00 00 92
			29 01 00 00 00 00 08 B8 67 4B 06 00 04 00 00
			29 01 00 00 00 00 08 B9 99 4B 07 00 07 00 00
			29 01 00 00 00 00 08 BA BB 43 17 00 09 00 00
			29 01 00 00 00 00 02 B0 03
		];

		qcom,mdss-dsi-panel-color-temperature-command_resume = [
			29 01 00 00 00 00 02 b0 04
			//29 01 00 00 26 00 2c CA 1D FC FC FC 00 2B 1D 14 00 F5 40 00 00 13 DB 00 00 07 17 F1 00 F5 9F 6B 61 A1 6B 59 4D 00 00 00 00 00 00 00 00 00 00 00 00 00 00  ->CE in paper mode
			29 01 00 00 26 00 2c CA 1D FC FC FC 00 15 03 0B 00 CF 40 00 00 2F 00 F9 00 07 17 FC 00 D0 9F 6B 61 A0 6F 4E 4D 00 C5 F2 55 BF FF 4E 00 00 00 00 00 00 00  //->CE in paper mode,updated on 20180306
			29 01 00 00 00 00 13 C8 03 00 00 00 00 FE 00 00 00 00 00 DC 00 00 00 00 00 92
			29 01 00 00 00 00 08 B8 67 4B 06 00 04 00 00
			29 01 00 00 00 00 08 B9 99 4B 07 00 07 00 00
			29 01 00 00 00 00 08 BA BB 43 17 00 09 00 00
			29 01 00 00 00 00 02 b0 03
		];

		qcom,mdss-dsi-panel-color-temperature-command-restore = [
			29 01 00 00 00 00 02 b0 04
			15 01 00 00 00 00 02 51 ff
			15 01 00 00 00 00 02 53 2C
			15 01 00 00 00 00 02 55 82
			//29 01 00 00 00 00 2C CA 1D FC FC FC 00 12 00 14 00 F5 F5 F5 00 13 DB 00 ED C5 00 F1 00 F5 9F 6B 61 A1 6B 59 4D 00 00 00 00 00 00 00 00 00 00 00 00 00 00  ->CE in normal mode
			//29 01 00 00 00 00 2C CA 1D FC FC FC 00 15 03 0B 00 CF F5 F7 00 2F 00 F9 F9 F9 00 FC 00 D0 9F 6B 61 A1 6B 59 4D 00 C5 F2 55 BF FF 4E 00 00 00 00 00 00 00  ->CE in normal mode,updated on 20180228
			29 01 00 00 00 00 2C CA 1D FC FC FC 00 15 03 0B 00 CF E5 E7 00 2F 00 F9 F9 F9 00 FC 00 D0 9F 6B 61 A0 6F 58 4D 00 C5 F2 55 BF FF 4E 00 00 00 00 00 00 00  //->CE in normal mode,updated on 20180306
			29 01 00 00 26 00 13 C8 03 00 00 00 00 FE 00 00 00 00 00 DC 00 00 00 00 00 92
			29 01 00 00 26 00 13 C8 03 00 00 00 00 FE 00 00 00 00 00 DD 00 00 00 00 00 96
			29 01 00 00 26 00 13 C8 03 00 00 00 00 FE 00 00 00 00 00 DE 00 00 00 00 00 9A
			29 01 00 00 26 00 13 C8 03 00 00 00 00 FE 00 00 00 00 00 DF 00 00 00 00 00 9E
			29 01 00 00 26 00 13 C8 03 00 00 00 00 FE 00 00 00 00 00 E0 00 00 00 00 00 A2
			29 01 00 00 26 00 13 C8 03 00 00 00 00 FE 00 00 00 00 00 E1 00 00 00 00 00 A6
			29 01 00 00 26 00 13 C8 03 00 00 00 00 FE 00 00 00 00 00 E2 00 00 00 00 00 AA
			29 01 00 00 26 00 13 C8 03 00 00 00 00 FE 00 00 00 00 00 E3 00 00 00 00 00 AE
			29 01 00 00 26 00 13 C8 03 00 00 00 00 FD 00 00 00 00 00 E4 00 00 00 00 00 B2
			29 01 00 00 26 00 13 C8 03 00 00 00 00 FD 00 00 00 00 00 E5 00 00 00 00 00 B6
			29 01 00 00 26 00 13 C8 03 00 00 00 00 FD 00 00 00 00 00 E6 00 00 00 00 00 BA
			29 01 00 00 26 00 13 C8 03 00 00 00 00 FD 00 00 00 00 00 E7 00 00 00 00 00 BE
			29 01 00 00 26 00 13 C8 03 00 00 00 00 FD 00 00 00 00 00 E8 00 00 00 00 00 C2
			29 01 00 00 26 00 13 C8 03 00 00 00 00 FD 00 00 00 00 00 E9 00 00 00 00 00 C6
			29 01 00 00 26 00 13 C8 03 00 00 00 00 FD 00 00 00 00 00 EA 00 00 00 00 00 CA
			29 01 00 00 26 00 13 C8 03 00 00 00 00 FD 00 00 00 00 00 EB 00 00 00 00 00 CE
			29 01 00 00 26 00 13 C8 03 00 00 00 00 FD 00 00 00 00 00 EC 00 00 00 00 00 D2
			29 01 00 00 26 00 13 C8 03 00 00 00 00 FD 00 00 00 00 00 ED 00 00 00 00 00 D6
			29 01 00 00 26 00 13 C8 03 00 00 00 00 FC 00 00 00 00 00 EE 00 00 00 00 00 DA
			29 01 00 00 26 00 13 C8 03 00 00 00 00 FC 00 00 00 00 00 EF 00 00 00 00 00 DE
			29 01 00 00 26 00 13 C8 03 00 00 00 00 FC 00 00 00 00 00 F0 00 00 00 00 00 E2
			29 01 00 00 26 00 13 C8 03 00 00 00 00 FC 00 00 00 00 00 F1 00 00 00 00 00 E6
			29 01 00 00 26 00 13 C8 03 00 00 00 00 FC 00 00 00 00 00 F2 00 00 00 00 00 EA
			29 01 00 00 26 00 13 C8 03 00 00 00 00 FC 00 00 00 00 00 F4 00 00 00 00 00 EE
			29 01 00 00 26 00 13 C8 03 00 00 00 00 FC 00 00 00 00 00 F6 00 00 00 00 00 F2
			29 01 00 00 26 00 13 C8 03 00 00 00 00 FC 00 00 00 00 00 F8 00 00 00 00 00 F6
			29 01 00 00 26 00 13 C8 03 00 00 00 00 FC 00 00 00 00 00 FA 00 00 00 00 00 FA
			29 01 00 00 26 00 13 C8 03 00 00 00 00 FC 00 00 00 00 00 FC 00 00 00 00 00 FC
			29 01 00 00 26 00 13 C8 00 00 00 00 00 FC 00 00 00 00 00 FC 00 00 00 00 00 FC
			29 01 00 00 00 00 08 B8 67 4B 06 00 04 00 00
			29 01 00 00 00 00 08 B9 99 4B 10 00 07 00 00
			29 01 00 00 00 00 08 BA BB 43 17 00 09 00 00
			29 01 00 00 00 00 02 B0 03
		];
		qcom,mdss-dsi-panel-cabc-ui-mode-td4310 = [
			29 01 00 00 00 00 02 B0 04
			29 01 00 00 00 00 02 D6 01
			15 01 00 00 00 00 02 51 ff
			15 01 00 00 00 00 02 53 2C
			15 01 00 00 00 00 02 55 81
			//29 01 00 00 00 00 27 C7 06 1C 2B 3E 4E 5A 73 84 91 9D 4F 5B 6A 7E 87 93 A0 AA B2 06 1B 2A 3D 4D 59 72 83 91 9D 4F 5B 6A 7E 87 93 A0 AA B2 //gamma 2.3
			29 01 00 00 00 00 27 C7 0a 21 2d 3e 4c 57 70 80 8d 99 4c 58 67 7b 84 8f 9d a8 b4 0a 21 2d 3e 4c 57 70 80 8d 99 4c 58 67 7b 84 8f 9d a8 b4 //gamma 2.2
			29 01 00 00 00 00 14 C8 00 00 00 00 00 FC 00 00 00 00 00 FC 00 00 00 00 00 FC 00
			29 01 00 00 00 00 08 B8 67 4B 06 00 04 00 00
			29 01 00 00 00 00 08 B9 99 4B 10 00 07 00 00
			29 01 00 00 00 00 08 BA BB 43 17 00 09 00 00
			29 01 00 00 00 00 1a CE 55 40 60 78 87 94 9E AB B8 C4 CD D6 DE E5 EC F3 FF 00 E3 04 04 42 04 69 5A
			//29 01 00 00 00 00 2C CA 1D FC FC FC 00 12 00 14 00 F5 F5 F5 00 13 DB 00 ED C5 00 F1 00 F5 9F 6B 61 A1 6B 59 4D 00 00 00 00 00 00 00 00 00 00 00 00 00 00  ->CE in normal mode
			//29 01 00 00 00 00 2C CA 1D FC FC FC 00 15 03 0B 00 CF F5 F7 00 2F 00 F9 F9 F9 00 FC 00 D0 9F 6B 61 A1 6B 59 4D 00 C5 F2 55 BF FF 4E 00 00 00 00 00 00 00  ->CE in normal mode,updated on 20180228
			29 01 00 00 00 00 2C CA 1D FC FC FC 00 15 03 0B 00 CF E5 E7 00 2F 00 F9 F9 F9 00 FC 00 D0 9F 6B 61 A0 6F 58 4D 00 C5 F2 55 BF FF 4E 00 00 00 00 00 00 00  //->CE in normal mode,updated on 20180306
			29 01 00 00 00 00 02 F9 64
			29 01 00 00 00 00 02 B0 03
		];

		qcom,mdss-dsi-panel-cabc-still-mode-td4310 = [
			29 01 00 00 00 00 02 B0 04
			29 01 00 00 00 00 02 D6 01
			15 01 00 00 00 00 02 51 ff
			15 01 00 00 00 00 02 53 2C
			15 01 00 00 00 00 02 55 82
			//29 01 00 00 00 00 27 C7 06 1C 2B 3E 4E 5A 73 84 91 9D 4F 5B 6A 7E 87 93 A0 AA B2 06 1B 2A 3D 4D 59 72 83 91 9D 4F 5B 6A 7E 87 93 A0 AA B2 //gamma 2.3
			29 01 00 00 00 00 27 C7 0a 21 2d 3e 4c 57 70 80 8d 99 4c 58 67 7b 84 8f 9d a8 b4 0a 21 2d 3e 4c 57 70 80 8d 99 4c 58 67 7b 84 8f 9d a8 b4 //gamma 2.2
			29 01 00 00 00 00 14 C8 00 00 00 00 00 FC 00 00 00 00 00 FC 00 00 00 00 00 FC 00
			29 01 00 00 00 00 08 B8 67 4B 06 00 04 00 00
			29 01 00 00 00 00 08 B9 99 4B 10 00 07 00 00
			29 01 00 00 00 00 08 BA BB 43 17 00 09 00 00
			29 01 00 00 00 00 1a CE 55 40 60 78 87 94 9E AB B8 C4 CD D6 DE E5 EC F3 FF 00 E3 04 04 42 04 69 5A
			//29 01 00 00 00 00 2C CA 1D FC FC FC 00 12 00 14 00 F5 F5 F5 00 13 DB 00 ED C5 00 F1 00 F5 9F 6B 61 A1 6B 59 4D 00 00 00 00 00 00 00 00 00 00 00 00 00 00  ->CE in normal mode
			//29 01 00 00 00 00 2C CA 1D FC FC FC 00 15 03 0B 00 CF F5 F7 00 2F 00 F9 F9 F9 00 FC 00 D0 9F 6B 61 A1 6B 59 4D 00 C5 F2 55 BF FF 4E 00 00 00 00 00 00 00  ->CE in normal mode,updated on 20180228
			29 01 00 00 00 00 2C CA 1D FC FC FC 00 15 03 0B 00 CF E5 E7 00 2F 00 F9 F9 F9 00 FC 00 D0 9F 6B 61 A0 6F 58 4D 00 C5 F2 55 BF FF 4E 00 00 00 00 00 00 00  //->CE in normal mode,updated on 20180306
			29 01 00 00 00 00 02 F9 64
			29 01 00 00 00 00 02 B0 03
		];

		qcom,mdss-dsi-panel-cabc-moving-mode-td4310 = [
			29 01 00 00 00 00 02 B0 04
			29 01 00 00 00 00 02 D6 01
			15 01 00 00 00 00 02 51 ff
			15 01 00 00 00 00 02 53 2C
			15 01 00 00 00 00 02 55 83
			//29 01 00 00 00 00 27 C7 06 1C 2B 3E 4E 5A 73 84 91 9D 4F 5B 6A 7E 87 93 A0 AA B2 06 1B 2A 3D 4D 59 72 83 91 9D 4F 5B 6A 7E 87 93 A0 AA B2 //gamma 2.3
			29 01 00 00 00 00 27 C7 0a 21 2d 3e 4c 57 70 80 8d 99 4c 58 67 7b 84 8f 9d a8 b4 0a 21 2d 3e 4c 57 70 80 8d 99 4c 58 67 7b 84 8f 9d a8 b4 //gamma 2.2
			29 01 00 00 00 00 14 C8 00 00 00 00 00 FC 00 00 00 00 00 FC 00 00 00 00 00 FC 00
			29 01 00 00 00 00 08 B8 67 4B 06 00 04 00 00
			29 01 00 00 00 00 08 B9 99 4B 10 00 07 00 00
			29 01 00 00 00 00 08 BA BB 43 17 00 09 00 00
			29 01 00 00 00 00 1a CE 55 40 60 78 87 94 9E AB B8 C4 CD D6 DE E5 EC F3 FF 00 E3 04 04 42 04 69 5A
			//29 01 00 00 00 00 2C CA 1D FC FC FC 00 12 00 14 00 F5 F5 F5 00 13 DB 00 ED C5 00 F1 00 F5 9F 6B 61 A1 6B 59 4D 00 00 00 00 00 00 00 00 00 00 00 00 00 00  ->CE in normal mode
			//29 01 00 00 00 00 2C CA 1D FC FC FC 00 15 03 0B 00 CF F5 F7 00 2F 00 F9 F9 F9 00 FC 00 D0 9F 6B 61 A1 6B 59 4D 00 C5 F2 55 BF FF 4E 00 00 00 00 00 00 00  ->CE in normal mode,updated on 20180228
			29 01 00 00 00 00 2C CA 1D FC FC FC 00 15 03 0B 00 CF E5 E7 00 2F 00 F9 F9 F9 00 FC 00 D0 9F 6B 61 A0 6F 58 4D 00 C5 F2 55 BF FF 4E 00 00 00 00 00 00 00  //->CE in normal mode,updated on 20180306
			29 01 00 00 00 00 02 F9 64
			29 01 00 00 00 00 02 B0 03
		];

		qcom,mdss-dsi-panel-sre-weak-level = [
			29 01 00 00 00 00 02 b0 04
			15 01 00 00 00 00 02 51 ff
			15 01 00 00 00 00 02 53 2C
			15 01 00 00 00 00 02 55 71
			29 01 00 00 00 00 08 B8 6e 01 8c 00 00 40 00
			29 01 00 00 00 00 03 BD 00 35
			//29 01 00 00 00 00 2c CA 1D FC FC FC 00 12 00 14 00 F5 F5 F5 00 13 DB 00 ED C5 00 F1 00 F5 9F 6B 61 A1 6B 59 4D 00 00 00 00 00 00 00 00 00 00 00 00 00 00  ->CE in normal mode,Old version
			//29 01 00 00 00 00 2c CA 1D FC FC FC 00 15 03 0B 00 CF F5 F7 00 2F 00 F9 F9 F9 00 FC 00 D0 9F 6B 61 A1 6B 59 4D 00 C5 F2 55 BF FF 4E 00 00 00 00 00 00 00  ->CE in normal mode,updated on 20180228
			29 01 00 00 00 00 2c CA 1D FC FC FC 00 15 03 0B 00 CF E5 E7 00 2F 00 F9 F9 F9 00 FC 00 D0 9F 6B 61 A0 6F 58 4D 00 C5 F2 55 BF FF 4E 00 00 00 00 00 00 00  //->CE in normal mode,updated on 20180306
			29 01 00 00 00 00 02 F9 64
			29 01 00 00 00 00 02 B0 03
		];

		qcom,mdss-dsi-panel-sre-middle-level = [
			29 01 00 00 00 00 02 b0 04
			15 01 00 00 00 00 02 51 ff
			15 01 00 00 00 00 02 53 2C
			15 01 00 00 00 00 02 55 F1
			29 01 00 00 00 00 08 B8 6e F1 64 32 00 40 00
			29 01 00 00 00 00 03 BD 64 00
			29 01 00 00 00 00 2c CA 1D FC FC FC 00 12 00 14 00 F5 F5 F5 00 13 DB 00 ED C5 00 F1 00 F5 9F 6B 61 A1 6B 59 4D 00 00 00 00 00 00 00 00 00 00 00 00 00 00
			29 01 00 00 00 00 02 F9 64
			29 01 00 00 00 00 02 B0 03
		];

		qcom,mdss-dsi-panel-sre-strong-level = [
			29 01 00 00 00 00 02 b0 04
			15 01 00 00 00 00 02 51 ff
			15 01 00 00 00 00 02 53 2C
			15 01 00 00 00 00 02 55 71
			29 01 00 00 00 00 08 B8 6e 01 8c 00 00 60 00
			29 01 00 00 00 00 03 BD 54 35
			//29 01 00 00 00 00 2C CA 1D FC FC FC 00 15 03 0B 00 CF F5 F7 00 2F 00 F9 F9 F9 00 FC 00 D0 9F 6B 61 A1 6B 59 4D 00 C5 F2 55 BF FF 4E 00 00 00 00 00 00 00
			//29 01 00 00 00 00 2C CA 1D FC FC FC 00 12 00 14 00 F5 F5 F5 00 13 DB 00 ED C5 00 F1 00 F5 9F 6B 61 A1 6B 59 4D 00 00 00 00 00 00 00 00 00 00 00 00 00 00  ->CE in normal mode,Old version
			//29 01 00 00 00 00 2C CA 1D FC FC FC 00 15 03 0B 00 CF F5 F7 00 2F 00 F9 F9 F9 00 FC 00 D0 9F 6B 61 A1 6B 59 4D 00 C5 F2 55 BF FF 4E 00 00 00 00 00 00 00  ->CE in normal mode,updated on 20180228
			29 01 00 00 00 00 2C CA 1D FC FC FC 00 15 03 0B 00 CF E5 E7 00 2F 00 F9 F9 F9 00 FC 00 D0 9F 6B 61 A0 6F 58 4D 00 C5 F2 55 BF FF 4E 00 00 00 00 00 00 00  //->CE in normal mode,updated on 20180306
			29 01 00 00 00 00 02 F9 64
			29 01 00 00 00 00 02 B0 03
		];

		qcom,mdss-dsi-panel-sre-exit = [
			29 01 00 00 00 00 02 b0 04
			15 01 00 00 00 00 02 51 ff
			15 01 00 00 00 00 02 53 2C
			15 01 00 00 00 00 02 55 82
			29 01 00 00 00 00 08 B8 67 4B 06 00 04 00 00
			29 01 00 00 00 00 08 B9 99 4B 10 00 07 00 00
			29 01 00 00 00 00 08 BA BB 43 17 00 09 00 00
			//29 01 00 00 00 00 2C CA 1D FC FC FC 00 12 00 14 00 F5 F5 F5 00 13 DB 00 ED C5 00 F1 00 F5 9F 6B 61 A1 6B 59 4D 00 00 00 00 00 00 00 00 00 00 00 00 00 00  ->CE in normal mode
			//29 01 00 00 00 00 2C CA 1D FC FC FC 00 15 03 0B 00 CF F5 F7 00 2F 00 F9 F9 F9 00 FC 00 D0 9F 6B 61 A1 6B 59 4D 00 C5 F2 55 BF FF 4E 00 00 00 00 00 00 00  ->CE in normal mode,updated on 20180228
			29 01 00 00 00 00 2C CA 1D FC FC FC 00 15 03 0B 00 CF E5 E7 00 2F 00 F9 F9 F9 00 FC 00 D0 9F 6B 61 A0 6F 58 4D 00 C5 F2 55 BF FF 4E 00 00 00 00 00 00 00  //->CE in normal mode,updated on 20180306
			29 01 00 00 00 00 02 F9 64
			29 01 00 00 00 00 02 B0 03
		];

		qcom,mdss-dsi-on-command = [
			05 01 00 00 64 00 02 11 00
			29 01 00 00 00 00 02 B0 00
			29 01 00 00 00 00 04 B3 31 00 06
			29 01 00 00 00 00 02 B4 00
			29 01 00 00 00 00 06 B6 33 5B 81 12 00
			29 01 00 00 00 00 08 B8 67 4B 06 00 04 00 00
			29 01 00 00 00 00 08 B9 99 4B 10 00 07 00 00
			29 01 00 00 00 00 08 BA BB 43 17 00 09 00 00
			29 01 00 00 00 00 03 BB 14 14
			29 01 00 00 00 00 03 BC 37 32
			29 01 00 00 00 00 03 BD 64 32
			29 01 00 00 00 00 02 BE 04
			29 01 00 00 00 00 02 C0 00
			29 01 00 00 00 00 31 C1 04 40 00 FF FF C0 9A 2B E3 BF FF FF 97 11 C2 28 FF FF FF 7D 41 5C 63 E0 FF 0F 00 00 00 00 00 00 00 00 40 02 62 11 06 02 02 00 01 00 01 00 00 00
			29 01 00 00 00 00 19 C2 01 F8 70 08 64 04 0C 10 00 08 30 00 00 00 00 00 00 00 00 08 00 00 00 00
			29 01 00 00 00 00 3F C3 86 58 65 86 50 00 00 00 00 00 41 B4 1B 00 00 46 14 61 00 00 01 01 03 28 00 01 00 01 00 00 15 00 15 00 2C 01 00 00 00 00 00 00 00 00 00 00 00 00 28 00 28 00 5A 02 00 00 00 00 00 00 08 08
			29 01 00 00 00 00 15 C4 70 00 00 00 00 00 00 00 00 02 02 31 01 00 00 00 02 01 01 01
			29 01 00 00 00 00 09 C5 08 00 00 00 00 70 00 00
			29 01 00 00 00 00 40 C6 44 00 44 03 3D 01 0E 01 02 01 02 01 02 00 00 00 00 07 0E 04 44 00 47 54 00 00 00 00 00 00 00 00 00 00 00 00 00 00 00 00 00 00 00 00 00 00 00 00 00 00 00 00 00 00 00 00 00 00 00 00 00 00 00
			29 01 00 00 00 00 27 C7 0a 21 2d 3e 4c 57 70 80 8d 99 4c 58 67 7b 84 8f 9d a8 b4 0a 21 2d 3e 4c 57 70 80 8d 99 4c 58 67 7b 84 8f 9d a8 b4	//###Gamma2.2
			//29 01 00 00 00 00 27 C7 06 1C 2B 3E 4E 5A 73 84 91 9D 4F 5B 6A 7E 87 93 A0 AA B2 06 1B 2A 3D 4D 59 72 83 91 9D 4F 5B 6A 7E 87 93 A0 AA B2  //###Gamma2.3
			29 01 00 00 00 00 38 C8 00 00 00 00 00 FC 00 00 00 00 00 FC 00 00 00 00 00 FC 00 00 00 00 00 FC 00 00 00 00 00 FC 00 00 00 00 00 FC 00 00 00 00 00 FC 00 00 00 00 00 FC 00 00 00 00 00 FC 00
			29 01 00 00 00 00 14 C9 00 00 00 00 00 FC 00 00 00 00 00 FC 00 00 00 00 00 FC 00
			//29 01 00 00 00 00 2C CA 1D FC FC FC 00 12 00 14 00 F5 F5 F5 00 13 DB 00 ED C5 00 F1 00 F5 9F 6B 61 A1 6B 59 4D 00 00 00 00 00 00 00 00 00 00 00 00 00 00  ->CE in normal mode
			//29 01 00 00 00 00 2C CA 1D FC FC FC 00 15 03 0B 00 CF F5 F7 00 2F 00 F9 F9 F9 00 FC 00 D0 9F 6B 61 A1 6B 59 4D 00 C5 F2 55 BF FF 4E 00 00 00 00 00 00 00  ->CE in normal mode,updated on 20180228
			29 01 00 00 00 00 2C CA 1D FC FC FC 00 15 03 0B 00 CF E5 E7 00 2F 00 F9 F9 F9 00 FC 00 D0 9F 6B 61 A0 6F 58 4D 00 C5 F2 55 BF FF 4E 00 00 00 00 00 00 00  //->CE in normal mode,updated on 20180306
			29 01 00 00 00 00 1C CB F8 85 1F FA 0D 40 00 00 20 00 11 50 00 0D 00 00 00 00 00 00 00 00 00 00 00 00 00
			29 01 00 00 00 00 03 CC 37 00
			29 01 00 00 00 00 27 CD 1D 00 23 00 23 00 5C 02 BF BF E3 E3 AF AF E2 E2 01 00 00 00 00 00 00 00 00 00 00 00 00 00 00 00 00 00 00 00 00 A2
			29 01 00 00 00 00 1A CE 55 40 60 78 87 94 9E AB B8 C4 CD D6 DE E5 EC F3 FF 00 E3 04 04 42 04 69 5A
			29 01 00 00 00 00 03 CF 48 1D
			29 01 00 00 00 00 14 D0 33 59 CF 31 01 10 10 10 19 19 00 00 00 00 00 00 00 6D 65
			29 01 00 00 00 00 02 D1 00
			29 01 00 00 00 00 16 D3 1B 3B BB 77 77 77 BB B3 33 00 00 6E 60 E7 E7 33 BB F2 FD C6 0B
			//29 01 00 00 00 00 0B D5 03 00 00 02 00 02 00 01 00 00
			29 01 00 00 00 00 02 D6 01
			29 01 00 00 00 00 22 D7 86 FF 03 05 41 24 80 1F C7 1F 1B 00 0C 07 20 00 00 00 00 00 0C F0 07 00 0C 00 00 AA 67 7E 1D 06 00
			29 01 00 00 00 00 08 D9 00 30 14 3E 05 77 02
			29 01 00 00 00 00 05 DD 30 06 23 65
			29 01 00 00 00 00 02 EA 9F
			29 01 00 00 00 00 04 EE 41 51 00
			29 01 00 00 00 00 04 F1 00 00 00
			29 01 00 00 00 00 02 B0 04
			29 01 00 00 00 00 02 F9 64
			29 01 00 00 00 00 02 B0 03
			39 01 00 00 00 00 02 51 FF
			39 01 00 00 00 00 02 53 24
			39 01 00 00 00 00 02 55 82
			05 01 00 00 14 00 02 29 00];
		qcom,mdss-dsi-off-command = [05 01 00 00 14 00 02 28 00
					     05 01 00 00 78 00 02 10 00];
		qcom,mdss-dsi-on-command-state = "dsi_lp_mode";
		qcom,mdss-dsi-off-command-state = "dsi_hs_mode";
		qcom,mdss-dsi-bl-pmic-control-type = "bl_ctrl_wled";
		qcom,mdss-dsi-reset-sequence = <1 2>, <0 2>, <1 3>;
		qcom,mdss-dsi-panel-status-command = [06 01 00 01 05 00 01 0a];
		qcom,mdss-dsi-panel-status-command-state = "dsi_lp_mode";
		qcom,mdss-dsi-panel-status-check-mode = "reg_read";
		qcom,mdss-dsi-panel-status-read-length = <1>;
		qcom,mdss-dsi-panel-status-value = <0x1c>;
		qcom,esd-check-enabled;
		qcom,mdss-pan-physical-width-dimension = <68>;
		qcom,mdss-pan-physical-height-dimension = <136>;
		//qcom,esd-check-enabled;
		qcom,mdss-dsi-tx-eot-append;
		//qcom,mdss-dsi-post-init-delay = <1>;
	};
};
