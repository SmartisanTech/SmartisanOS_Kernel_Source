/* Copyright (c) 2013-2014, The Linux Foundation. All rights reserved.
 *
 * This program is free software; you can redistribute it and/or modify
 * it under the terms of the GNU General Public License version 2 and
 * only version 2 as published by the Free Software Foundation.
 *
 * This program is distributed in the hope that it will be useful,
 * but WITHOUT ANY WARRANTY; without even the implied warranty of
 * MERCHANTABILITY or FITNESS FOR A PARTICULAR PURPOSE.  See the
 * GNU General Public License for more details.
 */

&mdss_mdp {
	dsi_nt35596_1080_vid: qcom,mdss_dsi_nt35596_1080p_video {
		qcom,mdss-dsi-panel-name = "nt35596 1080p video mode dsi panel";
		qcom,mdss-dsi-panel-controller = <&mdss_dsi0>;
		qcom,mdss-dsi-panel-type = "dsi_video_mode";
		qcom,mdss-dsi-panel-destination = "display_1";
		qcom,mdss-dsi-panel-framerate = <60>;
		qcom,mdss-dsi-virtual-channel-id = <0>;
		qcom,mdss-dsi-stream = <0>;
		qcom,mdss-dsi-panel-width = <1080>;
		qcom,mdss-dsi-panel-height = <1920>;
		qcom,mdss-dsi-h-front-porch = <32>;
		qcom,mdss-dsi-h-back-porch = <32>;
		qcom,mdss-dsi-h-pulse-width = <8>;
		qcom,mdss-dsi-h-sync-skew = <0>;
		qcom,mdss-dsi-v-back-porch = <18>;
		qcom,mdss-dsi-v-front-porch = <2>;
		qcom,mdss-dsi-v-pulse-width = <2>;
		qcom,mdss-dsi-h-left-border = <0>;
		qcom,mdss-dsi-h-right-border = <0>;
		qcom,mdss-dsi-v-top-border = <0>;
		qcom,mdss-dsi-v-bottom-border = <0>;
		qcom,mdss-dsi-bpp = <24>;
		qcom,mdss-dsi-underflow-color = <0xff>;
		qcom,mdss-dsi-border-color = <0>;
		qcom,mdss-dsi-on-command = [//39 01 00 00 00 00 02 FF EE
              	39 01 00 00 00 00 02 BA 03    //SET MIPI lane
		39 01 00 00 00 00 02 C2 03    //SET DSI mode 
		 
		39 01 00 00 00 00 02 FF 05    //RELOAD CMD5
		39 01 00 00 00 00 02 FB 01
		39 01 00 00 00 00 02 C5 31
		39 01 00 00 00 00 02 FF EE
		39 01 00 00 00 00 02 FB 01
		39 01 00 00 00 00 02 1F 45
		39 01 00 00 00 00 02 24 4F
		39 01 00 00 00 00 02 38 C8
		39 01 00 00 00 00 02 39 2C
		39 01 00 00 00 00 02 1E BB
		39 01 00 00 00 00 02 1D 0F
		39 01 00 00 00 00 02 7E B1

		39 01 00 00 00 00 02 FF 00
		39 01 00 00 00 00 02 FB 01
		39 01 00 00 00 00 02 35 01

		39 01 00 00 00 00 02 FF 01
		39 01 00 00 00 00 02 FB 01
		39 01 00 00 00 00 02 00 01
		39 01 00 00 00 00 02 01 55
		39 01 00 00 00 00 02 02 40
		39 01 00 00 00 00 02 05 40
		39 01 00 00 00 00 02 06 4a
		39 01 00 00 00 00 02 07 24
		39 01 00 00 00 00 02 08 0C
		39 01 00 00 00 00 02 0B 87
		39 01 00 00 00 00 02 0C 87
		39 01 00 00 00 00 02 0E B0
		39 01 00 00 00 00 02 0F B3
		39 01 00 00 00 00 02 11 10
		39 01 00 00 00 00 02 12 10
		39 01 00 00 00 00 02 13 05
		39 01 00 00 00 00 02 14 4a
		39 01 00 00 00 00 02 15 18
		39 01 00 00 00 00 02 16 18
		39 01 00 00 00 00 02 18 00
		39 01 00 00 00 00 02 19 77
		39 01 00 00 00 00 02 1A 55
		39 01 00 00 00 00 02 1B 13
		39 01 00 00 00 00 02 1C 00
		39 01 00 00 00 00 02 1D 00
		39 01 00 00 00 00 02 1E 13
		39 01 00 00 00 00 02 1F 00

		39 01 00 00 00 00 02 23 00
		39 01 00 00 00 00 02 24 00
		39 01 00 00 00 00 02 25 00
		39 01 00 00 00 00 02 26 00
		39 01 00 00 00 00 02 27 00
		39 01 00 00 00 00 02 28 00

		39 01 00 00 00 00 02 35 00

		39 01 00 00 00 00 02 66 00

		39 01 00 00 00 00 02 58 82
		39 01 00 00 00 00 02 59 02
		39 01 00 00 00 00 02 5A 02
		39 01 00 00 00 00 02 5B 02
		39 01 00 00 00 00 02 5C 82
		39 01 00 00 00 00 02 5D 82
		39 01 00 00 00 00 02 5E 02
		39 01 00 00 00 00 02 5F 02

		39 01 00 00 00 00 02 72 31

		39 01 00 00 00 00 02 FF 05//PAGE 5
		39 01 00 00 00 00 02 FB 01
		39 01 00 00 00 00 02 00 01
		39 01 00 00 00 00 02 01 0B
		39 01 00 00 00 00 02 02 0C
		39 01 00 00 00 00 02 03 09
		39 01 00 00 00 00 02 04 0A
		39 01 00 00 00 00 02 05 00
		39 01 00 00 00 00 02 06 0F
		39 01 00 00 00 00 02 07 10
		39 01 00 00 00 00 02 08 00
		39 01 00 00 00 00 02 09 00
		39 01 00 00 00 00 02 0A 00
		39 01 00 00 00 00 02 0B 00
		39 01 00 00 00 00 02 0C 00
		39 01 00 00 00 00 02 0D 13
		39 01 00 00 00 00 02 0E 15
		39 01 00 00 00 00 02 0F 17

		39 01 00 00 00 00 02 10 01
		39 01 00 00 00 00 02 11 0B
		39 01 00 00 00 00 02 12 0C
		39 01 00 00 00 00 02 13 09
		39 01 00 00 00 00 02 14 0A
		39 01 00 00 00 00 02 15 00
		39 01 00 00 00 00 02 16 0F
		39 01 00 00 00 00 02 17 10
		39 01 00 00 00 00 02 18 00
		39 01 00 00 00 00 02 19 00
		39 01 00 00 00 00 02 1A 00
		39 01 00 00 00 00 02 1B 00
		39 01 00 00 00 00 02 1C 00
		39 01 00 00 00 00 02 1D 13
		39 01 00 00 00 00 02 1E 15
		39 01 00 00 00 00 02 1F 17

		39 01 00 00 00 00 02 20 00
		39 01 00 00 00 00 02 21 03
		39 01 00 00 00 00 02 22 01
		39 01 00 00 00 00 02 23 40
		39 01 00 00 00 00 02 24 40
		39 01 00 00 00 00 02 25 ED
		39 01 00 00 00 00 02 29 58
		39 01 00 00 00 00 02 2A 12
		39 01 00 00 00 00 02 2B 01

		39 01 00 00 00 00 02 4B 06
		39 01 00 00 00 00 02 4C 11
		39 01 00 00 00 00 02 4D 20
		39 01 00 00 00 00 02 4E 02
		39 01 00 00 00 00 02 4F 02

		39 01 00 00 00 00 02 50 20
		39 01 00 00 00 00 02 51 61
		39 01 00 00 00 00 02 52 01
		39 01 00 00 00 00 02 53 63
		39 01 00 00 00 00 02 54 77
		39 01 00 00 00 00 02 55 ED
		39 01 00 00 00 00 02 5B 00
		39 01 00 00 00 00 02 5C 00
		39 01 00 00 00 00 02 5D 00
		39 01 00 00 00 00 02 5E 00
		39 01 00 00 00 00 02 5F 15

		39 01 00 00 00 00 02 60 75
		39 01 00 00 00 00 02 61 00
		39 01 00 00 00 00 02 62 00
		39 01 00 00 00 00 02 63 00
		39 01 00 00 00 00 02 64 00
		39 01 00 00 00 00 02 65 00
		39 01 00 00 00 00 02 66 00
		39 01 00 00 00 00 02 67 00
		39 01 00 00 00 00 02 68 04
		39 01 00 00 00 00 02 69 00
		39 01 00 00 00 00 02 6A 00
		39 01 00 00 00 00 02 6C 40

		39 01 00 00 00 00 02 75 01
		39 01 00 00 00 00 02 76 01
		39 01 00 00 00 00 02 7A 80
		39 01 00 00 00 00 02 7B C5
		39 01 00 00 00 00 02 7C D8
		39 01 00 00 00 00 02 7D 60
		39 01 00 00 00 00 02 7F 15

		39 01 00 00 00 00 02 80 81
		39 01 00 00 00 00 02 83 05
		39 01 00 00 00 00 02 93 08
		39 01 00 00 00 00 02 94 10
		39 01 00 00 00 00 02 8A 00
		39 01 00 00 00 00 02 9B 0F
		39 01 00 00 00 00 02 EA FF
		39 01 00 00 00 00 02 EC 00

		39 01 00 00 00 00 02 FF 01
		39 01 00 00 00 00 02 FB 01
		39 01 00 00 00 00 02 FF 02
		39 01 00 00 00 00 02 FB 01
		39 01 00 00 00 00 02 FF 04
		39 01 00 00 00 00 02 FB 01
		39 01 00 00 00 00 02 FF 00
		39 01 00 00 00 00 02 d3 14
		39 01 00 00 00 00 02 d4 02
                
                39 01 00 00 00 00 02 35 00

		39 01 00 00 00 00 02 36 00 
		39 01 00 00 00 00 02 3A 77

		05 01 00 00 78 00 02 11 00
		05 01 00 00 50 00 02 29 00
		39 01 00 00 00 00 02 53 2C];
		qcom,mdss-dsi-off-command = [05 01 00 00 32 00 02 28 00
					05 01 00 00 78 00 02 10 00];
		qcom,mdss-dsi-on-command-state = "dsi_lp_mode";
		qcom,mdss-dsi-off-command-state = "dsi_hs_mode";
		qcom,mdss-dsi-h-sync-pulse = <1>;
		qcom,mdss-dsi-traffic-mode = "burst_mode";
		qcom,mdss-dsi-lane-map = "lane_map_0123";
		qcom,mdss-dsi-bllp-eof-power-mode;
		qcom,mdss-dsi-bllp-power-mode;
		qcom,mdss-dsi-lane-0-state;
		qcom,mdss-dsi-lane-1-state;
		qcom,mdss-dsi-lane-2-state;
		qcom,mdss-dsi-lane-3-state;
		qcom,mdss-dsi-panel-timings = [D5 32 22 00 60 64 26 36 29 03 04 00];
		qcom,mdss-dsi-t-clk-post = <0x03>;
		qcom,mdss-dsi-t-clk-pre = <0x35>;
		qcom,mdss-dsi-bl-min-level = <1>;
		qcom,mdss-dsi-bl-max-level = <255>;
		qcom,mdss-dsi-dma-trigger = "trigger_sw";
		qcom,mdss-dsi-mdp-trigger = "none";
		qcom,mdss-dsi-bl-pmic-control-type = "bl_ctrl_dcs";
		qcom,mdss-dsi-reset-sequence = <1 20>, <0 50>, <1 20>;

	};
};
