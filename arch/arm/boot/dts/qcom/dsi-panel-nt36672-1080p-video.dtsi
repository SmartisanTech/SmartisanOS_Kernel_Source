/* Copyright (c) 2013, The Linux Foundation. All rights reserved.
 *
 * This program is free software; you can redistribute it and/or modify
 * it under the terms of the GNU General Public License version 2 and
 * only version 2 as published by the Free Software Foundation.
 *
 * This program is distributed in the hope that it will be useful,
 * but WITHOUT ANY WARRANTY; without even the implied warranty of
 * MERCHANTABILITY or FITNESS FOR A PARTICULAR PURPOSE.  See the
 * GNU General Public License for more details.
 */

/*---------------------------------------------------------------------------
 * This file is autogenerated file using gcdb parser. Please do not edit it.
 * Update input XML file to add a new entry or update variable in this file
 * VERSION = "1.0"
 *---------------------------------------------------------------------------*/
&mdss_mdp {
	dsi_nt36672_1080p_vid: qcom,mdss_dsi_nt36672_1080p_video {
		qcom,mdss-dsi-panel-name = "nt36672 1080p video mode dsi panel";
		qcom,mdss-dsi-panel-controller = <&mdss_dsi0>;
		qcom,mdss-dsi-panel-type = "dsi_video_mode";
		qcom,mdss-dsi-panel-destination = "display_1";
		qcom,mdss-dsi-panel-framerate = <55>;
		qcom,mdss-dsi-virtual-channel-id = <0>;
		qcom,mdss-dsi-stream = <0>;
		qcom,mdss-dsi-panel-width = <1080>;
		qcom,mdss-dsi-panel-height = <1920>;
		qcom,mdss-dsi-h-front-porch = <20>;
		qcom,mdss-dsi-h-back-porch = <280>;
		qcom,mdss-dsi-h-pulse-width = <4>;
		qcom,mdss-dsi-h-sync-skew = <0>;
		qcom,mdss-dsi-v-back-porch = <20>;
		qcom,mdss-dsi-v-front-porch = <20>;
		qcom,mdss-dsi-v-pulse-width = <2>;
		qcom,mdss-dsi-h-left-border = <0>;
		qcom,mdss-dsi-h-right-border = <0>;
		qcom,mdss-dsi-v-top-border = <0>;
		qcom,mdss-dsi-v-bottom-border = <4>;
		qcom,mdss-dsi-bpp = <24>;
		qcom,mdss-dsi-color-order = "rgb_swap_rgb";
		qcom,mdss-dsi-underflow-color = <0xff>;
		qcom,mdss-dsi-border-color = <0>;
		//for esd config start
		qcom,mdss-dsi-hbp-power-mode;
		qcom,mdss-dsi-force-clock-lane-hs;
		//esd config end
		qcom,mdss-dsi-pan-enable-dynamic-fps;
		qcom,mdss-dsi-pan-fps-update = "dfps_immediate_porch_mode_vfp";
		qcom,mdss-dsi-min-refresh-rate = <48>;
		qcom,mdss-dsi-max-refresh-rate = <55>;

		qcom,mdss-dsi-panel-sre-weak-level = [
			15 01 00 00 00 00 02 55 42
		];

		qcom,mdss-dsi-panel-sre-middle-level = [
			15 01 00 00 00 00 02 55 52
		];

		qcom,mdss-dsi-panel-sre-strong-level = [
			15 01 00 00 00 00 02 55 62
		];

		qcom,mdss-dsi-panel-sre-exit = [
			15 01 00 00 00 00 02 55 02
		];

		qcom,mdss-dsi-panel-color-temperature-command = [
			//eyecare config start
			15 01 00 00 00 00 02 FF  20
			15 00 00 00 00 00 02 FB  01
			15 00 00 00 00 00 02 AF  03
			39 00 00 00 00 00 11 B0  00  00  00  24  00  54  00  7A  00  9A  00  B5  00  CC  00  E1
			39 00 00 00 00 00 11 B1  00  F3  01  2C  01  57  01  95  01  C3  02  06  02  3B  02  3D
			39 00 00 00 00 00 11 B2  02  70  02  AB  02  D0  02  FF  03  22  03  4C  03  58  03  65
			39 01 00 00 00 00 0d B3  03  74  03  86  03  9B  03  B4  03  CC  03  FF
			39 00 00 00 00 00 11 B4  01  8F  01  92  01  97  01  9C  01  A1  01  A6  01  AB  01  B0
			39 00 00 00 00 00 11 B5  01  B4  01  C5  01  D5  01  F1  02  09  02  35  02  5F  02  60
			39 00 00 00 00 00 11 B6  02  8D  02  C4  02  E8  03  15  03  37  03  5E  03  69  03  76
			39 01 00 00 00 00 0d B7  03  84  03  95  03  A9  03  BD  03  CB  03  FF
			39 00 00 00 00 00 11 B8  01  C6  01  C8  01  CC  01  CF  01  D3  01  D6  01  DA  01  DD
			39 00 00 00 00 00 11 B9  01  E1  01  ED  01  F8  02  0F  02  23  02  4A  02  71  02  72
			39 00 00 00 00 00 11 BA  02  9D  02  D2  02  F4  03  23  03  42  03  66  03  70  03  7B
			39 00 00 00 00 00 0d BB  03  87  03  95  03  A6  03  BB  03  E2  03  FF
			//CE start
			15 01 00 00 00 00 02 FF 22
			15 00 00 00 00 00 02 53 02
			15 00 00 00 00 00 02 55 88
			15 00 00 00 00 00 02 56 77
			15 00 00 00 00 00 02 58 40
			15 00 00 00 00 00 02 59 40
			15 00 00 00 00 00 02 5A 40
			15 00 00 00 00 00 02 60 3C
			15 00 00 00 00 00 02 61 39
			15 00 00 00 00 00 02 62 37
			15 00 00 00 00 00 02 63 34
			15 00 00 00 00 00 02 64 32
			15 00 00 00 00 00 02 65 31
			15 01 00 00 00 00 02 66 31
			15 00 00 00 00 00 02 67 31
			15 00 00 00 00 00 02 68 33
			15 00 00 00 00 00 02 69 36
			15 00 00 00 00 00 02 6A 3C
			15 00 00 00 00 00 02 6B 40
			15 00 00 00 00 00 02 6C 40
			15 00 00 00 00 00 02 6D 40
			15 00 00 00 00 00 02 6E 40
			15 00 00 00 00 00 02 6F 40
			15 00 00 00 00 00 02 74 00
			15 00 00 00 00 00 02 83 02
			15 00 00 00 00 00 02 89 40
			15 00 00 00 00 00 02 94 37
			15 01 00 00 00 00 02 95 2A
			15 00 00 00 00 00 02 96 37
			15 00 00 00 00 00 02 97 47
			15 00 00 00 00 00 02 98 53
			15 00 00 00 00 00 02 99 60
			15 00 00 00 00 00 02 9A 48
			15 00 00 00 00 00 02 9B 40
			15 00 00 00 00 00 02 9C 40
			15 00 00 00 00 00 02 B7 70
			15 00 00 00 00 00 02 B8 70
			15 00 00 00 00 00 02 FB 01
			15 00 00 00 00 00 02 FF 10
			15 01 00 00 00 00 02 55 92
		];

		qcom,mdss-dsi-panel-color-temperature-command-restore = [
			// CE start
			15 01 00 00 00 00 02 FF 22
			15 00 00 00 00 00 02 07 6B
			15 00 00 00 00 00 02 08 67
			15 00 00 00 00 00 02 0A 5D
			15 00 00 00 00 00 02 0B 57
			15 00 00 00 00 00 02 0C 52
			15 00 00 00 00 00 02 0D 4D
			15 00 00 00 00 00 02 0E 48
			15 00 00 00 00 00 02 0F 44
			15 00 00 00 00 00 02 17 00
			15 00 00 00 00 00 02 53 01
			15 00 00 00 00 00 02 54 00
			15 00 00 00 00 00 02 55 88
			15 01 00 00 00 00 02 56 75
			15 00 00 00 00 00 02 58 55
			15 00 00 00 00 00 02 59 4D
			15 00 00 00 00 00 02 5A 45
			15 00 00 00 00 00 02 5B 45
			15 00 00 00 00 00 02 5C 47
			15 00 00 00 00 00 02 5D 44
			15 00 00 00 00 00 02 5E 41
			15 00 00 00 00 00 02 5F 40
			15 00 00 00 00 00 02 60 40
			15 00 00 00 00 00 02 61 40
			15 00 00 00 00 00 02 62 40
			15 00 00 00 00 00 02 63 40
			15 00 00 00 00 00 02 64 43
			15 01 00 00 00 00 02 65 47
			15 00 00 00 00 00 02 66 4A
			15 00 00 00 00 00 02 67 4D
			15 00 00 00 00 00 02 68 50
			15 00 00 00 00 00 02 69 55
			15 00 00 00 00 00 02 6A 58
			15 00 00 00 00 00 02 6B 55
			15 00 00 00 00 00 02 6C 54
			15 00 00 00 00 00 02 6D 53
			15 00 00 00 00 00 02 6E 54
			15 00 00 00 00 00 02 6F 55
			15 00 00 00 00 00 02 73 05
			15 00 00 00 00 00 02 74 06
			15 00 00 00 00 00 02 83 03
			15 01 00 00 00 00 02 84 28
			15 00 00 00 00 00 02 86 40
			15 00 00 00 00 00 02 87 43
			15 00 00 00 00 00 02 89 20
			15 00 00 00 00 00 02 8A 37
			15 00 00 00 00 00 02 94 40
			15 00 00 00 00 00 02 95 40
			15 00 00 00 00 00 02 96 40
			15 00 00 00 00 00 02 97 C0
			15 00 00 00 00 00 02 98 40
			15 01 00 00 00 00 02 99 40
			15 00 00 00 00 00 02 9A 4C
			15 00 00 00 00 00 02 9B 5A
			15 00 00 00 00 00 02 9C 4C
			15 00 00 00 00 00 02 A2 20
			15 00 00 00 00 00 02 B3 00
			15 00 00 00 00 00 02 B7 70
			15 00 00 00 00 00 02 B8 70
			15 01 00 00 00 00 02 FB 01
			// CE end
			15 01 00 00 00 00 02 FF 20
			15 01 00 00 00 00 02 FB 00
			15 01 00 00 00 00 02 FF 10
			15 01 00 00 00 00 02 55 82			
			15 01 00 00 12 00 02 11 00
			15 01 00 00 00 00 02 FF 20
			15 01 00 00 00 00 02 FB 01
			15 01 00 00 00 00 02 78 00
		];

		qcom,mdss-dsi-panel-cabc-moving-mode-nt36672 = [
			15 01 00 00 00 00 02 FF 23
			15 01 00 00 00 00 02 FB 01
			15 01 00 00 00 00 02 58 FF
			15 01 00 00 00 00 02 59 F1
			15 01 00 00 00 00 02 5A EA
			15 01 00 00 00 00 02 5B E2
			15 01 00 00 00 00 02 5C DB
			15 01 00 00 00 00 02 5D D3
			15 01 00 00 00 00 02 5E C8
			15 01 00 00 00 00 02 5F BE
			15 01 00 00 00 00 02 60 B3
			15 01 00 00 00 00 02 61 A9
			15 01 00 00 00 00 02 62 A0
			15 01 00 00 00 00 02 63 98
			15 01 00 00 00 00 02 64 91
			15 01 00 00 00 00 02 65 8A
			15 01 00 00 00 00 02 66 85
			15 01 00 00 00 00 02 67 80
			15 01 00 00 00 00 02 FF 10
			15 01 00 00 00 00 02 55 03
		];
		qcom,mdss-dsi-on-command = [
                	// CE start
			15 01 00 00 00 00 02 FF 22
			15 01 00 00 00 00 02 07 6B
			15 01 00 00 00 00 02 08 67
			15 01 00 00 00 00 02 0A 5D
			15 01 00 00 00 00 02 0B 57
			15 01 00 00 00 00 02 0C 52
			15 01 00 00 00 00 02 0D 4D
			15 01 00 00 00 00 02 0E 48
			15 01 00 00 00 00 02 0F 44
			15 01 00 00 00 00 02 17 00
			15 01 00 00 00 00 02 53 01
			15 01 00 00 00 00 02 54 00
			15 01 00 00 00 00 02 55 88
			15 01 00 00 00 00 02 56 75
			15 01 00 00 00 00 02 58 55
			15 01 00 00 00 00 02 59 4D
			15 01 00 00 00 00 02 5A 45
			15 01 00 00 00 00 02 5B 45
			15 01 00 00 00 00 02 5C 47
			15 01 00 00 00 00 02 5D 44
			15 01 00 00 00 00 02 5E 41
			15 01 00 00 00 00 02 5F 40
			15 01 00 00 00 00 02 60 40
			15 01 00 00 00 00 02 61 40
			15 01 00 00 00 00 02 62 40
			15 01 00 00 00 00 02 63 40
			15 01 00 00 00 00 02 64 43
			15 01 00 00 00 00 02 65 47
			15 01 00 00 00 00 02 66 4A
			15 01 00 00 00 00 02 67 4D
			15 01 00 00 00 00 02 68 50
			15 01 00 00 00 00 02 69 55
			15 01 00 00 00 00 02 6A 58
			15 01 00 00 00 00 02 6B 55
			15 01 00 00 00 00 02 6C 54
			15 01 00 00 00 00 02 6D 53
			15 01 00 00 00 00 02 6E 54
			15 01 00 00 00 00 02 6F 55
			15 01 00 00 00 00 02 73 05
			15 01 00 00 00 00 02 83 03
			15 01 00 00 00 00 02 84 28
			15 01 00 00 00 00 02 86 40
			15 01 00 00 00 00 02 87 43
			15 01 00 00 00 00 02 89 20
			15 01 00 00 00 00 02 8A 37
			15 01 00 00 00 00 02 97 C0
			15 01 00 00 00 00 02 9A 4C
			15 01 00 00 00 00 02 9B 5A
			15 01 00 00 00 00 02 9C 4C
			15 01 00 00 00 00 02 A2 20
			15 01 00 00 00 00 02 B3 00
			15 01 00 00 00 00 02 B7 70
			15 01 00 00 00 00 02 B8 70
			15 01 00 00 00 00 02 FB 01
			// CE end

			//esd start
			29 01 00 00 00 00 02 FF 20
			29 01 00 00 00 00 02 FB 01
			29 01 00 00 00 00 02 78 00
			29 01 00 00 00 00 02 FF 24
			29 01 00 00 00 00 02 FB 01
			29 01 00 00 00 00 02 C2 80
			29 01 00 00 00 00 02 68 C3
			29 01 00 00 00 00 02 78 80
			29 01 00 00 00 00 02 FF 26
			29 01 00 00 00 00 02 FB 01
			29 01 00 00 00 00 02 1C FA
			29 01 00 00 00 00 02 FF E0
			29 01 00 00 00 00 02 FB 01
			29 01 00 00 00 00 02 17 40
			29 01 00 00 00 00 02 FF 25
			29 01 00 00 00 00 02 FB 01
			29 01 00 00 00 00 02 17 9F
			//esd end

			29 01 00 00 00 00 02 FF 10
			29 01 00 00 00 00 02 51 FF
			29 01 00 00 00 00 02 53 2c
			29 01 00 00 00 00 02 55 82
			29 01 00 00 80 00 02 11 00
			29 01 00 00 20 00 02 29 00
			];
		qcom,mdss-dsi-off-command = [05 01 00 00 32 00 02 28 00
					05 01 00 00 78 00 02 10 00];
		qcom,mdss-dsi-on-command-state = "dsi_lp_mode";
		qcom,mdss-dsi-off-command-state = "dsi_hs_mode";
		qcom,mdss-dsi-h-sync-pulse = <1>;
		qcom,mdss-dsi-traffic-mode = "burst_mode";
		qcom,mdss-dsi-lane-map = "lane_map_0123";
		qcom,mdss-dsi-bllp-eof-power-mode;
		qcom,mdss-dsi-bllp-power-mode;
		qcom,mdss-dsi-lane-0-state;
		qcom,mdss-dsi-lane-1-state;
		qcom,mdss-dsi-lane-2-state;
		qcom,mdss-dsi-lane-3-state;
		qcom,mdss-dsi-panel-timings = [bf 38 26 01 68 6c 2a 3c 2c 03 04 00];
		qcom,mdss-dsi-t-clk-post = <0x0d>;
		qcom,mdss-dsi-t-clk-pre = <0x30>;
		qcom,mdss-dsi-bl-min-level = <1>;
		qcom,mdss-dsi-bl-max-level = <4095>;
		qcom,mdss-dsi-dma-trigger = "trigger_sw";
		qcom,mdss-dsi-mdp-trigger = "none";
		qcom,mdss-dsi-bl-pmic-control-type = "bl_ctrl_wled";
		qcom,mdss-dsi-reset-sequence = <1 10>, <0 2>, <1 10>;
		qcom,mdss-dsi-panel-status-command = [06 01 00 01 05 00 01 AB];
		qcom,mdss-dsi-panel-status-command-mode = "dsi_lp_mode";
		qcom,mdss-dsi-panel-status-check-mode = "reg_read";
		qcom,mdss-dsi-panel-status-read-length = <1>;
		qcom,mdss-dsi-panel-status-value = <0x00>;
		qcom,mdss-dsi-panel-max-error-count = <3>;
		qcom,mdss-pan-physical-width-dimension = <68>;
		qcom,mdss-pan-physical-height-dimension = <121>;
	};
};
