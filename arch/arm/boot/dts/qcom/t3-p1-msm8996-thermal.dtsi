/*It inherits from msm8996.dtsi*/
&soc {
	qcom,sensor-information {
		sensor_information36: qcom,sensor-information-36 {
			qcom,sensor-type = "adc";
			qcom,sensor-name = "xo_therm_buf";
		};
	};
};
