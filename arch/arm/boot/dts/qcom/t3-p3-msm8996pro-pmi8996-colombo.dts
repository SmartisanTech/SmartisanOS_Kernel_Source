/* Copyright (c) 2016, The Linux Foundation. All rights reserved.
 *
 * This program is free software; you can redistribute it and/or modify
 * it under the terms of the GNU General Public License version 2 and
 * only version 2 as published by the Free Software Foundation.
 *
 * This program is distributed in the hope that it will be useful,
 * but WITHOUT ANY WARRANTY; without even the implied warranty of
 * MERCHANTABILITY or FITNESS FOR A PARTICULAR PURPOSE.  See the
 * GNU General Public License for more details.
 */


/dts-v1/;

#include "msm8996pro.dtsi"
#include "msm-pmi8996.dtsi"
#include "msm8996-mtp.dtsi"
#include "t3-p3-msm8996-special-colombo.dtsi"

/ {
	model = "Qualcomm Technologies, Inc. MSM 8996pro + PMI8996 Colombo P3";
	compatible = "qcom,msm8996-colombo", "qcom,msm8996", "qcom,colombo", "qcom,colombo-p3";
	qcom,board-id = <0x1c 0x3>;
};
