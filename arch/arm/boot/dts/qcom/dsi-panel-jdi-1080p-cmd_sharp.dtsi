/* Copyright (c) 2013, The Linux Foundation. All rights reserved.
 *
 * This program is free software; you can redistribute it and/or modify
 * it under the terms of the GNU General Public License version 2 and
 * only version 2 as published by the Free Software Foundation.
 *
 * This program is distributed in the hope that it will be useful,
 * but WITHOUT ANY WARRANTY; without even the implied warranty of
 * MERCHANTABILITY or FITNESS FOR A PARTICULAR PURPOSE.  See the
 * GNU General Public License for more details.
 */
/*---------------------------------------------------------------------------
 * This file is autogenerated file using gcdb parser. Please do not edit it.
 * Update input XML file to add a new entry or update variable in this file
 * VERSION = "1.0"
 *---------------------------------------------------------------------------*/
&mdss_mdp {
	dsi_jdi_1080p_cmd_sharp: qcom,mdss_dsi_jdi_1080p_cmd_sharp {
		qcom,mdss-dsi-panel-name = "jdi 1080p command mode dsi panel xiapu";
		qcom,mdss-dsi-panel-controller = <&mdss_dsi0>;
		qcom,mdss-dsi-panel-type = "dsi_video_mode";
		qcom,mdss-dsi-panel-destination = "display_1";
		qcom,mdss-dsi-panel-framerate = <60>;
		qcom,mdss-dsi-virtual-channel-id = <0>;
		qcom,mdss-dsi-stream = <0>;
		qcom,mdss-dsi-panel-width = <1080>;
		qcom,mdss-dsi-panel-height = <1920>;
		qcom,mdss-dsi-h-front-porch = <180>;
		qcom,mdss-dsi-h-back-porch = <82>;
		qcom,mdss-dsi-h-pulse-width = <70>;
		qcom,mdss-dsi-h-sync-skew = <0>;
		qcom,mdss-dsi-v-back-porch = <4>;
		qcom,mdss-dsi-v-front-porch = <10>;
		qcom,mdss-dsi-v-pulse-width = <2>;

		qcom,mdss-dsi-h-left-border = <0>;
		qcom,mdss-dsi-h-right-border = <0>;
		qcom,mdss-dsi-v-top-border = <0>;
		qcom,mdss-dsi-v-bottom-border = <0>;
		qcom,mdss-dsi-bpp = <24>;
		//qcom,mdss-dsi-panel-clockrate = <836000000>;
		qcom,mdss-dsi-color-order = "rgb_swap_rgb";
		qcom,mdss-dsi-underflow-color = <0xff>;
		qcom,mdss-dsi-border-color = <0>;
		qcom,mdss-dsi-pixel-packing = "tight";
		qcom,mdss-dsi-pixel-alignment = <0>;
		qcom,mdss-dsi-on-command = [
/********************************video mode**************************/
				15 01 00 00 00 00 02 FF 10
				15 01 00 00 00 00 02 FB 01
				15 01 00 00 00 00 02 BA 03
				15 01 00 00 00 00 02 35 00
				15 01 00 00 00 00 02 BB 03	
				15 01 00 00 00 00 02 B0 03
				39 01 00 00 00 00 06 3B 03 06 0A 98	B4
				//39 01 00 00 00 00 05 2B 00 00 07 7F
				//39 01 00 00 00 00 03 44 00 00				
/******************************CABC ON/OFF*****************************/				
				15 01 00 00 00 00 02 51 ff
				15 01 00 00 00 00 02 53 24
				15 01 00 00 00 00 02 FF 10
				//39 01 00 00 00 00 02 5e 20
/*******************************DISPLAY ON SEQUENSE*******************/	
				05 01 00 00 ff 00 02 11 00
				05 01 00 00 ff 00 02 29 00
/*********************************************************************/					
				];

		qcom,mdss-dsi-off-command = [
			39 01 00 00 ff 00 02 28 00
			39 01 00 00 ff 00 02 10 00
			];
		qcom,mdss-dsi-on-command-state = "dsi_lp_mode";
		qcom,mdss-dsi-off-command-state = "dsi_hs_mode";
		qcom,mdss-dsi-h-sync-pulse = <1>;
		qcom,mdss-dsi-traffic-mode = "burst_mode";
		qcom,mdss-dsi-lane-map = "lane_map_0123";
		qcom,mdss-dsi-bllp-eof-power-mode;
		qcom,mdss-dsi-bllp-power-mode;
		qcom,mdss-dsi-lane-0-state;
		qcom,mdss-dsi-lane-1-state;
		qcom,mdss-dsi-lane-2-state;
		qcom,mdss-dsi-lane-3-state;
		//qcom,mdss-dsi-panel-orientation="180";
		//qcom,mdss-dsi-lp11-init;
		//qcom,mdss-tear-check-sync-init-val = <1920>;
		//qcom,mdss-tear-check-sync-cfg-height = <1928>;
		//qcom,mdss-tear-check-rd-ptr-trigger-intr = <1921>;
		//qcom,mdss-tear-check-frame-rate = <6000>;
		//qcom,mdss-tear-check-start-pos = <1920>;
		qcom,mdss-dsi-te-pin-select = <1>;
		qcom,mdss-dsi-te-v-sync-rd-ptr-irq-line = <0x2c>;
		qcom,mdss-dsi-te-dcs-command = <1>;
		qcom,mdss-dsi-te-check-enable;
		qcom,mdss-dsi-te-using-te-pin;
		qcom,mdss-dsi-tx-eot-append;
		qcom,mdss-dsi-panel-timings = [AE 44 37 00 5D 55 39 46 5B 03 04 00];
		qcom,mdss-dsi-panel-timings-8996 = [
			25 1F 09 0A 06 03 04 a0
			25 1F 09 0A 06 03 04 a0
			25 1F 09 0A 06 03 04 a0
			25 1F 09 0A 06 03 04 a0
			25 1E 08 08 0A 06 04 a0];
		qcom,mdss-dsi-t-clk-post = <0x1e>; 		//<0x1e>;
		qcom,mdss-dsi-t-clk-pre = <0x34>;
		qcom,mdss-dsi-bl-min-level = <1>;
		qcom,mdss-dsi-bl-max-level = <4095>;
		qcom,mdss-dsi-dma-trigger = "trigger_sw";
		qcom,mdss-dsi-mdp-trigger = "none";
		qcom,mdss-dsi-bl-pmic-control-type = "bl_ctrl_wled";
		qcom,mdss-dsi-reset-sequence = <1 50>, <0 10>, <1 50>;
		qcom,mdss-pan-physical-width-dimension = <65>;
		qcom,mdss-pan-physical-height-dimension = <116>;
	};
};
