/* Copyright (c) 2013, The Linux Foundation. All rights reserved.
 *
 * This program is free software; you can redistribute it and/or modify
 * it under the terms of the GNU General Public License version 2 and
 * only version 2 as published by the Free Software Foundation.
 *
 * This program is distributed in the hope that it will be useful,
 * but WITHOUT ANY WARRANTY; without even the implied warranty of
 * MERCHANTABILITY or FITNESS FOR A PARTICULAR PURPOSE.  See the
 * GNU General Public License for more details.
 */

/*---------------------------------------------------------------------------
 * This file is autogenerated file using gcdb parser. Please do not edit it.
 * Update input XML file to add a new entry or update variable in this file
 * VERSION = "1.0"
 *---------------------------------------------------------------------------*/
&mdss_mdp {
	dsi_compatible_1080_vid: qcom,mdss_dsi_compatible_1080p_video {
		qcom,mdss-dsi-panel-name = "nt35532 1080p video mode dsi panel";
		qcom,mdss-dsi-panel-controller = <&mdss_dsi0>;
		qcom,mdss-dsi-panel-type = "dsi_video_mode";
		qcom,mdss-dsi-panel-destination = "display_1";
		qcom,mdss-dsi-panel-framerate = <60>;
		qcom,mdss-dsi-virtual-channel-id = <0>;
		qcom,mdss-dsi-stream = <0>;
		qcom,mdss-dsi-panel-width = <1080>;
		qcom,mdss-dsi-panel-height = <1920>;
		qcom,mdss-dsi-h-front-porch = <72>;
		qcom,mdss-dsi-h-back-porch = <16>;
		qcom,mdss-dsi-h-pulse-width = <8>;
		qcom,mdss-dsi-h-sync-skew = <0>;
		qcom,mdss-dsi-v-front-porch = <14>;
		qcom,mdss-dsi-v-back-porch = <6>;
		qcom,mdss-dsi-v-pulse-width = <2>;
		qcom,mdss-dsi-h-left-border = <0>;
		qcom,mdss-dsi-h-right-border = <0>;
		qcom,mdss-dsi-v-top-border = <0>;
		qcom,mdss-dsi-v-bottom-border = <0>;
		qcom,mdss-dsi-bpp = <24>;
		qcom,mdss-dsi-underflow-color = <0xff>;
		qcom,mdss-dsi-border-color = <0>;
		qcom,mdss-dsi-on-command = [
		39 01 00 00 00 00 02 FF 04
		39 01 00 00 01 00 02 FB 01
		39 01 00 00 00 00 02 07 20
		39 01 00 00 00 00 02 08 01
		39 01 00 00 00 00 02 46 E9
          	39 01 00 00 00 00 02 FF 00    
		39 01 00 00 14 00 02 FB 01
		39 01 00 00 00 00 02 FF 00    
		39 01 00 00 00 00 02 D3 08
		39 01 00 00 00 00 02 D4 0E
		05 01 00 00 64 00 02 11 00
		05 01 00 00 28 00 02 29 00
		39 01 00 00 00 00 02 51 15
		39 01 00 00 00 00 02 53 2C   //LED(PWM) on
		39 01 00 00 00 00 02 55 03];//CABC off
		qcom,mdss-dsi-off-command = [05 01 00 00 32 00 02 28 00
					05 01 00 00 78 00 02 10 00];
		qcom,mdss-dsi-on-command-state = "dsi_lp_mode";
		qcom,mdss-dsi-off-command-state = "dsi_hs_mode";

		//qcom,mdss-dsi-panel-status-command = [06 01 00 01 05 00 02 0A 08];
		//qcom,mdss-dsi-panel-status-command-state = "dsi_lp_mode";
		//qcom,mdss-dsi-panel-status-check-mode = "reg_read_nt35596";
		//qcom,mdss-dsi-panel-status-value = <0x9c>;
		
		qcom,mdss-dsi-h-sync-pulse = <1>;
		qcom,mdss-dsi-traffic-mode = "burst_mode";
		qcom,mdss-dsi-lane-map = "lane_map_0123";
		qcom,mdss-dsi-bllp-eof-power-mode;
		qcom,mdss-dsi-bllp-power-mode;
		qcom,mdss-dsi-lane-0-state;
		qcom,mdss-dsi-lane-1-state;
		qcom,mdss-dsi-lane-2-state;
		qcom,mdss-dsi-lane-3-state;
		qcom,mdss-dsi-panel-timings = [D6 34 22 00 62 66 26 36 28 03 04 00];
		qcom,mdss-dsi-t-clk-post = <0x03>;
		qcom,mdss-dsi-t-clk-pre = <0x28>;

		qcom,mdss-dsi-panel-name-com = "nt35596 1080p video mode dsi panel";		
		qcom,mdss-dsi-h-front-porch-com = <100>;
		qcom,mdss-dsi-h-back-porch-com = <80>;
		qcom,mdss-dsi-h-pulse-width-com = <16>;
		qcom,mdss-dsi-h-sync-skew-com = <0>;
		qcom,mdss-dsi-v-front-porch-com = <20>;
		qcom,mdss-dsi-v-back-porch-com = <16>;
		qcom,mdss-dsi-v-pulse-width-com = <4>;
		qcom,mdss-dsi-on-command-com = [
		15 01 00 00 00 00 02 FF EE
		15 01 00 00 01 00 02 FB 01
		15 01 00 00 0a 00 02 18 40
		15 01 00 00 14 00 02 18 00
		//page3
		15 01 00 00 00 00 02 FF 04
		15 01 00 00 01 00 02 FB 01
		15 01 00 00 00 00 02 07 20
		15 01 00 00 00 00 02 08 02
		15 01 00 00 00 00 02 FF 05
		15 01 00 00 0F 00 02 FB 01
		//CMD3_PA           
		15 01 00 00 00 00 02 FF EE 
		15 01 00 00 00 00 02 24 4F
		15 01 00 00 00 00 02 38 C8
		15 01 00 00 00 00 02 39 27
		15 01 00 00 00 00 02 1E 77
		15 01 00 00 00 00 02 1D 0F
		15 01 00 00 00 00 02 7E 71
		15 01 00 00 00 00 02 7C 31
		15 01 00 00 00 00 02 FB 01
		//CMD2_P0
		15 01 00 00 00 00 02 FF 01        
		15 01 00 00 00 00 02 00 01
		15 01 00 00 00 00 02 01 55
		15 01 00 00 00 00 02 02 40		            
		15 01 00 00 00 00 02 05 50
		15 01 00 00 00 00 02 06 4A
		15 01 00 00 00 00 02 07 29
		15 01 00 00 00 00 02 08 0C
		15 01 00 00 00 00 02 0B 87
		15 01 00 00 00 00 02 0C 87
		15 01 00 00 00 00 02 0E B0
		15 01 00 00 00 00 02 0F B3
		15 01 00 00 00 00 02 13 03
		15 01 00 00 00 00 02 14 4A
		15 01 00 00 00 00 02 15 12
		15 01 00 00 00 00 02 16 12		            
		15 01 00 00 00 00 02 18 00
		15 01 00 00 00 00 02 19 77
		15 01 00 00 00 00 02 1A 55
		15 01 00 00 00 00 02 1B 13
		15 01 00 00 00 00 02 1C 00
		15 01 00 00 00 00 02 1D 00		            
		15 01 00 00 00 00 02 1E 00
		15 01 00 00 00 00 02 1F 00		                        
		15 01 00 00 00 00 02 58 82      
		15 01 00 00 00 00 02 59 02      
		15 01 00 00 00 00 02 5A 02      
		15 01 00 00 00 00 02 5B 02      
		15 01 00 00 00 00 02 5C 82      
		15 01 00 00 00 00 02 5D 82      
		15 01 00 00 00 00 02 5E 02      
		15 01 00 00 00 00 02 5F 02
		15 01 00 00 00 00 02 72 31       
		15 01 00 00 00 00 02 FB 01
		//CMD2_P4           
		15 01 00 00 00 00 02 FF 05        
		15 01 00 00 00 00 02 00 01
		15 01 00 00 00 00 02 01 0B
		15 01 00 00 00 00 02 02 0C
		15 01 00 00 00 00 02 03 09
		15 01 00 00 00 00 02 04 0A
		15 01 00 00 00 00 02 05 00
		15 01 00 00 00 00 02 06 0F
		15 01 00 00 00 00 02 07 10
		15 01 00 00 00 00 02 08 00
		15 01 00 00 00 00 02 09 00
		15 01 00 00 00 00 02 0A 00
		15 01 00 00 00 00 02 0B 00
		15 01 00 00 00 00 02 0C 00
		15 01 00 00 00 00 02 0D 13
		15 01 00 00 00 00 02 0E 15
		15 01 00 00 00 00 02 0F 17
		15 01 00 00 00 00 02 10 01
		15 01 00 00 00 00 02 11 0B
		15 01 00 00 00 00 02 12 0C
		15 01 00 00 00 00 02 13 09
		15 01 00 00 00 00 02 14 0A
		15 01 00 00 00 00 02 15 00
		15 01 00 00 00 00 02 16 0F
		15 01 00 00 00 00 02 17 10
		15 01 00 00 00 00 02 18 00
		15 01 00 00 00 00 02 19 00
		15 01 00 00 00 00 02 1A 00
		15 01 00 00 00 00 02 1B 00
		15 01 00 00 00 00 02 1C 00
		15 01 00 00 00 00 02 1D 13
		15 01 00 00 00 00 02 1E 15
		15 01 00 00 00 00 02 1F 17         
		15 01 00 00 00 00 02 20 00
		15 01 00 00 00 00 02 21 03
		15 01 00 00 00 00 02 22 01
		15 01 00 00 00 00 02 23 40
		15 01 00 00 00 00 02 24 40
		15 01 00 00 00 00 02 25 ED          
		15 01 00 00 00 00 02 29 58
		15 01 00 00 00 00 02 2A 12
		15 01 00 00 00 00 02 2B 01
		15 01 00 00 00 00 02 4B 04
		15 01 00 00 00 00 02 4C 12
		15 01 00 00 00 00 02 4D 02
		15 01 00 00 00 00 02 4E 20
		15 01 00 00 00 00 02 4F 20
		15 01 00 00 00 00 02 50 02
		15 01 00 00 00 00 02 51 61
		15 01 00 00 00 00 02 52 01
		15 01 00 00 00 00 02 53 63
		15 01 00 00 00 00 02 54 75
		15 01 00 00 00 00 02 55 ED      
		15 01 00 00 00 00 02 5B 00
		15 01 00 00 00 00 02 5C 00
		15 01 00 00 00 00 02 5F 15
		15 01 00 00 00 00 02 60 75
		15 01 00 00 00 00 02 63 00
		15 01 00 00 00 00 02 64 00
		15 01 00 00 00 00 02 67 00
		15 01 00 00 00 00 02 68 04
		15 01 00 00 00 00 02 6C 40    
		15 01 00 00 00 00 02 7A 80            
		15 01 00 00 00 00 02 7B A3           
		15 01 00 00 00 00 02 7C D8            
		15 01 00 00 00 00 02 7D 60
		15 01 00 00 00 00 02 7F 15
		15 01 00 00 00 00 02 80 00            
		15 01 00 00 00 00 02 83 00           
		15 01 00 00 00 00 02 93 08
		15 01 00 00 00 00 02 94 0A 
		15 01 00 00 00 00 02 8A 00
		15 01 00 00 00 00 02 9B 0F
		15 01 00 00 00 00 02 FB 01
		//Gamma
		15 01 00 00 00 00 02 FF 01
		15 00 00 00 00 00 02 75 00
		15 00 00 00 00 00 02 76 C5
		15 00 00 00 00 00 02 77 00
		15 00 00 00 00 00 02 78 CF
		15 00 00 00 00 00 02 79 00
		15 00 00 00 00 00 02 7A E0
		15 00 00 00 00 00 02 7B 00
		15 00 00 00 00 00 02 7C F0
		15 00 00 00 00 00 02 7D 00
		15 00 00 00 00 00 02 7E FE
		15 00 00 00 00 00 02 7F 01
		15 00 00 00 00 00 02 80 0A
		15 00 00 00 00 00 02 81 01
		15 00 00 00 00 00 02 82 16
		15 00 00 00 00 00 02 83 01
		15 00 00 00 00 00 02 84 20
		15 00 00 00 00 00 02 85 01
		15 00 00 00 00 00 02 86 2A
		15 00 00 00 00 00 02 87 01
		15 00 00 00 00 00 02 88 4D
		15 00 00 00 00 00 02 89 01
		15 00 00 00 00 00 02 8A 6A
		15 00 00 00 00 00 02 8B 01
		15 00 00 00 00 00 02 8C 9B
		15 00 00 00 00 00 02 8D 01
		15 00 00 00 00 00 02 8E C1
		15 00 00 00 00 00 02 8F 01
		15 00 00 00 00 00 02 90 FE
		15 00 00 00 00 00 02 91 02
		15 00 00 00 00 00 02 92 32
		15 00 00 00 00 00 02 93 02
		15 00 00 00 00 00 02 94 33
		15 00 00 00 00 00 02 95 02
		15 00 00 00 00 00 02 96 62
		15 00 00 00 00 00 02 97 02
		15 00 00 00 00 00 02 98 96
		15 00 00 00 00 00 02 99 02
		15 00 00 00 00 00 02 9A B7
		15 00 00 00 00 00 02 9B 02
		15 00 00 00 00 00 02 9C E6
		15 00 00 00 00 00 02 9D 03
		15 00 00 00 00 00 02 9E 0D
		15 00 00 00 00 00 02 9F 03
		15 00 00 00 00 00 02 A0 3E
		15 00 00 00 00 00 02 A2 03
		15 00 00 00 00 00 02 A3 50
		15 00 00 00 00 00 02 A4 03
		15 00 00 00 00 00 02 A5 5E
		15 00 00 00 00 00 02 A6 03
		15 00 00 00 00 00 02 A7 69
		15 00 00 00 00 00 02 A9 03
		15 00 00 00 00 00 02 AA 75
		15 00 00 00 00 00 02 AB 03
		15 00 00 00 00 00 02 AC 8D
		15 00 00 00 00 00 02 AD 03
		15 00 00 00 00 00 02 AE B4
		15 00 00 00 00 00 02 AF 03
		15 00 00 00 00 00 02 B0 CD
		15 00 00 00 00 00 02 B1 03
		15 00 00 00 00 00 02 B2 D0
		15 00 00 00 00 00 02 B3 00
		15 00 00 00 00 00 02 B4 C5
		15 00 00 00 00 00 02 B5 00
		15 00 00 00 00 00 02 B6 CF
		15 00 00 00 00 00 02 B7 00
		15 00 00 00 00 00 02 B8 E0
		15 00 00 00 00 00 02 B9 00
		15 00 00 00 00 00 02 BA F0
		15 00 00 00 00 00 02 BB 00
		15 00 00 00 00 00 02 BC FE
		15 00 00 00 00 00 02 BD 01
		15 00 00 00 00 00 02 BE 0A
		15 00 00 00 00 00 02 BF 01
		15 00 00 00 00 00 02 C0 16
		15 00 00 00 00 00 02 C1 01
		15 00 00 00 00 00 02 C2 20
		15 00 00 00 00 00 02 C3 01
		15 00 00 00 00 00 02 C4 2A
		15 00 00 00 00 00 02 C5 01
		15 00 00 00 00 00 02 C6 4D
		15 00 00 00 00 00 02 C7 01
		15 00 00 00 00 00 02 C8 6A
		15 00 00 00 00 00 02 C9 01
		15 00 00 00 00 00 02 CA 9B
		15 00 00 00 00 00 02 CB 01
		15 00 00 00 00 00 02 CC C1
		15 00 00 00 00 00 02 CD 01
		15 00 00 00 00 00 02 CE FE
		15 00 00 00 00 00 02 CF 02
		15 00 00 00 00 00 02 D0 32
		15 00 00 00 00 00 02 D1 02
		15 00 00 00 00 00 02 D2 33
		15 00 00 00 00 00 02 D3 02
		15 00 00 00 00 00 02 D4 62
		15 00 00 00 00 00 02 D5 02
		15 00 00 00 00 00 02 D6 96
		15 00 00 00 00 00 02 D7 02
		15 00 00 00 00 00 02 D8 B7
		15 00 00 00 00 00 02 D9 02
		15 00 00 00 00 00 02 DA E6
		15 00 00 00 00 00 02 DB 03
		15 00 00 00 00 00 02 DC 0D
		15 00 00 00 00 00 02 DD 03
		15 00 00 00 00 00 02 DE 3E
		15 00 00 00 00 00 02 DF 03
		15 00 00 00 00 00 02 E0 50
		15 00 00 00 00 00 02 E1 03
		15 00 00 00 00 00 02 E2 5E
		15 00 00 00 00 00 02 E3 03
		15 00 00 00 00 00 02 E4 69
		15 00 00 00 00 00 02 E5 03
		15 00 00 00 00 00 02 E6 75
		15 00 00 00 00 00 02 E7 03
		15 00 00 00 00 00 02 E8 8D
		15 00 00 00 00 00 02 E9 03
		15 00 00 00 00 00 02 EA B4
		15 00 00 00 00 00 02 EB 03
		15 00 00 00 00 00 02 EC CD
		15 00 00 00 00 00 02 ED 03
		15 00 00 00 00 00 02 EE D0
		15 00 00 00 00 00 02 EF 00
		15 00 00 00 00 00 02 F0 01
		15 00 00 00 00 00 02 F1 00
		15 00 00 00 00 00 02 F2 20
		15 00 00 00 00 00 02 F3 00
		15 00 00 00 00 00 02 F4 4B
		15 00 00 00 00 00 02 F5 00
		15 00 00 00 00 00 02 F6 6A
		15 00 00 00 00 00 02 F7 00
		15 00 00 00 00 00 02 F8 84
		15 00 00 00 00 00 02 F9 00
		15 00 00 00 00 00 02 FA 9A
		15 01 00 00 00 00 02 FB 01  
		15 01 00 00 00 00 02 FF 02
		15 00 00 00 00 00 02 00 00
		15 00 00 00 00 00 02 01 AD
		15 00 00 00 00 00 02 02 00
		15 00 00 00 00 00 02 03 BE
		15 00 00 00 00 00 02 04 00
		15 00 00 00 00 00 02 05 CE
		15 00 00 00 00 00 02 06 01
		15 00 00 00 00 00 02 07 01
		15 00 00 00 00 00 02 08 01
		15 00 00 00 00 00 02 09 2A
		15 00 00 00 00 00 02 0A 01
		15 00 00 00 00 00 02 0B 6A
		15 00 00 00 00 00 02 0C 01
		15 00 00 00 00 00 02 0D 9B
		15 00 00 00 00 00 02 0E 01
		15 00 00 00 00 00 02 0F E6
		15 00 00 00 00 00 02 10 02
		15 00 00 00 00 00 02 11 20
		15 00 00 00 00 00 02 12 02
		15 00 00 00 00 00 02 13 21
		15 00 00 00 00 00 02 14 02
		15 00 00 00 00 00 02 15 54
		15 00 00 00 00 00 02 16 02
		15 00 00 00 00 00 02 17 8A
		15 00 00 00 00 00 02 18 02
		15 00 00 00 00 00 02 19 AB
		15 00 00 00 00 00 02 1A 02
		15 00 00 00 00 00 02 1B DB
		15 00 00 00 00 00 02 1C 03
		15 00 00 00 00 00 02 1D 00
		15 00 00 00 00 00 02 1E 03
		15 00 00 00 00 00 02 1F 2C
		15 00 00 00 00 00 02 20 03
		15 00 00 00 00 00 02 21 39
		15 00 00 00 00 00 02 22 03
		15 00 00 00 00 00 02 23 48
		15 00 00 00 00 00 02 24 03
		15 00 00 00 00 00 02 25 5A
		15 00 00 00 00 00 02 26 03
		15 00 00 00 00 00 02 27 71
		15 00 00 00 00 00 02 28 03
		15 00 00 00 00 00 02 29 92
		15 00 00 00 00 00 02 2A 03
		15 00 00 00 00 00 02 2B B7
		15 00 00 00 00 00 02 2D 03
		15 00 00 00 00 00 02 2F CD
		15 00 00 00 00 00 02 30 03
		15 00 00 00 00 00 02 31 D0
		15 00 00 00 00 00 02 32 00
		15 00 00 00 00 00 02 33 01
		15 00 00 00 00 00 02 34 00
		15 00 00 00 00 00 02 35 20
		15 00 00 00 00 00 02 36 00
		15 00 00 00 00 00 02 37 4B
		15 00 00 00 00 00 02 38 00
		15 00 00 00 00 00 02 39 6A
		15 00 00 00 00 00 02 3A 00
		15 00 00 00 00 00 02 3B 84
		15 00 00 00 00 00 02 3D 00
		15 00 00 00 00 00 02 3F 9A
		15 00 00 00 00 00 02 40 00
		15 00 00 00 00 00 02 41 AD
		15 00 00 00 00 00 02 42 00
		15 00 00 00 00 00 02 43 BE
		15 00 00 00 00 00 02 44 00
		15 00 00 00 00 00 02 45 CE
		15 00 00 00 00 00 02 46 01
		15 00 00 00 00 00 02 47 01
		15 00 00 00 00 00 02 48 01
		15 00 00 00 00 00 02 49 2A
		15 00 00 00 00 00 02 4A 01
		15 00 00 00 00 00 02 4B 6A
		15 00 00 00 00 00 02 4C 01
		15 00 00 00 00 00 02 4D 9B
		15 00 00 00 00 00 02 4E 01
		15 00 00 00 00 00 02 4F E6
		15 00 00 00 00 00 02 50 02
		15 00 00 00 00 00 02 51 20
		15 00 00 00 00 00 02 52 02
		15 00 00 00 00 00 02 53 21
		15 00 00 00 00 00 02 54 02
		15 00 00 00 00 00 02 55 54
		15 00 00 00 00 00 02 56 02
		15 00 00 00 00 00 02 58 8A
		15 00 00 00 00 00 02 59 02
		15 00 00 00 00 00 02 5A AB
		15 00 00 00 00 00 02 5B 02
		15 00 00 00 00 00 02 5C DB
		15 00 00 00 00 00 02 5D 03
		15 00 00 00 00 00 02 5E 00
		15 00 00 00 00 00 02 5F 03
		15 00 00 00 00 00 02 60 2C
		15 00 00 00 00 00 02 61 03
		15 00 00 00 00 00 02 62 39
		15 00 00 00 00 00 02 63 03
		15 00 00 00 00 00 02 64 48
		15 00 00 00 00 00 02 65 03
		15 00 00 00 00 00 02 66 5A
		15 00 00 00 00 00 02 67 03
		15 00 00 00 00 00 02 68 71
		15 00 00 00 00 00 02 69 03
		15 00 00 00 00 00 02 6A 92
		15 00 00 00 00 00 02 6B 03
		15 00 00 00 00 00 02 6C B7
		15 00 00 00 00 00 02 6D 03
		15 00 00 00 00 00 02 6E CD
		15 00 00 00 00 00 02 6F 03
		15 00 00 00 00 00 02 70 D0
		15 00 00 00 00 00 02 71 00
		15 00 00 00 00 00 02 72 01
		15 00 00 00 00 00 02 73 00
		15 00 00 00 00 00 02 74 18
		15 00 00 00 00 00 02 75 00
		15 00 00 00 00 00 02 76 3B
		15 00 00 00 00 00 02 77 00
		15 00 00 00 00 00 02 78 5A
		15 00 00 00 00 00 02 79 00
		15 00 00 00 00 00 02 7A 73
		15 00 00 00 00 00 02 7B 00
		15 00 00 00 00 00 02 7C 88
		15 00 00 00 00 00 02 7D 00
		15 00 00 00 00 00 02 7E 9C
		15 00 00 00 00 00 02 7F 00
		15 00 00 00 00 00 02 80 AC
		15 00 00 00 00 00 02 81 00
		15 00 00 00 00 00 02 82 BC
		15 00 00 00 00 00 02 83 00
		15 00 00 00 00 00 02 84 F1
		15 00 00 00 00 00 02 85 01
		15 00 00 00 00 00 02 86 1B
		15 00 00 00 00 00 02 87 01
		15 00 00 00 00 00 02 88 5E
		15 00 00 00 00 00 02 89 01
		15 00 00 00 00 00 02 8A 90
		15 00 00 00 00 00 02 8B 01
		15 00 00 00 00 00 02 8C DE
		15 00 00 00 00 00 02 8D 02
		15 00 00 00 00 00 02 8E 1B
		15 00 00 00 00 00 02 8F 02
		15 00 00 00 00 00 02 90 1C
		15 00 00 00 00 00 02 91 02
		15 00 00 00 00 00 02 92 51
		15 00 00 00 00 00 02 93 02
		15 00 00 00 00 00 02 94 88
		15 00 00 00 00 00 02 95 02
		15 00 00 00 00 00 02 96 AA
		15 00 00 00 00 00 02 97 02
		15 00 00 00 00 00 02 98 DE
		15 00 00 00 00 00 02 99 03
		15 00 00 00 00 00 02 9A 09
		15 00 00 00 00 00 02 9B 03
		15 00 00 00 00 00 02 9C 4B
		15 00 00 00 00 00 02 9D 03
		15 00 00 00 00 00 02 9E 6F
		15 00 00 00 00 00 02 9F 03
		15 00 00 00 00 00 02 A0 90
		15 00 00 00 00 00 02 A2 03
		15 00 00 00 00 00 02 A3 92
		15 00 00 00 00 00 02 A4 03
		15 00 00 00 00 00 02 A5 93
		15 00 00 00 00 00 02 A6 03
		15 00 00 00 00 00 02 A7 94
		15 00 00 00 00 00 02 A9 03
		15 00 00 00 00 00 02 AA B1
		15 00 00 00 00 00 02 AB 03
		15 00 00 00 00 00 02 AC CC
		15 00 00 00 00 00 02 AD 03
		15 00 00 00 00 00 02 AE D0
		15 00 00 00 00 00 02 AF 00
		15 00 00 00 00 00 02 B0 01
		15 00 00 00 00 00 02 B1 00
		15 00 00 00 00 00 02 B2 18
		15 00 00 00 00 00 02 B3 00
		15 00 00 00 00 00 02 B4 3B
		15 00 00 00 00 00 02 B5 00
		15 00 00 00 00 00 02 B6 5A
		15 00 00 00 00 00 02 B7 00
		15 00 00 00 00 00 02 B8 73
		15 00 00 00 00 00 02 B9 00
		15 00 00 00 00 00 02 BA 88
		15 00 00 00 00 00 02 BB 00
		15 00 00 00 00 00 02 BC 9C
		15 00 00 00 00 00 02 BD 00
		15 00 00 00 00 00 02 BE AC
		15 00 00 00 00 00 02 BF 00
		15 00 00 00 00 00 02 C0 BC
		15 00 00 00 00 00 02 C1 00
		15 00 00 00 00 00 02 C2 F1
		15 00 00 00 00 00 02 C3 01
		15 00 00 00 00 00 02 C4 1B
		15 00 00 00 00 00 02 C5 01
		15 00 00 00 00 00 02 C6 5E
		15 00 00 00 00 00 02 C7 01
		15 00 00 00 00 00 02 C8 90
		15 00 00 00 00 00 02 C9 01
		15 00 00 00 00 00 02 CA DE
		15 00 00 00 00 00 02 CB 02
		15 00 00 00 00 00 02 CC 1B
		15 00 00 00 00 00 02 CD 02
		15 00 00 00 00 00 02 CE 1C
		15 00 00 00 00 00 02 CF 02
		15 00 00 00 00 00 02 D0 51
		15 00 00 00 00 00 02 D1 02
		15 00 00 00 00 00 02 D2 88
		15 00 00 00 00 00 02 D3 02
		15 00 00 00 00 00 02 D4 AA
		15 00 00 00 00 00 02 D5 02
		15 00 00 00 00 00 02 D6 DE
		15 00 00 00 00 00 02 D7 03
		15 00 00 00 00 00 02 D8 09
		15 00 00 00 00 00 02 D9 03
		15 00 00 00 00 00 02 DA 4B
		15 00 00 00 00 00 02 DB 03
		15 00 00 00 00 00 02 DC 6F
		15 00 00 00 00 00 02 DD 03
		15 00 00 00 00 00 02 DE 90
		15 00 00 00 00 00 02 DF 03
		15 00 00 00 00 00 02 E0 92
		15 00 00 00 00 00 02 E1 03
		15 00 00 00 00 00 02 E2 93
		15 00 00 00 00 00 02 E3 03
		15 00 00 00 00 00 02 E4 94
		15 00 00 00 00 00 02 E5 03
		15 00 00 00 00 00 02 E6 B1
		15 00 00 00 00 00 02 E7 03
		15 00 00 00 00 00 02 E8 CC
		15 00 00 00 00 00 02 E9 03
		15 00 00 00 00 00 02 EA D0
		15 01 00 00 00 00 02 FB 01
		//CMD1
		15 01 00 00 00 00 02 FF 00 
		15 01 00 00 00 00 02 D3 14
		15 01 00 00 00 00 02 D4 14
		15 01 00 00 00 00 02 35 00
		05 01 00 00 78 00 02 11 00
		05 01 00 00 14 00 02 29 00
		
		15 01 00 00 00 00 02 51 15
		15 01 00 00 00 00 02 53 2c   //LED(PWM) on
		15 01 00 00 00 00 02 55 03];//off
		qcom,mdss-dsi-panel-timings-com = [E6 38 26 00 68 6E 2A 3C 2C 03 04 00];
		qcom,mdss-dsi-t-clk-post-com = <0x02>;
		qcom,mdss-dsi-t-clk-pre-com = <0x2b>;
		//qcom,mdss-dsi-force-clock-lane-hs;
		
		qcom,mdss-dsi-bl-min-level = <1>;
		qcom,mdss-dsi-bl-max-level = <255>;
		qcom,mdss-dsi-bl-max-level-com = <220>;
		qcom,mdss-dsi-dma-trigger = "trigger_sw";
		qcom,mdss-dsi-mdp-trigger = "none";
		qcom,mdss-dsi-bl-pmic-control-type = "bl_ctrl_dcs";
		qcom,mdss-dsi-reset-sequence = <1 80>, <0 5>, <1 10>; 
		qcom,mdss-dsi-reset-sequence-com = <1 5>, <0 5>, <1 5>, <0 5>, <1 20>;
		qcom,mdss-pan-physical-width-dimension = <68>;
		qcom,mdss-pan-physical-height-dimension = <120>;
		qcom,platform-vendor-id = <&msm_gpio 49 0>;
	};
};


