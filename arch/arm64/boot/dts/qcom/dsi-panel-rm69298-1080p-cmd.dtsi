/* Copyright (c) 2015-2017, The Linux Foundation. All rights reserved.
 *
 * This program is free software; you can redistribute it and/or modify
 * it under the terms of the GNU General Public License version 2 and
 * only version 2 as published by the Free Software Foundation.
 *
 * This program is distributed in the hope that it will be useful,
 * but WITHOUT ANY WARRANTY; without even the implied warranty of
 * MERCHANTABILITY or FITNESS FOR A PARTICULAR PURPOSE.  See the
 * GNU General Public License for more details.
 */

&mdss_mdp {
	dsi_rm6928_1080_cmd: qcom,mdss_dsi_rm6928_1080p_cmd {
		qcom,mdss-dsi-panel-name = "rm6928 1080p cmd mode dsi panel";
		qcom,mdss-dsi-panel-type = "dsi_cmd_mode";
		qcom,mdss-dsi-virtual-channel-id = <0>;
		qcom,mdss-dsi-panel-destination = "display_1";
		qcom,mdss-dsi-stream = <0>;
		qcom,mdss-dsi-bpp = <24>;
		qcom,mdss-dsi-underflow-color = <0xff>;
		qcom,mdss-dsi-border-color = <0>;
		qcom,mdss-dsi-color-order = "rgb_swap_rgb";
		qcom,mdss-dsi-traffic-mode = "non_burst_sync_pulse";
		qcom,mdss-dsi-lane-map = "lane_map_0123";
		qcom,mdss-dsi-bllp-eof-power-mode;
		qcom,mdss-dsi-bllp-power-mode;
		qcom,mdss-dsi-lane-0-state;
		qcom,mdss-dsi-lane-1-state;
		qcom,mdss-dsi-lane-2-state;
		qcom,mdss-dsi-lane-3-state;
		qcom,mdss-pan-physical-width-dimension = <70>;
		qcom,mdss-pan-physical-height-dimension = <125>;
//#0244392 madan@smartisan.com fix boot panel snowflake issue begin.
		qcom,mdss-dsi-reset-sequence = <0 5>,<1 11>;
//#0244392 madan@smartisan.com fix boot panel snowflake issue end.
		//qcom,mdss-dsi-panel-orientation = "180";
		qcom,mdss-dsi-dma-trigger = "trigger_sw";
		qcom,mdss-dsi-mdp-trigger = "none";
		qcom,mdss-dsi-wr-mem-start = <0x2c>;
		qcom,mdss-dsi-wr-mem-continue = <0x3c>;
		qcom,mdss-dsi-te-pin-select = <1>;
		qcom,mdss-dsi-te-dcs-command = <1>;
		qcom,mdss-dsi-te-check-enable;
		qcom,mdss-dsi-te-using-te-pin;
		qcom,mdss-dsi-lp11-init;
		qcom,mdss-dsi-bl-pmic-control-type = "bl_ctrl_dcs";
		qcom,mdss-dsi-bl-min-level = <1>;
		qcom,mdss-dsi-bl-max-level = <255>;

		qcom,mdss-dsi-display-timings {
			timing@0{
				qcom,mdss-dsi-panel-width = <1080>;
				qcom,mdss-dsi-panel-height = <2160>;
				qcom,mdss-dsi-h-front-porch = <26>;
				qcom,mdss-dsi-h-back-porch = <36>;
				qcom,mdss-dsi-h-pulse-width = <2>;
				qcom,mdss-dsi-h-sync-skew = <0>;
				qcom,mdss-dsi-v-back-porch = <4>;
				qcom,mdss-dsi-v-front-porch = <208>;
				qcom,mdss-dsi-v-pulse-width = <4>;
				qcom,mdss-dsi-h-left-border = <0>;
				qcom,mdss-dsi-h-right-border = <0>;
				qcom,mdss-dsi-v-top-border = <0>;
				qcom,mdss-dsi-v-bottom-border = <0>;
				qcom,mdss-dsi-panel-framerate = <60>;
				qcom,mdss-dsi-panel-jitter = <0x40 0xa>;
//paper on
				qcom,mdss-dsi-panel-color-temperature-command = [
					15 01 00 00 00 00 02 FE 10
					15 01 00 00 00 00 02 00 FF
					15 01 00 00 00 00 02 01 07
					15 01 00 00 00 00 02 06 62
					15 01 00 00 00 00 02 07 06
					15 01 00 00 00 00 02 0C B6
					15 01 00 00 00 00 02 0D 03
					15 01 00 00 00 00 02 FE D0
					15 01 00 00 00 00 02 80 00
					15 01 00 00 00 00 02 FE 12
					15 01 00 00 00 00 02 84 00
					15 01 00 00 00 00 02 FE 40
					15 01 00 00 00 00 02 79 13];
				qcom,mdss-dsi-panel-color-temperature-command-reset = [
					15 01 00 00 00 00 02 FE 10
					15 01 00 00 00 00 02 00 AA
					15 01 00 00 00 00 02 01 A6
					15 01 00 00 00 00 02 02 11
					15 01 00 00 00 00 02 03 3E
					15 01 00 00 00 00 02 04 E0
					15 01 00 00 00 00 02 05 00
					15 01 00 00 00 00 02 06 B7
					15 01 00 00 00 00 02 07 67
					15 01 00 00 00 00 02 08 02
					15 01 00 00 00 00 02 09 07
					15 01 00 00 00 00 02 0A E0
					15 01 00 00 00 00 02 0B 05
					15 01 00 00 00 00 02 0C 87
					15 01 00 00 00 00 02 0D 07];
//paper off
				qcom,mdss-dsi-panel-color-temperature-command-restore = [
					15 01 00 00 00 00 02 FE 10
					15 01 00 00 00 00 02 00 62
					15 01 00 00 00 00 02 01 E6
					15 01 00 00 00 00 02 02 12
					15 01 00 00 00 00 02 03 74
					15 01 00 00 00 00 02 04 90
					15 01 00 00 00 00 02 05 02
					15 01 00 00 00 00 02 06 B8
					15 01 00 00 00 00 02 07 A7
					15 01 00 00 00 00 02 08 00
					15 01 00 00 00 00 02 09 17
					15 01 00 00 00 00 02 0A 30
					15 01 00 00 00 00 02 0B 08
					15 01 00 00 00 00 02 0C 51
					15 01 00 00 00 00 02 0D 07
					15 01 00 00 00 00 02 FE 40
					15 01 00 00 00 00 02 79 13];
				qcom,mdss-dsi-panel-sre-weak-level = [
					15 01 00 00 00 00 02 FE 80
					15 01 00 00 00 00 02 00 03
					15 01 00 00 00 00 02 08 00
					15 01 00 00 00 00 02 09 00
					15 01 00 00 00 00 02 0A 0F
					15 01 00 00 00 00 02 0B 00
					15 01 00 00 00 00 02 0C 00
					15 01 00 00 00 00 02 0D 00
					15 01 00 00 00 00 02 0E EF
					15 01 00 00 00 00 02 0F 0F
					15 01 00 00 00 00 02 FE 70
					15 01 00 00 00 00 02 00 B0
					15 01 00 00 00 00 02 02 8F
					15 01 00 00 00 00 02 03 1F
					15 01 00 00 00 00 02 08 00
					15 01 00 00 00 00 02 09 00
					15 01 00 00 00 00 02 0A 00
					15 01 00 00 00 00 02 0B 00
					15 01 00 00 00 00 02 0C 99
					15 01 00 00 00 00 02 0D AA
					15 01 00 00 00 00 02 0E BB
					15 01 00 00 00 00 02 0F CC
					15 01 00 00 00 00 02 FE 00
					15 01 00 00 00 00 02 5A 0B
					15 01 00 00 00 00 02 6A C0];
				qcom,mdss-dsi-panel-sre-middle-level = [
					15 01 00 00 00 00 02 FE 80
					15 01 00 00 00 00 02 00 03
					15 01 00 00 00 00 02 08 00
					15 01 00 00 00 00 02 09 00
					15 01 00 00 00 00 02 0A 0F
					15 01 00 00 00 00 02 0B 00
					15 01 00 00 00 00 02 0C 00
					15 01 00 00 00 00 02 0D 00
					15 01 00 00 00 00 02 0E EF
					15 01 00 00 00 00 02 0F 0F
					15 01 00 00 00 00 02 FE 70
					15 01 00 00 00 00 02 00 B0
					15 01 00 00 00 00 02 02 8F
					15 01 00 00 00 00 02 03 1F
					15 01 00 00 00 00 02 08 00
					15 01 00 00 00 00 02 09 00
					15 01 00 00 00 00 02 0A 00
					15 01 00 00 00 00 02 0B 00
					15 01 00 00 00 00 02 0C 99
					15 01 00 00 00 00 02 0D AA
					15 01 00 00 00 00 02 0E BB
					15 01 00 00 00 00 02 0F CC
					15 01 00 00 00 00 02 FE 00
					15 01 00 00 00 00 02 5A 0B
					15 01 00 00 00 00 02 6A CF];
				qcom,mdss-dsi-panel-sre-strong-level = [
					15 01 00 00 00 00 02 FE 80
					15 01 00 00 00 00 02 00 03
					15 01 00 00 00 00 02 08 00
					15 01 00 00 00 00 02 09 00
					15 01 00 00 00 00 02 0A 0F
					15 01 00 00 00 00 02 0B 00
					15 01 00 00 00 00 02 0C 00
					15 01 00 00 00 00 02 0D 00
					15 01 00 00 00 00 02 0E EF
					15 01 00 00 00 00 02 0F 0F
					15 01 00 00 00 00 02 FE 70
					15 01 00 00 00 00 02 00 B0
					15 01 00 00 00 00 02 02 8F
					15 01 00 00 00 00 02 03 1F
					15 01 00 00 00 00 02 08 00
					15 01 00 00 00 00 02 09 00
					15 01 00 00 00 00 02 0A 00
					15 01 00 00 00 00 02 0B 00
					15 01 00 00 00 00 02 0C 99
					15 01 00 00 00 00 02 0D AA
					15 01 00 00 00 00 02 0E BB
					15 01 00 00 00 00 02 0F CC
					15 01 00 00 00 00 02 FE 00
					15 01 00 00 00 00 02 5A 0B
					15 01 00 00 00 00 02 6A DF];
				qcom,mdss-dsi-panel-sre-exit-papermode = [
					15 01 00 00 00 00 02 FE 00
					15 01 00 00 00 00 02 5A 03
					15 01 00 00 00 00 02 6A 00
					15 01 00 00 00 00 02 FE 10
					15 01 00 00 00 00 02 00 FF
					15 01 00 00 00 00 02 01 07
					15 01 00 00 00 00 02 02 80
					15 01 00 00 00 00 02 03 00
					15 01 00 00 00 00 02 04 08
					15 01 00 00 00 00 02 05 00
					15 01 00 00 00 00 02 06 62
					15 01 00 00 00 00 02 07 06
					15 01 00 00 00 00 02 08 80
					15 01 00 00 00 00 02 09 00
					15 01 00 00 00 00 02 0A 08
					15 01 00 00 00 00 02 0B 00
					15 01 00 00 00 00 02 0C B6
					15 01 00 00 00 00 02 0D 03
					15 01 00 00 00 00 02 FE 12
					15 01 00 00 00 00 02 84 00
					15 01 00 00 00 00 02 FE 40
					15 01 00 00 00 00 02 79 13];
				qcom,mdss-dsi-panel-sre-exit-normal = [
					15 01 00 00 00 00 02 FE 00
					15 01 00 00 00 00 02 5A 03
					15 01 00 00 00 00 02 6A 80
];
				qcom,mdss-dsi-panel-ct-enter = [
					15 01 00 00 00 00 02 FE 10
					15 01 00 00 00 00 02 02 11
					15 01 00 00 00 00 02 03 3E
					15 01 00 00 00 00 02 04 E0
					15 01 00 00 00 00 02 05 00
					15 01 00 00 00 00 02 08 02
					15 01 00 00 00 00 02 09 07
					15 01 00 00 00 00 02 0A E0
					15 01 00 00 00 00 02 0B 05
					15 01 00 00 00 00 02 FE 40
					15 01 00 00 00 00 02 1D B8
					15 01 00 00 00 00 02 FE D0
					15 01 00 00 00 00 02 71 01
					15 01 00 00 00 00 02 FB AA
];

				qcom,mdss-dsi-panel-ct-exit = [
					15 01 00 00 00 00 02 FE 40
					15 01 00 00 00 00 02 1D F8
					15 01 00 00 00 00 02 FE D0
					15 01 00 00 00 00 02 71 02
					15 01 00 00 00 00 02 FB AA
];
				qcom,mdss-dsi-on-command-old = [
					15 01 00 00 00 00 02 FE 10
					15 01 00 00 00 00 02 0E 00
					15 01 00 00 00 00 02 0F 00
					15 01 00 00 00 00 02 10 01
					15 01 00 00 00 00 02 11 00
					15 01 00 00 00 00 02 12 08
					15 01 00 00 00 00 02 13 00
					15 01 00 00 00 00 02 14 24
					15 01 00 00 00 00 02 15 00
					15 01 00 00 00 00 02 16 54
					15 01 00 00 00 00 02 17 00
					15 01 00 00 00 00 02 18 98
					15 01 00 00 00 00 02 19 00
					15 01 00 00 00 00 02 1A EE
					15 01 00 00 00 00 02 1B 00
					15 01 00 00 00 00 02 1C 5F
					15 01 00 00 00 00 02 1D 01
					15 01 00 00 00 00 02 1E DF
					15 01 00 00 00 00 02 1F 01
					15 01 00 00 00 00 02 20 78
					15 01 00 00 00 00 02 21 02
					15 01 00 00 00 00 02 22 36
					15 01 00 00 00 00 02 23 03
					15 01 00 00 00 00 02 24 E6
					15 01 00 00 00 00 02 25 04
					15 01 00 00 00 00 02 26 12
					15 01 00 00 00 00 02 27 07
					15 01 00 00 00 00 02 28 88
					15 01 00 00 00 00 02 29 09
					15 01 00 00 00 00 02 2A 16
					15 01 00 00 00 00 02 2B 10
					15 01 00 00 00 00 02 2D 73
					15 01 00 00 00 00 02 2F 18
					15 01 00 00 00 00 02 30 42
					15 01 00 00 00 00 02 31 23
					15 01 00 00 00 00 02 32 1E
					15 01 00 00 00 00 02 33 30
					15 01 00 00 00 00 02 34 A9
					15 01 00 00 00 00 02 35 3F
					15 01 00 00 00 00 02 36 61
					15 01 00 00 00 00 02 37 52
					15 01 00 00 00 00 02 38 24
					15 01 00 00 00 00 02 39 67
					15 01 00 00 00 00 02 3A 64
					15 01 00 00 00 00 02 3B 7E
					15 01 00 00 00 00 02 3D 06
					15 01 00 00 00 00 02 3F 9A
					15 01 00 00 00 00 02 40 9B
					15 01 00 00 00 00 02 41 B7
					15 01 00 00 00 00 02 42 92
					15 01 00 00 00 00 02 43 DA
					15 01 00 00 00 00 02 44 FF
					15 01 00 00 00 00 02 45 FF
					15 01 00 00 00 00 02 46 00
					15 01 00 00 00 00 02 47 00
					15 01 00 00 00 00 02 48 00
					15 01 00 00 00 00 02 49 00
					15 01 00 00 00 00 02 4A 0D
					15 01 00 00 00 00 02 4B 00
					15 01 00 00 00 00 02 4C 27
					15 01 00 00 00 00 02 4D 00
					15 01 00 00 00 00 02 4E 5A
					15 01 00 00 00 00 02 4F 00
					15 01 00 00 00 00 02 50 A2
					15 01 00 00 00 00 02 51 00
					15 01 00 00 00 00 02 52 FC
					15 01 00 00 00 00 02 53 00
					15 01 00 00 00 00 02 54 68
					15 01 00 00 00 00 02 55 01
					15 01 00 00 00 00 02 56 F0
					15 01 00 00 00 00 02 58 01
					15 01 00 00 00 00 02 59 91
					15 01 00 00 00 00 02 5A 02
					15 01 00 00 00 00 02 5B 3B
					15 01 00 00 00 00 02 5C 03
					15 01 00 00 00 00 02 5D F8
					15 01 00 00 00 00 02 5E 04
					15 01 00 00 00 00 02 5F 0F
					15 01 00 00 00 00 02 60 07
					15 01 00 00 00 00 02 61 88
					15 01 00 00 00 00 02 62 09
					15 01 00 00 00 00 02 63 E0
					15 01 00 00 00 00 02 64 0F
					15 01 00 00 00 00 02 65 5A
					15 01 00 00 00 00 02 66 18
					15 01 00 00 00 00 02 67 8D
					15 01 00 00 00 00 02 68 22
					15 01 00 00 00 00 02 69 A9
					15 01 00 00 00 00 02 6A 2F
					15 01 00 00 00 00 02 6B 0E
					15 01 00 00 00 00 02 6C 3F
					15 01 00 00 00 00 02 6D 5F
					15 01 00 00 00 00 02 6E 50
					15 01 00 00 00 00 02 6F F1
					15 01 00 00 00 00 02 70 64
					15 01 00 00 00 00 02 71 1F
					15 01 00 00 00 00 02 72 7C
					15 01 00 00 00 00 02 73 30
					15 01 00 00 00 00 02 74 97
					15 01 00 00 00 00 02 75 FA
					15 01 00 00 00 00 02 76 B4
					15 01 00 00 00 00 02 77 20
					15 01 00 00 00 00 02 78 D8
					15 01 00 00 00 00 02 79 FF
					15 01 00 00 00 00 02 7A FF
					15 01 00 00 00 00 02 7B 00
					15 01 00 00 00 00 02 7C 00
					15 01 00 00 00 00 02 7D 03
					15 01 00 00 00 00 02 7E 00
					15 01 00 00 00 00 02 7F 0C
					15 01 00 00 00 00 02 80 00
					15 01 00 00 00 00 02 81 30
					15 01 00 00 00 00 02 82 00
					15 01 00 00 00 00 02 83 62
					15 01 00 00 00 00 02 84 00
					15 01 00 00 00 00 02 85 A9
					15 01 00 00 00 00 02 86 00
					15 01 00 00 00 00 02 87 09
					15 01 00 00 00 00 02 88 01
					15 01 00 00 00 00 02 89 7F
					15 01 00 00 00 00 02 8A 01
					15 01 00 00 00 00 02 8B 0F
					15 01 00 00 00 00 02 8C 02
					15 01 00 00 00 00 02 8D B5
					15 01 00 00 00 00 02 8E 02
					15 01 00 00 00 00 02 8F 6E
					15 01 00 00 00 00 02 90 03
					15 01 00 00 00 00 02 91 35
					15 01 00 00 00 00 02 92 05
					15 01 00 00 00 00 02 93 7A
					15 01 00 00 00 00 02 94 07
					15 01 00 00 00 00 02 95 0E
					15 01 00 00 00 00 02 96 0A
					15 01 00 00 00 00 02 97 2E
					15 01 00 00 00 00 02 98 11
					15 01 00 00 00 00 02 99 B7
					15 01 00 00 00 00 02 9A 19
					15 01 00 00 00 00 02 9B CB
					15 01 00 00 00 00 02 9C 24
					15 01 00 00 00 00 02 9D 69
					15 01 00 00 00 00 02 9E 32
					15 01 00 00 00 00 02 9F 3D
					15 01 00 00 00 00 02 A0 42
					15 01 00 00 00 00 02 A2 17
					15 01 00 00 00 00 02 A3 54
					15 01 00 00 00 00 02 A4 B1
					15 01 00 00 00 00 02 A5 68
					15 01 00 00 00 00 02 A6 FB
					15 01 00 00 00 00 02 A7 7F
					15 01 00 00 00 00 02 A9 16
					15 01 00 00 00 00 02 AA 9A
					15 01 00 00 00 00 02 AB E2
					15 01 00 00 00 00 02 AC B7
					15 01 00 00 00 00 02 AD CD
					15 01 00 00 00 00 02 AE D9
					15 01 00 00 00 00 02 AF FF
					15 01 00 00 00 00 02 B0 FF
					15 01 00 00 00 00 02 FE 12
					15 01 00 00 00 00 02 00 00
					15 01 00 00 00 00 02 01 45
					15 01 00 00 00 00 02 02 00
					15 01 00 00 00 00 02 03 54
					15 01 00 00 00 00 02 04 62
					15 01 00 00 00 00 02 05 00
					15 01 00 00 00 00 02 06 85
					15 01 00 00 00 00 02 07 A0
					15 01 00 00 00 00 02 08 00
					15 01 00 00 00 00 02 09 B9
					15 01 00 00 00 00 02 0A CB
					15 01 00 00 00 00 02 0B 00
					15 01 00 00 00 00 02 0C DB
					15 01 00 00 00 00 02 0D FB
					15 01 00 00 00 00 02 0E 00
					15 01 00 00 00 00 02 0F 2C
					15 01 00 00 00 00 02 10 56
					15 01 00 00 00 00 02 11 11
					15 01 00 00 00 00 02 12 97
					15 01 00 00 00 00 02 13 D1
					15 01 00 00 00 00 02 14 11
					15 01 00 00 00 00 02 15 2B
					15 01 00 00 00 00 02 16 76
					15 01 00 00 00 00 02 17 22
					15 01 00 00 00 00 02 18 F0
					15 01 00 00 00 00 02 19 53
					15 01 00 00 00 00 02 1A 32
					15 01 00 00 00 00 02 1B F6
					15 01 00 00 00 00 02 1C 7A
					15 01 00 00 00 00 02 1D 43
					15 01 00 00 00 00 02 1E EA
					15 01 00 00 00 00 02 1F 4F
					15 01 00 00 00 00 02 20 54
					15 01 00 00 00 00 02 21 AB
					15 01 00 00 00 00 02 22 FF
					15 01 00 00 00 00 02 23 55
					15 01 00 00 00 00 02 24 94
					15 01 00 00 00 00 02 25 16
					15 01 00 00 00 00 02 26 76
					15 01 00 00 00 00 02 27 8C
					15 01 00 00 00 00 02 28 F8
					15 01 00 00 00 00 02 29 77
					15 01 00 00 00 00 02 2A 00
					15 01 00 00 00 00 02 2B 3D
					15 01 00 00 00 00 02 2D 00
					15 01 00 00 00 00 02 2F 4F
					15 01 00 00 00 00 02 30 5E
					15 01 00 00 00 00 02 31 00
					15 01 00 00 00 00 02 32 82
					15 01 00 00 00 00 02 33 9C
					15 01 00 00 00 00 02 34 00
					15 01 00 00 00 00 02 35 B4
					15 01 00 00 00 00 02 36 C8
					15 01 00 00 00 00 02 37 00
					15 01 00 00 00 00 02 38 DA
					15 01 00 00 00 00 02 39 F8
					15 01 00 00 00 00 02 3A 00
					15 01 00 00 00 00 02 3B 2A
					15 01 00 00 00 00 02 3D 54
					15 01 00 00 00 00 02 3F 11
					15 01 00 00 00 00 02 40 97
					15 01 00 00 00 00 02 41 D1
					15 01 00 00 00 00 02 42 11
					15 01 00 00 00 00 02 43 2C
					15 01 00 00 00 00 02 44 79
					15 01 00 00 00 00 02 45 22
					15 01 00 00 00 00 02 46 F2
					15 01 00 00 00 00 02 47 58
					15 01 00 00 00 00 02 48 32
					15 01 00 00 00 00 02 49 FA
					15 01 00 00 00 00 02 4A 7E
					15 01 00 00 00 00 02 4B 43
					15 01 00 00 00 00 02 4C F4
					15 01 00 00 00 00 02 4D 5A
					15 01 00 00 00 00 02 4E 54
					15 01 00 00 00 00 02 4F B8
					15 01 00 00 00 00 02 50 0C
					15 01 00 00 00 00 02 51 65
					15 01 00 00 00 00 02 52 9F
					15 01 00 00 00 00 02 53 20
					15 01 00 00 00 00 02 54 76
					15 01 00 00 00 00 02 55 96
					15 01 00 00 00 00 02 56 F8
					15 01 00 00 00 00 02 58 77
					15 01 00 00 00 00 02 59 00
					15 01 00 00 00 00 02 5A 3C
					15 01 00 00 00 00 02 5B 00
					15 01 00 00 00 00 02 5C 4C
					15 01 00 00 00 00 02 5D 58
					15 01 00 00 00 00 02 5E 00
					15 01 00 00 00 00 02 5F 80
					15 01 00 00 00 00 02 60 9A
					15 01 00 00 00 00 02 61 00
					15 01 00 00 00 00 02 62 B0
					15 01 00 00 00 00 02 63 C4
					15 01 00 00 00 00 02 64 00
					15 01 00 00 00 00 02 65 D4
					15 01 00 00 00 00 02 66 F1
					15 01 00 00 00 00 02 67 00
					15 01 00 00 00 00 02 68 23
					15 01 00 00 00 00 02 69 4B
					15 01 00 00 00 00 02 6A 11
					15 01 00 00 00 00 02 6B 8D
					15 01 00 00 00 00 02 6C C5
					15 01 00 00 00 00 02 6D 11
					15 01 00 00 00 00 02 6E 1C
					15 01 00 00 00 00 02 6F 65
					15 01 00 00 00 00 02 70 22
					15 01 00 00 00 00 02 71 DE
					15 01 00 00 00 00 02 72 43
					15 01 00 00 00 00 02 73 32
					15 01 00 00 00 00 02 74 E1
					15 01 00 00 00 00 02 75 67
					15 01 00 00 00 00 02 76 43
					15 01 00 00 00 00 02 77 DB
					15 01 00 00 00 00 02 78 44
					15 01 00 00 00 00 02 79 54
					15 01 00 00 00 00 02 7A A2
					15 01 00 00 00 00 02 7B F8
					15 01 00 00 00 00 02 7C 55
					15 01 00 00 00 00 02 7D 92
					15 01 00 00 00 00 02 7E 17
					15 01 00 00 00 00 02 7F 76
					15 01 00 00 00 00 02 80 91
					15 01 00 00 00 00 02 81 F8
					15 01 00 00 00 00 02 82 77
					15 01 00 00 00 00 02 86 00
					15 01 00 00 00 00 02 87 00
					15 01 00 00 00 00 02 88 00
					39 01 00 00 00 00 02 FE A0
					39 01 00 00 00 00 02 16 00
					39 01 00 00 00 00 02 FE A0
					39 01 00 00 00 00 02 25 86
					39 01 00 00 00 00 02 2F 37
					39 01 00 00 00 00 02 30 03
					39 01 00 00 00 00 02 FE 00
					39 01 00 00 00 00 02 C2 08
					39 01 00 00 00 00 02 35 00
					39 01 00 00 00 00 02 51 FF
					39 01 00 00 80 00 02 11 00
					39 01 00 00 20 00 02 29 00];

				qcom,mdss-dsi-HBM-enable = [
					15 01 00 00 00 00 02 fe 40
					15 01 00 00 00 00 02 64 02
					15 01 00 00 00 00 02 FE 00
					15 01 00 00 00 00 02 53 E0];

				qcom,mdss-dsi-HBM-disable = [
					15 01 00 00 00 00 02 fe 40
					15 01 00 00 00 00 02 64 02
					15 01 00 00 00 00 02 FE 00
					15 01 00 00 00 00 02 53 20];

				qcom,mdss-dsi-CGM-P3-feature = [
					15 01 00 00 00 00 02 FE 10
					15 01 00 00 00 00 02 00 AA
					15 01 00 00 00 00 02 01 A6
					15 01 00 00 00 00 02 02 11
					15 01 00 00 00 00 02 03 3E
					15 01 00 00 00 00 02 04 E0
					15 01 00 00 00 00 02 05 00
					15 01 00 00 00 00 02 06 B7
					15 01 00 00 00 00 02 07 67
					15 01 00 00 00 00 02 08 02
					15 01 00 00 00 00 02 09 07
					15 01 00 00 00 00 02 0A E0
					15 01 00 00 00 00 02 0B 05
					15 01 00 00 00 00 02 0C 87
					15 01 00 00 00 00 02 0D 07
					15 01 00 00 00 00 02 FE D0
					15 01 00 00 00 00 02 80 00
					15 01 00 00 00 00 02 FE 40
					15 01 00 00 00 00 02 79 13];

				qcom,mdss-dsi-CGM-sRGB-feature = [
					15 01 00 00 00 00 02 FE 10
					15 01 00 00 00 00 02 00 DA
					15 01 00 00 00 00 02 01 75
					15 01 00 00 00 00 02 02 1E
					15 01 00 00 00 00 02 03 43
					15 01 00 00 00 00 02 04 00
					15 01 00 00 00 00 02 05 04
					15 01 00 00 00 00 02 06 A6
					15 01 00 00 00 00 02 07 47
					15 01 00 00 00 00 02 08 00
					15 01 00 00 00 00 02 09 1F
					15 01 00 00 00 00 02 0A A0
					15 01 00 00 00 00 02 0B 0C
					15 01 00 00 00 00 02 0C 03
					15 01 00 00 00 00 02 0D 07
					15 01 00 00 00 00 02 FE D0
					15 01 00 00 00 00 02 80 00
					15 01 00 00 00 00 02 FE 40
					15 01 00 00 00 00 02 79 13];

				qcom,mdss-dsi-CGM-Native-feature = [
					15 01 00 00 00 00 02 FE 10
					15 01 00 00 00 00 02 00 BF
					15 01 00 00 00 00 02 01 07
					15 01 00 00 00 00 02 02 80
					15 01 00 00 00 00 02 03 42
					15 01 00 00 00 00 02 04 00
					15 01 00 00 00 00 02 05 00
					15 01 00 00 00 00 02 06 C2
					15 01 00 00 00 00 02 07 87
					15 01 00 00 00 00 02 08 02
					15 01 00 00 00 00 02 09 00
					15 01 00 00 00 00 02 0A 00
					15 01 00 00 00 00 02 0B 00
					15 01 00 00 00 00 02 0C EA
					15 01 00 00 00 00 02 0D 07
					15 01 00 00 00 00 02 FE D0
					15 01 00 00 00 00 02 80 00
					15 01 00 00 00 00 02 FE 40
					15 01 00 00 00 00 02 79 13];

				qcom,mdss-dsi-roi-prepare = [
					15 01 00 00 00 00 02 FE 40
					15 01 00 00 00 00 02 0d 90
					15 01 00 00 00 00 02 FE 00];
				qcom,mdss-dsi-on-command = [
//DCI-P3
					15 01 00 00 00 00 02 FE 10
					15 01 00 00 00 00 02 00 AA
					15 01 00 00 00 00 02 01 A6
					15 01 00 00 00 00 02 02 11
					15 01 00 00 00 00 02 03 3E
					15 01 00 00 00 00 02 04 E0
					15 01 00 00 00 00 02 05 00
					15 01 00 00 00 00 02 06 B7
					15 01 00 00 00 00 02 07 67
					15 01 00 00 00 00 02 08 02
					15 01 00 00 00 00 02 09 07
					15 01 00 00 00 00 02 0A E0
					15 01 00 00 00 00 02 0B 05
					15 01 00 00 00 00 02 0C 87
					15 01 00 00 00 00 02 0D 07
					15 01 00 00 00 00 02 FE D0
					15 01 00 00 00 00 02 80 00
					15 01 00 00 00 00 02 FE 40
					15 01 00 00 00 00 02 79 13
					15 01 00 00 00 00 02 3D 62
					15 01 00 00 00 00 02 FE 12
					15 01 00 00 00 00 02 84 00
					15 01 00 00 00 00 02 FE 80
					15 01 00 00 00 00 02 00 03
					15 01 00 00 00 00 02 08 00
					15 01 00 00 00 00 02 09 00
					15 01 00 00 00 00 02 0A 0F
					15 01 00 00 00 00 02 0B 00
					15 01 00 00 00 00 02 0C 00
					15 01 00 00 00 00 02 0D 00
					15 01 00 00 00 00 02 0E EF
					15 01 00 00 00 00 02 0F 0F
					15 01 00 00 00 00 02 FE 70
					15 01 00 00 00 00 02 00 B0
					15 01 00 00 00 00 02 02 8F
					15 01 00 00 00 00 02 03 1F
					15 01 00 00 00 00 02 08 00
					15 01 00 00 00 00 02 09 00
					15 01 00 00 00 00 02 0A 00
					15 01 00 00 00 00 02 0B 00
					15 01 00 00 00 00 02 0C 99
					15 01 00 00 00 00 02 0D AA
					15 01 00 00 00 00 02 0E BB
					15 01 00 00 00 00 02 0F CC
//51 10bit
					39 01 00 00 00 00 02 52 50
					39 01 00 00 00 00 02 7D 31
					39 01 00 00 00 00 02 7E 4A
					39 01 00 00 00 00 02 7F 40

					39 01 00 00 00 00 02 FE 00
					39 01 00 00 00 00 02 C2 08
					39 01 00 00 00 00 02 35 00
					39 01 00 00 00 00 03 51 00 00
					39 01 00 00 00 00 02 11 00
					39 01 00 00 60 00 02 29 00];
				qcom,mdss-dsi-off-command = [
					05 01 00 00 10 00 01 28
					05 01 00 00 40 00 01 10];
				qcom,mdss-dsi-panel-color-temperature-command-state = "dsi_hs_mode";
				qcom,mdss-dsi-panel-color-temperature-command-reset-state = "dsi_hs_mode";
				qcom,mdss-dsi-panel-color-temperature-command-restore-state = "dsi_hs_mode";
				qcom,mdss-dsi-panel-sre-weak-level-state = "dsi_hs_mode";
				qcom,mdss-dsi-panel-sre-middle-level-state = "dsi_hs_mode";
				qcom,mdss-dsi-panel-sre-strong-level-state = "dsi_hs_mode";
				qcom,mdss-dsi-panel-sre-exit-papermode-state = "dsi_hs_mode";
				qcom,mdss-dsi-panel-sre-exit-normal-state = "dsi_hs_mode";
				qcom,mdss-dsi-HBM-disable-state="dsi_hs_mode";
				qcom,mdss-dsi-HBM-enable-state="dsi_hs_mode";
				qcom,mdss-dsi-CGM-Native-feature-state="dsi_hs_mode";
				qcom,mdss-dsi-CGM-sRGB-feature-state="dsi_hs_mode";
				qcom,mdss-dsi-CGM-P3-feature-state="dsi_hs_mode";
				qcom,mdss-dsi-roi-prepare-state = "dsi_hs_mode";
				qcom,mdss-dsi-panel-ct-enter-state = "dsi_hs_mode";
				qcom,mdss-dsi-panel-ct-exit-state = "dsi_hs_mode";
				qcom,mdss-dsi-on-command-state = "dsi_lp_mode";
				qcom,mdss-dsi-off-command-state = "dsi_hs_mode";
				qcom,mdss-dsi-h-sync-pulse = <0>;
			};
		};
	};
};
