
qcom,dc103atl_3600mah {
	qcom, = <24>;
	/* #3278808_Smartisan_DC103atl_3600mAh_averaged_MasterSlave_Jan15th2018*/
	qcom,max-voltage-uv = <4410000>;
	qcom,nom-batt-capacity-mah = <3600>;
	qcom,fastchg-current-ma = <3500>;
	qcom,jeita-fcc-ranges = <0   150  650000
				151  450  3500000
				451  600  1700000>;
	qcom,jeita-fv-ranges = <0   150  4410000
				151 450  4410000
				451 600  4100000>;
	qcom,batt-id-kohm = <10>;
	qcom,battery-beta = <3435>;
	qcom,fg-cc-cv-threshold-mv = <4390>;
	qcom,battery-type = "dc103atl_3600mah";
	qcom,checksum = <0x1377>;
	qcom,gui-version = "PMI8998GUI - 2.0.0.58";
	qcom,fg-profile-data = [
		 B8 1E B0 06
		 1E 03 46 07
		 DD 1C 0C 02
		 81 0D E8 0A
		 C4 17 F4 23
		 29 44 8E 5A
		 6A 00 00 00
		 10 00 00 00
		 00 00 7E BD
		 DD CD 7C C2
		 22 00 08 00
		 74 CD D7 E5
		 99 06 B2 00
		 01 FC 63 0A
		 6D 0D 85 2A
		 16 06 09 20
		 27 00 14 00
		 6B 1F FC 05
		 1F 0A B1 06
		 B9 1C 36 03
		 AE 15 97 12
		 72 18 14 2A
		 8E 4D FF 5B
		 63 00 00 00
		 0D 00 00 00
		 00 00 DC D5
		 44 CA 13 C2
		 1C 00 00 00
		 52 EA D7 E5
		 E7 FD D2 EB
		 1C E2 A5 03
		 D9 E3 61 1A
		 A2 33 CC FF
		 07 10 00 00
		 05 0E 66 46
		 1C 00 40 00
		 7E 01 0A FA
		 FF 00 00 00
		 00 00 00 00
		 00 00 00 00
		 00 00 00 00
		 00 00 00 00
		 00 00 00 00
		 00 00 00 00
		 00 00 00 00
		 00 00 00 00
		 00 00 00 00
		 00 00 00 00
		 00 00 00 00
		 00 00 00 00
		 00 00 00 00
		 00 00 00 00
		 00 00 00 00
		 00 00 00 00
		 00 00 00 00
		 00 00 00 00
	];
};
