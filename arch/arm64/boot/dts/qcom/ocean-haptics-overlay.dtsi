/* Copyright (c) 2017-2018, The Linux Foundation. All rights reserved.
 *
 * This program is free software; you can redistribute it and/or modify
 * it under the terms of the GNU General Public License version 2 and
 * only version 2 as published by the Free Software Foundation.
 *
 * This program is distributed in the hope that it will be useful,
 * but WITHOUT ANY WARRANTY; without even the implied warranty of
 * MERCHANTABILITY or FITNESS FOR A PARTICULAR PURPOSE.  See the
 * GNU General Public License for more details.
 */


/*
 * Linear Vibrator Specification
 *
 * Rated Voltage: 2.0Vrms AC (Sine wave)
 * Operational Frequency: F0 205Hz
 * Resistance: Max. 12Ohm
 */

&pm660_haptics {
	qcom,lra-auto-mode;
	qcom,wave-shape = "sine";
	qcom,vmax-mv = <2828>; // 2.0Vrms = 2.828Vmax
	qcom,ilim-ma = <800>;
	qcom,wave-play-rate-us = <4831>; // 205Hz + 2Hz
	status = "okay";
};
