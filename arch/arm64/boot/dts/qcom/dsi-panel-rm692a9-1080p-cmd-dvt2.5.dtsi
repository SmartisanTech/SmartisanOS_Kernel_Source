/* Copyright (c) 2015-2017, The Linux Foundation. All rights reserved.
 *
 * This program is free software; you can redistribute it and/or modify
 * it under the terms of the GNU General Public License version 2 and
 * only version 2 as published by the Free Software Foundation.
 *
 * This program is distributed in the hope that it will be useful,
 * but WITHOUT ANY WARRANTY; without even the implied warranty of
 * MERCHANTABILITY or FITNESS FOR A PARTICULAR PURPOSE.  See the
 * GNU General Public License for more details.
 */

&mdss_mdp {
	dsi_rm692a9_1080_cmd_dvt25: qcom,mdss_dsi_rm692a9_1080p_cmd_dvt25 {
		qcom,mdss-dsi-panel-name = "rm692a9 1080p cmd mode dsi dvt2.5 panel";
		qcom,mdss-dsi-panel-type = "dsi_cmd_mode";
		qcom,mdss-dsi-virtual-channel-id = <0>;
		qcom,mdss-dsi-panel-destination = "display_1";
		qcom,mdss-dsi-stream = <0>;
		qcom,mdss-dsi-bpp = <24>;
		qcom,mdss-dsi-underflow-color = <0xff>;
		qcom,mdss-dsi-border-color = <0>;
		qcom,mdss-dsi-color-order = "rgb_swap_rgb";
		qcom,mdss-dsi-traffic-mode = "non_burst_sync_pulse";
		qcom,mdss-dsi-lane-map = "lane_map_0123";
		qcom,mdss-dsi-bllp-eof-power-mode;
		qcom,mdss-dsi-bllp-power-mode;
		qcom,mdss-dsi-lane-0-state;
		qcom,mdss-dsi-lane-1-state;
		qcom,mdss-dsi-lane-2-state;
		qcom,mdss-dsi-lane-3-state;
		qcom,mdss-pan-physical-width-dimension = <70>;
		qcom,mdss-pan-physical-height-dimension = <125>;
		qcom,mdss-dsi-reset-sequence = <1 1>,<0 1>,<1 10>;
		qcom,mdss-dsi-dma-trigger = "trigger_sw";
		qcom,mdss-dsi-mdp-trigger = "none";
		qcom,mdss-dsi-wr-mem-start = <0x2c>;
		qcom,mdss-dsi-wr-mem-continue = <0x3c>;
		qcom,mdss-dsi-te-pin-select = <1>;
		qcom,mdss-dsi-te-dcs-command = <1>;
		qcom,mdss-dsi-te-check-enable;
		qcom,mdss-dsi-te-using-te-pin;
		qcom,mdss-dsi-bl-pmic-control-type = "bl_ctrl_dcs";
		qcom,mdss-dsi-bl-min-level = <1>;
		qcom,mdss-dsi-bl-max-level = <255>;
		qcom,mdss-brightness-max-level = <2047>;

		qcom,mdss-dsi-display-timings {
			timing@0{
				qcom,mdss-dsi-panel-width = <1080>;
				qcom,mdss-dsi-panel-height = <2340>;
				qcom,mdss-dsi-h-front-porch = <26>;
				qcom,mdss-dsi-h-back-porch = <36>;
				qcom,mdss-dsi-h-pulse-width = <2>;
				qcom,mdss-dsi-h-sync-skew = <0>;
				qcom,mdss-dsi-v-front-porch = <12>;
				qcom,mdss-dsi-v-back-porch = <4>;
				qcom,mdss-dsi-v-pulse-width = <4>;
				qcom,mdss-dsi-h-left-border = <0>;
				qcom,mdss-dsi-h-right-border = <0>;
				qcom,mdss-dsi-v-top-border = <0>;
				qcom,mdss-dsi-v-bottom-border = <0>;
				qcom,mdss-dsi-panel-framerate = <60>;
				qcom,mdss-dsi-panel-jitter = <0x40 0xa>;

				qcom,mdss-dsi-on-command = [
					15 01 00 00 00 00 02 FE 40
					15 01 00 00 00 00 02 9A 01
//dynamic ELVSS
					15 01 00 00 00 00 02 FE E0
					15 01 00 00 00 00 02 91 21
					15 01 00 00 00 00 02 92 20
					15 01 00 00 00 00 02 93 1F
					15 01 00 00 00 00 02 94 1E
					15 01 00 00 00 00 02 95 1D
					15 01 00 00 00 00 02 96 1C
					15 01 00 00 00 00 02 97 1B
					15 01 00 00 00 00 02 9A 01
					15 01 00 00 00 00 02 9B 02
					15 01 00 00 00 00 02 9C 03
					15 01 00 00 00 00 02 9D 0F
					15 01 00 00 00 00 02 9E 3F
					15 01 00 00 00 00 02 9F 7F
					15 01 00 00 00 00 02 FE 00
					15 01 00 00 00 00 02 5E 01
					15 01 00 00 00 00 02 FE E0
					15 01 00 00 00 00 02 8B 02
					15 01 00 00 00 00 02 8E 22
					15 01 00 00 00 00 02 90 14
					15 01 00 00 00 00 02 FE 70
					15 01 00 00 00 00 02 11 C0
					15 01 00 00 00 00 02 17 00
//dynamic ELVSS end
//4 acl start. remove lator.
					15 01 00 00 00 00 02 FE 72
					15 01 00 00 00 00 02 CA 80
					15 01 00 00 00 00 02 CE 02
//4 acl end. remove lator.
//1 to fix source bl flash start. remove lator.
					15 01 00 00 00 00 02 FE 12
					15 01 00 00 00 00 02 AA C0
//1 to fix source bl flash end. remove lator.
//3 to fix huijie guodu zhankai start. need it.
					15 01 00 00 00 00 02 A5 57
					15 01 00 00 00 00 02 A6 00
					15 01 00 00 00 00 02 A7 99
					15 01 00 00 00 00 02 A9 12
					15 01 00 00 00 00 02 84 08
//3 to fix huijie guodu zhankai end. need it.
//#0366717 begin.
					15 01 00 00 00 00 02 fe b0
					15 01 00 00 00 00 02 24 00
					15 01 00 00 00 00 02 25 5f
//#0366717 begin.
					15 01 00 00 00 00 02 fe 00
					15 01 00 00 00 00 02 c2 08
					15 01 00 00 00 00 02 35 00
					39 01 00 00 00 00 03 51 00 00
					15 01 00 00 60 00 02 11 00
					15 01 00 00 00 00 02 29 00];
				qcom,mdss-dsi-off-command = [
					05 01 00 00 20 00 02 28 00
					05 01 00 00 10 00 02 10 00];
				qcom,mdss-dsi-HBM-enable = [
					15 01 00 00 00 00 02 FE 72
					15 01 00 00 00 00 02 19 DD
					15 01 00 00 00 00 02 1A 03
					15 01 00 00 00 00 02 fe 00
					15 01 00 00 00 00 02 53 28
					39 01 00 00 00 00 03 51 0f ff];
				qcom,mdss-dsi-HBM-disable = [
					15 01 00 00 00 00 02 FE 72
					15 01 00 00 00 00 02 19 00
					15 01 00 00 00 00 02 1A 03
					15 01 00 00 00 00 02 fe 00
					15 01 00 00 00 00 02 53 20];
				qcom,mdss-dsi-panel-ct-enter = [
					15 01 00 00 00 00 02 FE 10
					15 01 00 00 00 00 02 0E 00
					15 01 00 00 00 00 02 0F 00
					15 01 00 00 00 00 02 10 00
					15 01 00 00 00 00 02 11 00
					15 01 00 00 00 00 02 12 00
					15 01 00 00 00 00 02 13 08
					15 01 00 00 00 00 02 14 14
					15 01 00 00 00 00 02 15 00
					15 01 00 00 00 00 02 16 1D
					15 01 00 00 00 00 02 18 00
					15 01 00 00 00 00 02 19 31
					15 01 00 00 00 00 02 1A 39
					15 01 00 00 00 00 02 1B 00
					15 01 00 00 00 00 02 1E 00
					15 01 00 00 00 00 02 21 00
					15 01 00 00 00 00 02 24 10
					15 01 00 00 00 00 02 27 11
					15 01 00 00 00 00 02 2A 21
					15 01 00 00 00 00 02 2F 32
					15 01 00 00 00 00 02 32 43
					15 01 00 00 00 00 02 35 54
					15 01 00 00 00 00 02 38 65
					15 01 00 00 00 00 02 40 98
					15 01 00 00 00 00 02 46 DC
					15 01 00 00 00 00 02 49 FE
					15 01 00 00 00 00 02 4C FF
					15 01 00 00 00 00 02 4D FF
					15 01 00 00 00 00 02 4E 00
					15 01 00 00 00 00 02 4F 00
					15 01 00 00 00 00 02 50 00
					15 01 00 00 00 00 02 51 00
					15 01 00 00 00 00 02 52 00
					15 01 00 00 00 00 02 53 08
					15 01 00 00 00 00 02 54 14
					15 01 00 00 00 00 02 55 00
					15 01 00 00 00 00 02 56 1D
					15 01 00 00 00 00 02 58 25
					15 01 00 00 00 00 02 59 00
					15 01 00 00 00 00 02 5A 31
					15 01 00 00 00 00 02 5B 35
					15 01 00 00 00 00 02 5C 00
					15 01 00 00 00 00 02 5F 00
					15 01 00 00 00 00 02 60 7B
					15 01 00 00 00 00 02 61 8F
					15 01 00 00 00 00 02 62 00
					15 01 00 00 00 00 02 63 A4
					15 01 00 00 00 00 02 64 D5
					15 01 00 00 00 00 02 65 10
					15 01 00 00 00 00 02 66 0E
					15 01 00 00 00 00 02 67 4C
					15 01 00 00 00 00 02 68 11
					15 01 00 00 00 00 02 69 95
					15 01 00 00 00 00 02 6A E3
					15 01 00 00 00 00 02 6B 21
					15 01 00 00 00 00 02 6C 39
					15 01 00 00 00 00 02 6D 9B
					15 01 00 00 00 00 02 6E 32
					15 01 00 00 00 00 02 70 7D
					15 01 00 00 00 00 02 71 33
					15 01 00 00 00 00 02 72 FC
					15 01 00 00 00 00 02 73 83
					15 01 00 00 00 00 02 74 54
					15 01 00 00 00 00 02 77 65
					15 01 00 00 00 00 02 78 62
					15 01 00 00 00 00 02 79 12
					15 01 00 00 00 00 02 7A 77
					15 01 00 00 00 00 02 7D 98
					15 01 00 00 00 00 02 7E 91
					15 01 00 00 00 00 02 7F 7E
					15 01 00 00 00 00 02 80 BA
					15 01 00 00 00 00 02 81 80
					15 01 00 00 00 00 02 82 8A
					15 01 00 00 00 00 02 83 DC
					15 01 00 00 00 00 02 86 FE
					15 01 00 00 00 00 02 87 6C
					15 01 00 00 00 00 02 89 FF
					15 01 00 00 00 00 02 8A FF
					15 01 00 00 00 00 02 8B 00
					15 01 00 00 00 00 02 8C 00
					15 01 00 00 00 00 02 8D 00
					15 01 00 00 00 00 02 8F 00
					15 01 00 00 00 00 02 90 08
					15 01 00 00 00 00 02 91 19
					15 01 00 00 00 00 02 92 00
					15 01 00 00 00 00 02 93 21
					15 01 00 00 00 00 02 94 29
					15 01 00 00 00 00 02 95 00
					15 01 00 00 00 00 02 96 35
					15 01 00 00 00 00 02 98 00
					15 01 00 00 00 00 02 99 42
					15 01 00 00 00 00 02 9A 62
					15 01 00 00 00 00 02 9B 00
					15 01 00 00 00 00 02 9C 87
					15 01 00 00 00 00 02 9D 9C
					15 01 00 00 00 00 02 9E 00
					15 01 00 00 00 00 02 A2 10
					15 01 00 00 00 00 02 A5 11
					15 01 00 00 00 00 02 A9 22
					15 01 00 00 00 00 02 AC 32
					15 01 00 00 00 00 02 AF 43
					15 01 00 00 00 00 02 B2 54
					15 01 00 00 00 00 02 B8 87
					15 01 00 00 00 00 02 BE BA
					15 01 00 00 00 00 02 C1 DC
					15 01 00 00 00 00 02 C4 FE
					15 01 00 00 00 00 02 C6 CE
					15 01 00 00 00 00 02 C7 FF
					15 01 00 00 00 00 02 C8 FF
					15 01 00 00 00 00 02 FE 12
					15 01 00 00 00 00 02 00 00
					15 01 00 00 00 00 02 01 42
					15 01 00 00 00 00 02 02 00
					15 01 00 00 00 00 02 03 44
					15 01 00 00 00 00 02 04 48
					15 01 00 00 00 00 02 05 00
					15 01 00 00 00 00 02 06 70
					15 01 00 00 00 00 02 08 00
					15 01 00 00 00 00 02 09 E6
					15 01 00 00 00 00 02 0B 10
					15 01 00 00 00 00 02 0E 21
					15 01 00 00 00 00 02 11 22
					15 01 00 00 00 00 02 14 33
					15 01 00 00 00 00 02 17 43
					15 01 00 00 00 00 02 1A 54
					15 01 00 00 00 00 02 1D 65
					15 01 00 00 00 00 02 20 66
					15 01 00 00 00 00 02 23 76
					15 01 00 00 00 00 02 26 77
					15 01 00 00 00 00 02 28 F8
					15 01 00 00 00 00 02 29 77
					15 01 00 00 00 00 02 2A 00
					15 01 00 00 00 00 02 2B 4A
					15 01 00 00 00 00 02 2D 00
					15 01 00 00 00 00 02 2F 4C
					15 01 00 00 00 00 02 30 50
					15 01 00 00 00 00 02 31 00
					15 01 00 00 00 00 02 32 78
					15 01 00 00 00 00 02 33 A8
					15 01 00 00 00 00 02 34 00
					15 01 00 00 00 00 02 35 EE
					15 01 00 00 00 00 02 36 4D
					15 01 00 00 00 00 02 37 10
					15 01 00 00 00 00 02 38 CA
					15 01 00 00 00 00 02 3A 21
					15 01 00 00 00 00 02 3B 72
					15 01 00 00 00 00 02 3D EF
					15 01 00 00 00 00 02 3F 22
					15 01 00 00 00 00 02 41 AE
					15 01 00 00 00 00 02 42 33
					15 01 00 00 00 00 02 44 82
					15 01 00 00 00 00 02 45 43
					15 01 00 00 00 00 02 46 F7
					15 01 00 00 00 00 02 47 5C
					15 01 00 00 00 00 02 48 54
					15 01 00 00 00 00 02 4A 0A
					15 01 00 00 00 00 02 4B 65
					15 01 00 00 00 00 02 4C 56
					15 01 00 00 00 00 02 4D 9D
					15 01 00 00 00 00 02 4E 66
					15 01 00 00 00 00 02 4F E1
					15 01 00 00 00 00 02 50 21
					15 01 00 00 00 00 02 51 76
					15 01 00 00 00 00 02 52 5A
					15 01 00 00 00 00 02 54 77
					15 01 00 00 00 00 02 55 CD
					15 01 00 00 00 00 02 56 F8
					15 01 00 00 00 00 02 58 77
					15 01 00 00 00 00 02 59 00
					15 01 00 00 00 00 02 5B 00
					15 01 00 00 00 00 02 5E 00
					15 01 00 00 00 00 02 60 98
					15 01 00 00 00 00 02 61 00
					15 01 00 00 00 00 02 62 D6
					15 01 00 00 00 00 02 63 3D
					15 01 00 00 00 00 02 64 10
					15 01 00 00 00 00 02 67 21
					15 01 00 00 00 00 02 68 56
					15 01 00 00 00 00 02 69 CF
					15 01 00 00 00 00 02 6A 22
					15 01 00 00 00 00 02 6D 33
					15 01 00 00 00 00 02 70 43
					15 01 00 00 00 00 02 73 54
					15 01 00 00 00 00 02 76 55
					15 01 00 00 00 00 02 79 66
					15 01 00 00 00 00 02 7C 76
					15 01 00 00 00 00 02 7F 77
					15 01 00 00 00 00 02 81 F8
					15 01 00 00 00 00 02 82 77
					15 01 00 00 00 00 02 FE 12
					15 01 00 00 00 00 02 84 00
					15 01 00 00 00 00 02 FE 12
					15 01 00 00 00 00 02 86 00
					15 01 00 00 00 00 02 87 00
					15 01 00 00 00 00 02 88 00
					15 01 00 00 00 00 02 83 10];
				qcom,mdss-dsi-source-backlight-enter = [
					15 01 00 00 00 00 02 FE 40
					15 01 00 00 00 00 02 1D B8
					15 01 00 00 00 00 02 FE D0
					15 01 00 00 00 00 02 71 01
					15 01 00 00 01 00 02 FB AA
					15 01 00 00 00 00 02 FE 72
					15 01 00 00 00 00 02 77 10
					15 01 00 00 00 00 02 78 35
					15 01 00 00 00 00 02 79 47
					15 01 00 00 00 00 02 7A 66
					15 01 00 00 00 00 02 7B 8F
					15 01 00 00 00 00 02 7C C9
					15 01 00 00 00 00 02 7D 15
					15 01 00 00 00 00 02 7E 80
					15 01 00 00 00 00 02 7F 16
					15 01 00 00 00 00 02 80 88
					15 01 00 00 00 00 02 81 E5
					15 01 00 00 00 00 02 82 39
					15 01 00 00 00 00 02 83 7E
					15 01 00 00 00 00 02 84 C4
					15 01 00 00 00 00 02 85 FF
					15 01 00 00 00 00 02 73 00
					15 01 00 00 00 00 02 74 50
					15 01 00 00 00 00 02 75 EA
					15 01 00 00 00 00 02 76 3F
					15 01 00 00 00 00 02 FE 74
					15 01 00 00 00 00 02 02 00
					15 01 00 00 00 00 02 09 00
					15 01 00 00 00 00 02 0A 00
					15 01 00 00 00 00 02 0E 40
					15 01 00 00 00 00 02 10 00
					15 01 00 00 00 00 02 12 00
					15 01 00 00 00 00 02 13 00
					15 01 00 00 00 00 02 19 40
					15 01 00 00 00 00 02 38 00
					15 01 00 00 00 00 02 3A FF
					15 01 00 00 00 00 02 3D FF
					15 01 00 00 00 00 02 41 FF
					15 01 00 00 00 00 02 46 FF
					15 01 00 00 00 00 02 58 40
					15 01 00 00 00 00 02 FE 40
					15 01 00 00 00 00 02 1D F8
					15 01 00 00 00 00 02 FE D0
					15 01 00 00 00 00 02 71 02
					15 01 00 00 14 00 02 FB AA];
				qcom,mdss-dsi-source-backlight-exit = [
					15 01 00 00 00 00 02 FE 40
					15 01 00 00 00 00 02 1D B8
					15 01 00 00 00 00 02 FE D0
					15 01 00 00 00 00 02 71 01
					15 01 00 00 01 00 02 FB AA
					15 01 00 00 00 00 02 FE 72
					15 01 00 00 00 00 02 77 00
					15 01 00 00 00 00 02 78 00
					15 01 00 00 00 00 02 79 00
					15 01 00 00 00 00 02 7A 62
					15 01 00 00 00 00 02 7B 96
					15 01 00 00 00 00 02 7C C3
					15 01 00 00 00 00 02 7D 13
					15 01 00 00 00 00 02 7E 7F
					15 01 00 00 00 00 02 7F 11
					15 01 00 00 00 00 02 80 82
					15 01 00 00 00 00 02 81 E0
					15 01 00 00 00 00 02 82 32
					15 01 00 00 00 00 02 83 84
					15 01 00 00 00 00 02 84 C5
					15 01 00 00 00 00 02 85 FF
					15 01 00 00 00 00 02 73 00
					15 01 00 00 00 00 02 74 50
					15 01 00 00 00 00 02 75 EA
					15 01 00 00 00 00 02 76 3F
					15 01 00 00 00 00 02 fe 74
					15 01 00 00 00 00 02 02 50
					15 01 00 00 00 00 02 09 55
					15 01 00 00 00 00 02 0A 55
					15 01 00 00 00 00 02 0E 70
					15 01 00 00 00 00 02 10 01
					15 01 00 00 00 00 02 12 10
					15 01 00 00 00 00 02 13 05
					15 01 00 00 00 00 02 19 10
					15 01 00 00 00 00 02 38 30
					15 01 00 00 00 00 02 3A F0
					15 01 00 00 00 00 02 3D 0F
					15 01 00 00 00 00 02 41 ff
					15 01 00 00 00 00 02 46 ff
					15 01 00 00 00 00 02 58 70
					15 01 00 00 00 00 02 FE 40
					15 01 00 00 00 00 02 1D F8
					15 01 00 00 00 00 02 FE D0
					15 01 00 00 00 00 02 71 02
					15 01 00 00 14 00 02 FB AA];
				qcom,mdss-dsi-lp1-command = [
					15 01 00 00 00 00 02 FE D0
					15 01 00 00 00 00 02 45 40
					15 01 00 00 00 00 02 FE 00
					15 01 00 00 00 00 02 39 00];
				qcom,mdss-dsi-lp2-command = [
					15 01 00 00 00 00 02 FE D0
					15 01 00 00 00 00 02 45 40
					15 01 00 00 00 00 02 FE 00
					15 01 00 00 00 00 02 39 00];
				qcom,mdss-dsi-nolp-command = [
					15 01 00 00 00 00 02 FE 00
					15 01 00 00 00 00 02 38 00];
				qcom,mdss-dsi-local-hbm-enter = [
					15 01 00 00 00 00 02 fe 00
					15 01 00 00 14 00 02 83 01];
				qcom,mdss-dsi-local-hbm-exit = [
					15 01 00 00 00 00 02 fe 00
					15 01 00 00 14 00 02 83 00];
				qcom,mdss-dsi-CGM-P3-feature = [
					15 01 00 00 00 00 02 FE 12
					15 01 00 00 14 00 02 83 20];
				qcom,mdss-dsi-CGM-sRGB-feature = [
					15 01 00 00 00 00 02 FE 12
					15 01 00 00 14 00 02 83 10];
				qcom,mdss-dsi-CGM-Native-feature = [
					15 01 00 00 00 00 02 FE 12
					15 01 00 00 14 00 02 83 30];
				qcom,mdss-dsi-CGM-exit = [
					15 01 00 00 00 00 02 FE 12
					15 01 00 00 00 00 02 83 00];
				qcom,mdss-dsi-on-command-state = "dsi_lp_mode";
				qcom,mdss-dsi-off-command-state = "dsi_hs_mode";
				qcom,mdss-dsi-HBM-enable-state = "dsi_hs_mode";
				qcom,mdss-dsi-HBM-disable-state = "dsi_hs_mode";
				qcom,mdss-dsi-panel-ct-enter-state = "dsi_hs_mode";
				qcom,mdss-dsi-source-backlight-enter-state = "dsi_hs_mode";
				qcom,mdss-dsi-source-backlight-exit-state = "dsi_hs_mode";
				qcom,mdss-dsi-lp1-command-state = "dsi_hs_mode";
				qcom,mdss-dsi-lp2-command-state = "dsi_hs_mode";
				qcom,mdss-dsi-nolp-command-state = "dsi_hs_mode";
				qcom,mdss-dsi-local-hbm-enter-state = "dsi_hs_mode";
				qcom,mdss-dsi-local-hbm-exit-state = "dsi_hs_mode";
				qcom,mdss-dsi-CGM-P3-feature-state = "dsi_hs_mode";
				qcom,mdss-dsi-CGM-sRGB-feature-state = "dsi_hs_mode";
				qcom,mdss-dsi-CGM-Native-feature-state = "dsi_hs_mode";
				qcom,mdss-dsi-CGM-exit-status = "dsi_hs_mode";
				qcom,mdss-dsi-h-sync-pulse = <0>;
			};
		};
	};
};
