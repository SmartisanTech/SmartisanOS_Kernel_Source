## drivers/ese-nxp/Kconfig
```kconfig
#
# NXP P61 Devices
#

menu "NXP Secure Element devices"
    depends on P61

config P61_NFC
    tristate "P61 SPI driver"
    depends on SPI
    select CRC_CCITT
    default n
    ---help---
      Say yes if you want P61 secure element driver.
      This is for spi connected version. If unsure, say N here.

      To compile this driver as a module, choose m here. The module will
      be called p61.

endmenu
config P61_NFC
    tristate "P61 SPI driver"
    depends on SPI
    select CRC_CCITT
    help
```

## drivers/fingerprint/Kconfig
```kconfig
menuconfig FINGERPRINT
    tristate "Fingerprint Config Choosen"
    default y
    help
    Say Y to can config finperprint manufacturer

if  FINGERPRINT
    source "drivers/fingerprint/fpc/Kconfig"
    source "drivers/fingerprint/goodix/Kconfig"
endif
```

## drivers/fingerprint/fpc/Kconfig
```kconfig
config FINGERPRINT_FPC
	tristate "fpc fingerprint drvier support"
	depends on FINGERPRINT
	help
	  Say Y here to enable goodix fingerprint driver support!
```

## drivers/fingerprint/idex/Kconfig
```kconfig
#
# Fingerprints driver configuration
#
menuconfig INPUT_FINGERPRINT
	bool "FingerPrints"
	help
	  Say Y here, and a list of supported fingerprints will be displayed.
	  This option doesn't affect the kernel.

	  If unsure, say Y.

if INPUT_FINGERPRINT
config INPUT_IX_BTP
       tristate "IX fingerprint sensor support"
       depends on SPI_MASTER

endif
```

## drivers/input/fingerprint/Kconfig
```kconfig
menuconfig FINGERPRINT
    tristate "Fingerprint Config Choosen"
    default y
    help
    Say Y to can config finperprint manufacturer

source "drivers/input/fingerprint/goodix/Kconfig"
source "drivers/input/fingerprint/idex/Kconfig"
source "drivers/input/fingerprint/betterlife/Kconfig"
```

## drivers/input/fingerprint/betterlife/Kconfig
```kconfig
config BETTERLIFE_FINGERPRINT
	tristate "blestech tee driver support"
	help
	  Say Y here if you want to support blestech tee  etc...
```

## drivers/input/fingerprint/goodix/Kconfig
```kconfig
config GOODIX_FINGERPRINT
	tristate "Goodix fingerprint drvier support"
	depends on FINGERPRINT
	help
	  Say Y here to enable goodix fingerprint driver support!
```

## drivers/input/touchscreen/focaltech_touch/Kconfig
```kconfig
#
# Focaltech Touchscreen driver configuration
#

config TOUCHSCREEN_FTS
	bool "Focaltech Touchscreen"
	default n
	help
	  Say Y here if you have Focaltech touch panel.
	  If unsure, say N.

config TOUCHSCREEN_FTS_LOG
	bool "Focaltech Touchscreen Log"
	depends on TOUCHSCREEN_FTS
	default n
	help
	  Say Y here if you need FTS debug log.
	  If unsure, say N.

config TOUCHSCREEN_FTS_FOD
	bool "Focaltech Touchscreen FOD"
	depends on TOUCHSCREEN_FTS
	default n
	help
	  Say Y here if you need FOD feature.
	  If unsure, say N.
```

## drivers/input/touchscreen/novatek_touch/Kconfig
```kconfig
#
# Novatek NT36672 touchscreen driver configuration
#
config TOUCHSCREEN_NT36672
	bool "Novatek NT36672"
	default y
	help
	  Say Y here if you have a Novatek NT36672 touchscreen connected
	  to your system.

	  If unsure, say N.
```

## drivers/misc/haptic/Kconfig
```kconfig
config ISA1200_HAPTICS
	tristate "IMAGIS ISA1200"
	default n
	help
	  Say Y to enable haptic driver ISA1200.
```

## drivers/smartisan/Kconfig
```kconfig
config HW_INFO
	tristate "For vendor hw info"
	default y
	---help---
	  This define for vendor hw info 
	  default Y.

config FACTORY_SUPPORT 
	tristate "For factory version support"
	default n
	---help---
	  This define for factory support 
	  if factory version, Y.
	  
```

## fs/sdcardfs/Kconfig
```kconfig
config SDCARD_FS
	tristate "sdcard file system"
	depends on CONFIGFS_FS
	default n
	help
	  Sdcardfs is based on Wrapfs file system.

config SDCARD_FS_FADV_NOACTIVE
	bool "sdcardfs fadvise noactive support"
	depends on FADV_NOACTIVE
	default y
	help
	  Sdcardfs supports fadvise noactive mode.

config SDCARD_FS_XATTR
	bool "Sdcardfs extended attribute"
	default y
	depends on SDCARD_FS
	help
	  Modification of sdcard file system for xattr
```
